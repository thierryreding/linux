## Documentation/devicetree/bindings/usb/nvidia,tegra186-xusb.yaml
```yaml
# SPDX-License-Identifier: (GPL-2.0-only OR BSD-2-Clause)
%YAML 1.2
---
$id: http://devicetree.org/schemas/usb/nvidia,tegra186-xusb.yaml#
$schema: http://devicetree.org/meta-schemas/core.yaml#

title: NVIDIA Tegra186 xHCI controller

maintainers:
  - Thierry Reding <thierry.reding@gmail.com>
  - Jon Hunter <jonathanh@nvidia.com>

description: The Tegra xHCI controller supports both USB2 and USB3 interfaces exposed by the Tegra
  XUSB pad controller.

properties:
  compatible:
    const: nvidia,tegra186-xusb

  reg:
    items:
      - description: base and length of the xHCI host registers
      - description: base and length of the XUSB FPCI registers

  reg-names:
    items:
      - const: hcd
      - const: fpci

  interrupts:
    items:
      - description: xHCI host interrupt
      - description: mailbox interrupt

  clocks:
    items:
      - description: XUSB host clock
      - description: XUSB Falcon source clock
      - description: XUSB SuperSpeed clock
      - description: XUSB SuperSpeed source clock
      - description: XUSB HighSpeed clock source
      - description: XUSB FullSpeed clock source
      - description: USB PLL
      - description: reference clock
      - description: I/O PLL

  clock-names:
    items:
      - const: xusb_host
      - const: xusb_falcon_src
      - const: xusb_ss
      - const: xusb_ss_src
      - const: xusb_hs_src
      - const: xusb_fs_src
      - const: pll_u_480m
      - const: clk_m
      - const: pll_e

  interconnects:
    items:
      - description: read client
      - description: write client

  interconnect-names:
    items:
      - const: dma-mem # read
      - const: write

  iommus:
    maxItems: 1

  nvidia,xusb-padctl:
    $ref: /schemas/types.yaml#/definitions/phandle
    description: phandle to the XUSB pad controller that is used to configure the USB pads used by
      the XHCI controller

  phys:
    minItems: 1
    maxItems: 7

  phy-names:
    contains:
      anyOf:
        - const: usb2-0
        - const: usb2-1
        - const: usb2-2
        - const: hsic-0
        - const: usb3-0
        - const: usb3-1
        - const: usb3-2

  power-domains:
    description: A list of PM domain specifiers that reference each power-domain used by the xHCI
      controller. This list must comprise of a specifier for the XUSBA and XUSBC power-domains.
      See ../power/power_domain.txt and ../arm/tegra/nvidia,tegra20-pmc.txt for details.
    items:
      - description: XUSBC power domain
      - description: XUSBA power domain

  power-domain-names:
    description: A list of names that represent each of the specifiers in the 'power-domains'
      property. See ../power/power_domain.txt for details.
    items:
      - const: xusb_host
      - const: xusb_ss

  dvddio-pex-supply:
    description: PCIe/USB3 analog logic power supply. Must supply 1.05 V.

  hvddio-pex-supply:
    description: High-voltage PCIe/USB3 power supply. Must supply 1.8 V.

  avdd-usb-supply:
    description: USB controller power supply. Must supply 3.3 V.

  avdd-pll-utmip-supply:
    description: UTMI PLL power supply. Must supply 1.8 V.

  avdd-pll-uerefe-supply:
    description: PLLE reference PLL power supply. Must supply 1.05 V.

  dvdd-usb-ss-pll-supply:
    description: PCIe/USB3 PLL power supply. Must supply 1.05 V.

  hvdd-usb-ss-pll-e-supply:
    description: High-voltage PLLE power supply. Must supply 1.8 V.

  # USB bus
  "#address-cells":
    const: 1

  "#size-cells":
    const: 0

additionalProperties:
  description: USB device nodes
  type: object

examples:
  - |
    #include <dt-bindings/clock/tegra186-clock.h>
    #include <dt-bindings/interrupt-controller/arm-gic.h>
    #include <dt-bindings/memory/tegra186-mc.h>
    #include <dt-bindings/power/tegra186-powergate.h>
    #include <dt-bindings/reset/tegra186-reset.h>

    usb@3530000 {
        compatible = "nvidia,tegra186-xusb";
        reg = <0x03530000 0x8000>,
              <0x03538000 0x1000>;
        reg-names = "hcd", "fpci";
        interrupts = <GIC_SPI 163 IRQ_TYPE_LEVEL_HIGH>,
                     <GIC_SPI 164 IRQ_TYPE_LEVEL_HIGH>;
        clocks = <&bpmp TEGRA186_CLK_XUSB_HOST>,
                 <&bpmp TEGRA186_CLK_XUSB_FALCON>,
                 <&bpmp TEGRA186_CLK_XUSB_SS>,
                 <&bpmp TEGRA186_CLK_XUSB_CORE_SS>,
                 <&bpmp TEGRA186_CLK_CLK_M>,
                 <&bpmp TEGRA186_CLK_XUSB_FS>,
                 <&bpmp TEGRA186_CLK_PLLU>,
                 <&bpmp TEGRA186_CLK_CLK_M>,
                 <&bpmp TEGRA186_CLK_PLLE>;
        clock-names = "xusb_host", "xusb_falcon_src", "xusb_ss",
                      "xusb_ss_src", "xusb_hs_src", "xusb_fs_src",
                      "pll_u_480m", "clk_m", "pll_e";
        power-domains = <&bpmp TEGRA186_POWER_DOMAIN_XUSBC>,
                        <&bpmp TEGRA186_POWER_DOMAIN_XUSBA>;
        power-domain-names = "xusb_host", "xusb_ss";
        interconnects = <&mc TEGRA186_MEMORY_CLIENT_XUSB_HOSTR &emc>,
                        <&mc TEGRA186_MEMORY_CLIENT_XUSB_HOSTW &emc>;
        interconnect-names = "dma-mem", "write";
        iommus = <&smmu TEGRA186_SID_XUSB_HOST>;
        nvidia,xusb-padctl = <&padctl>;

        #address-cells = <1>;
        #size-cells = <0>;

        phys = <&{/padctl@3520000/pads/usb2/lanes/usb2-0}>,
               <&{/padctl@3520000/pads/usb2/lanes/usb2-1}>,
               <&{/padctl@3520000/pads/usb3/lanes/usb3-0}>;
        phy-names = "usb2-0", "usb2-1", "usb3-0";
    };
```

## Documentation/devicetree/bindings/usb/nvidia,tegra20-udc.yaml
```yaml
# SPDX-License-Identifier: GPL-2.0-only
%YAML 1.2
---
$id: "http://devicetree.org/schemas/usb/nvidia,tegra20-udc.yaml#"
$schema: "http://devicetree.org/meta-schemas/core.yaml#"

title: NVIDIA Tegra20 (and later) USB device mode controller

maintainers:
  - Thierry Reding <thierry.reding@gmail.com>
  - Jon Hunter <jonathanh@nvidia.com>

properties:
  compatible:
    enum:
      - nvidia,tegra20-udc
      - nvidia,tegra30-udc
      - nvidia,tegra114-udc
      - nvidia,tegra124-udc

  reg:
    maxItems: 1

  interrupts:
    maxItems: 1

  clocks:
    items:
      - description: module clock

  resets:
    items:
      - description: module reset

  reset-names:
    items:
      - const: usb

  nvidia,needs-double-reset:
    $ref: "/schemas/types.yaml#/definitions/flag"
    description: Specifies a workaround for the USB1 port that needs to be reset twice internally
      some Tegra devices.

  nvidia,phy:
    $ref: "/schemas/types.yaml#/definitions/phandle"
    description: phandle for the PHY device. Use "phys" instead.
    deprecated: true

allOf:
  - $ref: chipidea,usb2-core.yaml

unevaluatedProperties: true

required:
  - compatible
  - reg
  - interrupts
  - clocks
  - resets
  - reset-names

examples:
  - |
    #include <dt-bindings/clock/tegra20-car.h>
    #include <dt-bindings/interrupt-controller/arm-gic.h>

    usb@c5000000 {
      compatible = "nvidia,tegra20-udc";
      reg = <0xc5000000 0x4000>;
      interrupts = <GIC_SPI 20 IRQ_TYPE_LEVEL_HIGH>;
      clocks = <&tegra_car TEGRA20_CLK_USBD>;
      resets = <&tegra_car 20>;
      reset-names = "usb";

      dr_mode = "peripheral";
      phy_type = "utmi";

      nvidia,needs-double-reset;
      nvidia,phy = <&phy1>;
    };
```

## drivers/gpu/drm/imx/Kconfig
```kconfig
config DRM_IMX
	tristate "DRM Support for Freescale i.MX"
	select DRM_KMS_HELPER
	select DRM_KMS_FB_HELPER
	select VIDEOMODE_HELPERS
	select DRM_GEM_CMA_HELPER
	select DRM_KMS_CMA_HELPER
	depends on DRM && (ARCH_MXC || ARCH_MULTIPLATFORM)
	depends on IMX_IPUV3_CORE
	help
	  enable i.MX graphics support

config DRM_IMX_PARALLEL_DISPLAY
	bool "Support for parallel displays"
	select DRM_PANEL
	depends on DRM_IMX
	select VIDEOMODE_HELPERS

config DRM_IMX_TVE
	bool "Support for TV and VGA displays"
	depends on DRM_IMX
	select REGMAP_MMIO
	help
	  Choose this to enable the internal Television Encoder (TVe)
	  found on i.MX53 processors.

config DRM_IMX_LDB
	bool "Support for LVDS displays"
	depends on DRM_IMX && MFD_SYSCON
	select DRM_PANEL
	help
	  Choose this to enable the internal LVDS Display Bridge (LDB)
	  found on i.MX53 and i.MX6 processors.

config DRM_IMX_IPUV3
	bool
	depends on DRM_IMX
	depends on IMX_IPUV3_CORE
	default y

config DRM_IMX_HDMI
	bool "Freescale i.MX DRM HDMI"
	select DRM_DW_HDMI
	depends on DRM_IMX
	help
	  Choose this if you want to use HDMI on i.MX6.
```

## drivers/staging/media/tegra-vde/Kconfig
```kconfig
config TEGRA_VDE
	tristate "NVIDIA Tegra Video Decoder Engine driver"
	depends on ARCH_TEGRA || COMPILE_TEST
	depends on VIDEO_DEV && VIDEO_V4L2 && MEDIA_CONTROLLER
	depends on MEDIA_CONTROLLER_REQUEST_API
	select V4L2_MEM2MEM_DEV
	select VIDEOBUF2_DMA_CONTIG
	select DMA_SHARED_BUFFER
	select SRAM
	help
	    Say Y here to enable support for the NVIDIA Tegra video decoder
	    driver.
```
