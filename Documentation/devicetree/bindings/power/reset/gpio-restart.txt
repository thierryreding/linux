## Documentation/devicetree/bindings/power/reset/gpio-restart.txt
```
Drive a GPIO line that can be used to restart the system from a restart
handler.

This binding supports level and edge triggered reset.  At driver load
time, the driver will request the given gpio line and install a restart
handler. If the optional properties 'open-source' is not found, the GPIO line
will be driven in the inactive state.  Otherwise its not driven until
the restart is initiated.

When the system is restarted, the restart handler will be invoked in
priority order.  The gpio is configured as an output, and driven active,
triggering a level triggered reset condition. This will also cause an
inactive->active edge condition, triggering positive edge triggered
reset. After a delay specified by active-delay, the GPIO is set to
inactive, thus causing an active->inactive edge, triggering negative edge
triggered reset. After a delay specified by inactive-delay, the GPIO
is driven active again.  After a delay specified by wait-delay, the
restart handler completes allowing other restart handlers to be attempted.

Required properties:
- compatible : should be "gpio-restart".
- gpios : The GPIO to set high/low, see "gpios property" in
  Documentation/devicetree/bindings/gpio/gpio.txt. If the pin should be
  low to reset the board set it to "Active Low", otherwise set
  gpio to "Active High".

Optional properties:
- open-source : Treat the GPIO as being open source and defer driving
  it to when the restart is initiated.  If this optional property is not
  specified, the GPIO is initialized as an output in its inactive state.
- active-delay: Delay (default 100) to wait after driving gpio active [ms]
- inactive-delay: Delay (default 100) to wait after driving gpio inactive [ms]
- wait-delay: Delay (default 3000) to wait after completing restart
  sequence [ms]

Examples:

gpio-restart {
	compatible = "gpio-restart";
	gpios = <&gpio 4 0>;
	active-delay = <100>;
	inactive-delay = <100>;
	wait-delay = <3000>;
};
```

## Documentation/devicetree/bindings/pwm/nvidia,tegra20-pwm.yaml
```yaml
# SPDX-License-Identifier: (GPL-2.0-only OR BSD-2-Clause)
%YAML 1.2
---
$id: http://devicetree.org/schemas/pwm/nvidia,tegra20-pwm.yaml#
$schema: http://devicetree.org/meta-schemas/core.yaml#

title: NVIDIA Tegra PWFM controller

maintainers:
  - Thierry Reding <thierry.reding@gmail.com>
  - Jon Hunter <jonathanh@nvidia.com>

properties:
  compatible:
    oneOf:
      - items:
          - const: nvidia,tegra20-pwm

      - items:
          - enum:
              - nvidia,tegra30-pwm
              - nvidia,tegra114-pwm
              - nvidia,tegra124-pwm
              - nvidia,tegra132-pwm
              - nvidia,tegra210-pwm
          - enum:
              - nvidia,tegra20-pwm

      - items:
          - const: nvidia,tegra186-pwm

      - items:
          - const: nvidia,tegra194-pwm
          - const: nvidia,tegra186-pwm

  reg:
    maxItems: 1

  clocks:
    items:
      - description: module clock

  clock-names:
    items:
      - const: pwm

  resets:
    items:
      - description: module reset

  reset-names:
    items:
      - const: pwm

  "#pwm-cells":
    const: 2

  pinctrl-names:
    items:
      - const: default
      - const: sleep

  pinctrl-0:
    description: configuration for the default/active state

  pinctrl-1:
    description: configuration for the sleep state

  operating-points-v2:
    $ref: "/schemas/types.yaml#/definitions/phandle"

  power-domains:
    items:
      - description: phandle to the core power domain

allOf:
  - $ref: pwm.yaml

required:
  - compatible
  - reg
  - clocks
  - resets
  - reset-names

additionalProperties: false

examples:
  - |
    #include <dt-bindings/clock/tegra20-car.h>

    pwm: pwm@7000a000 {
        compatible = "nvidia,tegra20-pwm";
        reg = <0x7000a000 0x100>;
        #pwm-cells = <2>;
        clocks = <&tegra_car TEGRA20_CLK_PWM>;
        resets = <&tegra_car 17>;
        reset-names = "pwm";
    };

  # Example with the pin configuration for suspend and resume:
  # ==========================================================
  # Suppose pin PE7 (On Tegra210) interfaced with the regulator device and it requires PWM output
  # to be tristated when system enters suspend.
  - |
    #include <dt-bindings/clock/tegra210-car.h>
    #include <dt-bindings/pinctrl/pinctrl-tegra.h>

    pinmux@700008d4 {
        compatible = "nvidia,tegra210-pinmux";
        reg = <0x700008d4 0x29c>, /* Pad control registers */
              <0x70003000 0x294>; /* Mux registers */

        pwm_active_state: pwm_active_state {
            pe7 {
                nvidia,pins = "pe7";
                nvidia,tristate = <TEGRA_PIN_DISABLE>;
            };
        };

        pwm_sleep_state: pwm_sleep_state {
            pe7 {
                nvidia,pins = "pe7";
                nvidia,tristate = <TEGRA_PIN_ENABLE>;
            };
        };
    };

    pwm@7000a000 {
        compatible = "nvidia,tegra210-pwm", "nvidia,tegra20-pwm";
        reg = <0x7000a000 0x100>;
        clocks = <&tegra_car TEGRA210_CLK_PWM>;
        clock-names = "pwm";
        resets = <&tegra_car 17>;
        reset-names = "pwm";
        #pwm-cells = <2>;
        pinctrl-names = "default", "sleep";
        pinctrl-0 = <&pwm_active_state>;
        pinctrl-1 = <&pwm_sleep_state>;
    };
```

## Documentation/devicetree/bindings/pwm/st,stmpe-pwm.yaml
```yaml
# SPDX-License-Identifier: GPL-2.0-only
%YAML 1.2
---
$id: http://devicetree.org/schemas/pwm/st,stmpe-pwm.yaml#
$schema: http://devicetree.org/meta-schemas/core.yaml#

title: ST Microelectronics STMPE Multi-Functional Device (PWM)

maintainers:
  - Thierry Reding <thierry.reding@gmail.com>

description: This is a PWM block embedded in the ST Microelectronics STMPE (ST Multi-Purpose
  Expander) chips. The PWM is registered as a subdevices of the STMPE MFD device.

properties:
  compatible:
    const: st,stmpe-pwm

  "#pwm-cells":
    const: 2

additionalProperties: false

required:
  - compatible
  - "#pwm-cells"

examples:
  - |
    stmpe_pwm {
      compatible = "st,stmpe-pwm";
      #pwm-cells = <2>;
    };
```

## Documentation/devicetree/bindings/reserved-memory/memory-region.yaml
```yaml
# SPDX-License-Identifier: (GPL-2.0 OR BSD-2-Clause)
%YAML 1.2
---
$id: http://devicetree.org/schemas/reserved-memory/memory-region.yaml#
$schema: http://devicetree.org/meta-schemas/core.yaml#

title: Reserved Memory Region Device Tree Binding

maintainers:
  - devicetree-spec@vger.kernel.org

description: |
  Regions in the /reserved-memory node may be referenced by other device
  nodes by adding a memory-region property to the device node.

select: true

properties:
  memory-region:
    $ref: /schemas/types.yaml#/definitions/phandle-array
    description: >
      Phandle to a /reserved-memory child node assigned to the device.

      Reserved memory region references can be accompanied by a memory region
      specifier, which provides additional information about how the memory region
      will be used in that specific context. If a reserved memory region does not
      have the #memory-region-cells property, 0 is implied and no information
      besides the phandle is conveyed. For reserved memory regions that contain
      #memory-region-cells = <1>, the following encoding applies if not otherwise
      overridden by the bindings selected by the region's compatible string:

        - bit 0: If set, requests that the region be reserved if the system uses an
          IOMMU for I/O virtual address translations. One example where this can be
          used if a coprocessor uses a predefined region of memory

        - bit 1: If set, requests that the region be identity mapped if the system
          uses an IOMMU for I/O virtual address translations. This is used, for
          example, when a bootloader has configured a display controller to display
          a boot splash. Once the OS takes over and enables the IOMMU for the given
          display controller, the IOMMU may fault if the framebuffer hasn't been
          mapped to the IOMMU at the address that the display controller tries to
          access.

  memory-region-names:
    $ref: /schemas/types.yaml#/definitions/string-array
    description: >
      A list of names, one for each corresponding entry in the
      memory-region property

additionalProperties: true

examples:
  - |
    fb0: video@12300000 {
        /* ... */
        reg = <0x12300000 0x1000>;
        memory-region = <&display_reserved>;
    };

...
```

## Documentation/devicetree/bindings/serial/arm,sbsa-uart.yaml
```yaml
# SPDX-License-Identifier: (GPL-2.0-only OR BSD-2-Clause)
%YAML 1.2
---
$id: http://devicetree.org/schemas/serial/arm,sbsa-uart.yaml#
$schema: http://devicetree.org/meta-schemas/core.yaml#

title: ARM SBSA defined generic UART

maintainers:
  - Rob Herring <robh@kernel.org>
  - Greg Kroah-Hartman <gregkh@linuxfoundation.org>

description:
  This UART uses a subset of the PL011 registers and consequently lives
  in the PL011 driver. It's baudrate and other communication parameters
  cannot be adjusted at runtime, so it lacks a clock specifier here.

properties:
  compatible:
    const: arm,sbsa-uart

  reg:
    maxItems: 1

  interrupts:
    maxItems: 1

allOf:
  - $ref: serial.yaml

unevaluatedProperties: false

required:
  - compatible
  - reg
  - interrupts
...
```

## Documentation/devicetree/bindings/sound/maxim,max98090.yaml
```yaml
# SPDX-License-Identifier: GPL-2.0-only
%YAML 1.2
---
$id: http://devicetree.org/schemas/sound/maxim,max98090.yaml#
$schema: http://devicetree.org/meta-schemas/core.yaml#

title: Maxim MAX98090 audio codec

maintainers:
  - Mark Brown <broonie@kernel.org>

description: |
  Pins on the device (for linking into audio routes):

    * MIC1
    * MIC2
    * DMICL
    * DMICR
    * IN1
    * IN2
    * IN3
    * IN4
    * IN5
    * IN6
    * IN12
    * IN34
    * IN56
    * HPL
    * HPR
    * SPKL
    * SPKR
    * RCVL
    * RCVR
    * MICBIAS

properties:
  compatible:
    enum:
      - maxim,max98090
      - maxim,max98091

  reg:
    maxItems: 1

  interrupts:
    maxItems: 1

  clocks:
    items:
      - description: master clock

  clock-names:
    items:
      - const: mclk

  "#sound-dai-cells":
    const: 0

  maxim,dmic-freq:
    $ref: /schemas/types.yaml#/definitions/uint32
    description: Frequency at which to clock DMIC.

  maxim,micbias:
    $ref: /schemas/types.yaml#/definitions/uint32
    description: Micbias voltage applies to the analog mic.
    oneOf:
      - description: 2.2 V
        const: 0
      - description: 2.55 V
        const: 1
      - description: 2.4 V
        const: 2
      - description: 2.8 V
        const: 3

additionalProperties: false

required:
  - compatible
  - reg
  - interrupts

examples:
  - |
    #include <dt-bindings/gpio/tegra-gpio.h>
    #include <dt-bindings/interrupt-controller/irq.h>

    i2c {
      #address-cells = <1>;
      #size-cells = <0>;

      audio-codec@10 {
        compatible = "maxim,max98090";
        reg = <0x10>;
        interrupt-parent = <&gpio>;
        interrupts = <TEGRA_GPIO(H, 4) IRQ_TYPE_LEVEL_HIGH>;
      };
    };
```

## Documentation/devicetree/bindings/sound/maxim,max98357a.yaml
```yaml
# SPDX-License-Identifier: GPL-2.0-only
%YAML 1.2
---
$id: http://devicetree.org/schemas/sound/maxim,max98357a.yaml#
$schema: http://devicetree.org/meta-schemas/core.yaml#

title: Maxim MAX98357A/MAX98360A audio DAC

maintainers:
  - Kenneth Westfield <kwestfie@codeaurora.org>
  - Mark Brown <broonie@kernel.org>

description: This node models the Maxim MAX98357A/MAX98360A DAC.

properties:
  compatible:
    enum:
      - maxim,max98357a
      - maxim,max98360a

  sdmode-gpios:
    description: GPIO specifier for the chip's SD_MODE pin. If this option is not specified then
      driver does not manage the pin state (e.g. chip is always on).

  sdmode-delay:
    description: Specifies the delay time for SD_MODE pin. If this option is specified, which
      means it's required I2S clocks ready before SD_MODE is unmuted in order to avoid the speaker
      pop noise. It's observed that 5ms is sufficient.

additionalProperties: false

required:
  - compatible

examples:
  - |
    max98357a {
      compatible = "maxim,max98357a";
      sdmode-gpios = <&qcom_pinmux 25 0>;
    };

  - |
    max98360a {
      compatible = "maxim,max98360a";
      sdmode-gpios = <&qcom_pinmux 25 0>;
    };
```
