## Documentation/devicetree/bindings/usb/nvidia,tegra124-xusb.yaml
```yaml
# SPDX-License-Identifier: GPL-2.0-only
%YAML 1.2
---
$id: http://devicetree.org/schemas/usb/nvidia,tegra124-xusb.yaml#
$schema: http://devicetree.org/meta-schemas/core.yaml#

title: NVIDIA Tegra xHCI controller

maintainers:
  - Thierry Reding <thierry.reding@gmail.com>
  - Jon Hunter <jonathanh@nvidia.com>

description: |
  The Tegra xHCI controller supports both USB2 and USB3 interfaces exposed by
  the Tegra XUSB pad controller.

properties:
  compatible:
    oneOf:
      - enum:
          - nvidia,tegra124-xusb
          - nvidia,tegra210-xusb
          - nvidia,tegra186-xusb
          - nvidia,tegra194-xusb

      - items:
          - const: nvidia,tegra132-xusb
          - const: nvidia,tegra124-xusb

  reg:
    minItems: 1
    maxItems: 3

  reg-names:
    minItems: 1
    maxItems: 3

  interrupts:
    items:
      - description: xHCI host interrupt
      - description: mailbox interrupt

  clocks:
    minItems: 9
    maxItems: 11

  clock-names:
    minItems: 9
    maxItems: 11

  nvidia,xusb-padctl:
    description: phandle to the XUSB pad controller that is used to configure
      the USB pads used by the XHCI controller
    $ref: "/schemas/types.yaml#/definitions/phandle"

  "#address-cells":
    const: 1

  "#size-cells":
    const: 0

  resets:
    items:
      - description: reset for the XUSB host controller
      - description: reset for the SuperSpeed logic
      - description: shared reset for xusb_{ss,hs,fs,falcon,host}_src.

  reset-names:
    items:
      - const: xusb_host
      - const: xusb_ss
      - const: xusb_src

  iommus:
    maxItems: 1

  phys: true
  phy-names: true

  power-domains:
    description: A list of PM domain specifiers that reference each
      power-domain used by the xHCI controller. This list must comprise
      of a specifier for the XUSBA and XUSBC power-domains. See
      ../power/power_domain.txt and ../arm/tegra/nvidia,tegra20-pmc.txt
      for details.
    maxItems: 2

  power-domain-names:
    description: A list of names that represent each of the specifiers
      in the 'power-domains' property. See ../power/power_domain.txt for
      details.
    maxItems: 2

patternProperties:
  # USB device nodes can have arbitrary names, but always need a unit-address
  "^.*@[0-9]+$":
    type: object

required:
  - compatible
  - reg
  - reg-names
  - interrupts
  - clocks
  - clock-names
  - nvidia,xusb-padctl

unevaluatedProperties: false

allOf:
  - if:
      properties:
        compatible:
          contains:
            const: nvidia,tegra124-xusb
    then:
      properties:
        reg:
          items:
            - description: base and length of the xHCI host registers
            - description: base and length of the XUSB FPCI registers
            - description: base and length of the XUSB IPFS registers

        reg-names:
          items:
            - const: hcd
            - const: fpci
            - const: ipfs

        clocks:
          minItems: 11

        clock-names:
          items:
            - const: xusb_host
            - const: xusb_host_src
            - const: xusb_falcon_src
            - const: xusb_ss
            - const: xusb_ss_src
            - const: xusb_ss_div2
            - const: xusb_hs_src
            - const: xusb_fs_src
            - const: pll_u_480m
            - const: clk_m
            - const: pll_e

        phy-names:
          contains:
            anyOf:
              - const: usb2-0
              - const: usb2-1
              - const: usb2-2
              - const: hsic-0
              - const: hsic-1
              - const: usb3-0
              - const: usb3-1

        avddio-pex-supply:
          description: PCIe/USB3 analog logic power supply. Must supply
            1.05 V.

        dvddio-pex-supply:
          description: PCIe/USB3 digital logic power supply. Must supply
            1.05 V.

        avdd-usb-supply:
          description: USB controller power supply. Must supply 3.3 V.

        hvdd-usb-ss-supply:
          description: High-voltage PCIe/USB3 power supply. Must supply 3.3 V.

      required:
        - resets
        - reset-names

  - if:
      properties:
        compatible:
          contains:
            const: nvidia,tegra210-xusb
    then:
      properties:
        reg:
          items:
            - description: base and length of the xHCI host registers
            - description: base and length of the XUSB FPCI registers
            - description: base and length of the XUSB IPFS registers

        reg-names:
          items:
            - const: hcd
            - const: fpci
            - const: ipfs

        clocks:
          minItems: 11

        clock-names:
          items:
            - const: xusb_host
            - const: xusb_host_src
            - const: xusb_falcon_src
            - const: xusb_ss
            - const: xusb_ss_src
            - const: xusb_ss_div2
            - const: xusb_hs_src
            - const: xusb_fs_src
            - const: pll_u_480m
            - const: clk_m
            - const: pll_e

        phy-names:
          contains:
            anyOf:
              - const: usb2-0
              - const: usb2-1
              - const: usb2-2
              - const: usb2-3
              - const: hsic-0
              - const: usb3-0
              - const: usb3-1
              - const: usb3-2
              - const: usb3-3

        dvddio-pex-supply:
          description: PCIe/USB3 analog logic power supply. Must supply
            1.05 V.

        hvddio-pex-supply:
          description: High-voltage PCIe/USB3 power supply. Must supply 1.8 V.

        avdd-usb-supply:
          description: USB controller power supply. Must supply 3.3 V.

  - if:
      properties:
        compatible:
          contains:
            enum:
              - nvidia,tegra210-xusb
              - nvidia,tegra186-xusb
              - nvidia,tegra194-xusb
    then:
      properties:
        power-domain-names:
          items:
            - description: the XUSBC power domain
              const: xusb_host
            - description: the XUSBA power domain
              const: xusb_ss

      required:
        - power-domains
        - power-domain-names

  - if:
      properties:
        compatible:
          contains:
            enum:
              - nvidia,tegra186-xusb
              - nvidia,tegra194-xusb
    then:
      properties:
        # Tegra186 doesn't have the IPFS registers
        reg:
          items:
            - description: base and length of the xHCI host registers
            - description: base and length of the XUSB FPCI registers

        reg-names:
          items:
            - const: hcd
            - const: fpci

        clocks:
          maxItems: 9

        clock-names:
          items:
            - const: xusb_host
            - const: xusb_falcon_src
            - const: xusb_ss
            - const: xusb_ss_src
            - const: xusb_hs_src
            - const: xusb_fs_src
            - const: pll_u_480m
            - const: clk_m
            - const: pll_e

        phy-names:
          contains:
            anyOf:
              - const: usb2-0
              - const: usb2-1
              - const: usb2-2
              - const: hsic-0
              - const: usb3-0
              - const: usb3-1
              - const: usb3-2

examples:
  - |
    #include <dt-bindings/interrupt-controller/arm-gic.h>
    #include <dt-bindings/clock/tegra124-car.h>

    usb@0,70090000 {
        compatible = "nvidia,tegra124-xusb";
        reg = <0x70090000 0x8000>,
              <0x70098000 0x1000>,
              <0x70099000 0x1000>;
        reg-names = "hcd", "fpci", "ipfs";

        interrupts = <GIC_SPI 39 IRQ_TYPE_LEVEL_HIGH>,
                     <GIC_SPI 40 IRQ_TYPE_LEVEL_HIGH>;

        clocks = <&tegra_car TEGRA124_CLK_XUSB_HOST>,
                 <&tegra_car TEGRA124_CLK_XUSB_HOST_SRC>,
                 <&tegra_car TEGRA124_CLK_XUSB_FALCON_SRC>,
                 <&tegra_car TEGRA124_CLK_XUSB_SS>,
                 <&tegra_car TEGRA124_CLK_XUSB_SS_DIV2>,
                 <&tegra_car TEGRA124_CLK_XUSB_SS_SRC>,
                 <&tegra_car TEGRA124_CLK_XUSB_HS_SRC>,
                 <&tegra_car TEGRA124_CLK_XUSB_FS_SRC>,
                 <&tegra_car TEGRA124_CLK_PLL_U_480M>,
                 <&tegra_car TEGRA124_CLK_CLK_M>,
                 <&tegra_car TEGRA124_CLK_PLL_E>;
        clock-names = "xusb_host", "xusb_host_src", "xusb_falcon_src",
                      "xusb_ss", "xusb_ss_div2", "xusb_ss_src",
                      "xusb_hs_src", "xusb_fs_src", "pll_u_480m",
                      "clk_m", "pll_e";
        resets = <&tegra_car 89>, <&tegra_car 156>, <&tegra_car 143>;
        reset-names = "xusb_host", "xusb_ss", "xusb_src";

        nvidia,xusb-padctl = <&padctl>;

        phys = <&{/padctl@0,7009f000/pads/usb2/lanes/usb2-1}>, /* mini-PCIe USB */
               <&{/padctl@0,7009f000/pads/usb2/lanes/usb2-2}>, /* USB A */
               <&{/padctl@0,7009f000/pads/pcie/lanes/pcie-0}>; /* USB A */
        phy-names = "usb2-1", "usb2-2", "usb3-0";

        avddio-pex-supply = <&vdd_1v05_run>;
        dvddio-pex-supply = <&vdd_1v05_run>;
        avdd-usb-supply = <&vdd_3v3_lp0>;
        avdd-pll-utmip-supply = <&vddio_1v8>;
        avdd-pll-erefe-supply = <&avdd_1v05_run>;
        avdd-usb-ss-pll-supply = <&vdd_1v05_run>;
        hvdd-usb-ss-supply = <&vdd_3v3_lp0>;
        hvdd-usb-ss-pll-e-supply = <&vdd_3v3_lp0>;
    };
```
