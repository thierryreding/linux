## Documentation/devicetree/bindings/sound/realtek,alc5632.yaml
```yaml
# SPDX-License-Identifier: GPL-2.0-only
%YAML 1.2
---
$id: http://devicetree.org/schemas/sound/realtek,alc5632.yaml#
$schema: http://devicetree.org/meta-schemas/core.yaml#

title: Realtek ALC5632 audio codec

maintainers:
  - Mark Brown <broonie@kernel.org>

description: |
  Pins on the device (for linking into audio routes):

    * SPK_OUTP
    * SPK_OUTN
    * HP_OUT_L
    * HP_OUT_R
    * AUX_OUT_P
    * AUX_OUT_N
    * LINE_IN_L
    * LINE_IN_R
    * PHONE_P
    * PHONE_N
    * MIC1_P
    * MIC1_N
    * MIC2_P
    * MIC2_N
    * MICBIAS1
    * DMICDAT

properties:
  compatible:
    const: realtek,alc5632

  reg:
    maxItems: 1

  # from ../gpio/gpio.yaml
  gpio-controller: true
  "#gpio-cells": true

additionalProperties: false

required:
  - compatible
  - reg
  - gpio-controller
  - "#gpio-cells"

examples:
  - |
    i2c {
      #address-cells = <1>;
      #size-cells = <0>;

      audio-codec@1a {
        compatible = "realtek,alc5632";
        reg = <0x1a>;

        gpio-controller;
        #gpio-cells = <2>;
      };
    };
```

## Documentation/devicetree/bindings/sound/realtek,rt5631.yaml
```yaml
# SPDX-License-Identifier: GPL-2.0-only
%YAML 1.2
---
$id: http://devicetree.org/schemas/sound/realtek,rt5631.yaml#
$schema: http://devicetree.org/meta-schemas/core.yaml#

title: Realtek ALC5631/RT5631 audio codec

maintainers:
  - Mark Brown <broonie@kernel.org>

description: |
  Pins on the device (for linking into audio routes):

    * SPK_OUT_R_P
    * SPK_OUT_R_N
    * SPK_OUT_L_P
    * SPK_OUT_L_N
    * HP_OUT_L
    * HP_OUT_R
    * AUX_OUT2_LP
    * AUX_OUT2_RN
    * AUX_OUT1_LP
    * AUX_OUT1_RN
    * AUX_IN_L_JD
    * AUX_IN_R_JD
    * MONO_IN_P
    * MONO_IN_N
    * MIC1_P
    * MIC1_N
    * MIC2_P
    * MIC2_N
    * MONO_OUT_P
    * MONO_OUT_N
    * MICBIAS1
    * MICBIAS2

properties:
  compatible:
    enum:
      - realtek,alc5631
      - realtek,rt5631

  reg:
    maxItems: 1

additionalProperties: false

required:
  - compatible
  - reg

examples:
  - |
    i2c {
      #address-cells = <1>;
      #size-cells = <0>;

      audio-codec@1a {
        compatible = "realtek,alc5631";
        reg = <0x1a>;
      };
    };

  - |
    i2c {
      #address-cells = <1>;
      #size-cells = <0>;

      audio-codec@1a {
        compatible = "realtek,rt5631";
        reg = <0x1a>;
      };
    };
```

## Documentation/devicetree/bindings/sound/realtek,rt5640.yaml
```yaml
# SPDX-License-Identifier: GPL-2.0-only
%YAML 1.2
---
$id: http://devicetree.org/schemas/sound/realtek,rt5640.yaml#
$schema: http://devicetree.org/meta-schemas/core.yaml#

title: Realtek RT5639/RT5640 audio codec

maintainers:
  - Mark Brown <broonie@kernel.org>

description: |
  Pins on the device (for linking into audio routes) for RT5639/RT5640:

    * DMIC1
    * DMIC2
    * MICBIAS1
    * IN1P
    * IN1N
    * IN2P
    * IN2N
    * IN3P
    * IN3N
    * HPOL
    * HPOR
    * LOUTL
    * LOUTR
    * SPOLP
    * SPOLN
    * SPORP
    * SPORN

  Additional pins on the device for RT5640:

    * MONOP
    * MONON

properties:
  compatible:
    enum:
      - realtek,rt5639
      - realtek,rt5640

  reg:
    maxItems: 1

  interrupts:
    maxItems: 1

  clocks:
    items:
      - description: phandle of the master clock to the codec

  clock-names:
    items:
      - const: mclk

  realtek,in1-differential:
    $ref: /schemas/types.yaml#/definitions/flag
    description: Indicates that the MIC1 input is differential, rather than single-ended.

  realtek,in2-differential:
    $ref: /schemas/types.yaml#/definitions/flag
    description: Indicates that the MIC2 input is differential, rather than single-ended.

  realtek,in3-differential:
    $ref: /schemas/types.yaml#/definitions/flag
    description: Indicates that the MIC3 input is differential, rather than single-ended.

  realtek,ldo1-en-gpios:
    description: The GPIO that controls the CODEC's LDO1_EN pin.

  realtek,dmic1-data-pin:
    $ref: /schemas/types.yaml#/definitions/uint32
    description: DMIC1 pin configuration
    oneOf:
      - description: dmic1 is not used
        const: 0
      - description: using IN1P pin as dmic1 data pin
        const: 1
      - description: using GPIO3 pin as dmic1 data pin
        const: 2

  realtek,dmic2-data-pin:
    $ref: /schemas/types.yaml#/definitions/uint32
    description: DMIC2 pin configuration
    oneOf:
      - description: dmic2 is not used
        const: 0
      - description: using IN1N pin as dmic2 data pin
        const: 1
      - description: using GPIO4 pin as dmic2 data pin
        const: 2

  realtek,jack-detect-source:
    $ref: /schemas/types.yaml#/definitions/uint32
    description: Jack detection source configuration
    oneOf:
      - description: No JD is used
        const: 0
      - description: using GPIO1 for jack-detect
        const: 1
      - description: using JD1_IN4P for jack-detect
        const: 2
      - description: using JD2_IN4N for jack-detect
        const: 3
      - description: using GPIO2 for jack-detect
        const: 4
      - description: using GPIO3 for jack-detect
        const: 5
      - description: using GPIO4 for jack-detect
        const: 6

  realtek,jack-detect-not-inverted:
    $ref: /schemas/types.yaml#/definitions/uint32
    description: Normal jack-detect switches give an inverted signal, set this bool in the rare
      case you've a jack-detect switch which is not inverted.

  realtek,over-current-threshold-microamp:
    description: micbias over-current detection threshold in µA
    enum: [ 600, 1500, 2000 ]

  realtek,over-current-scale-factor:
    $ref: /schemas/types.yaml#/definitions/uint32
    description: micbias over-current detection scale-factor
    oneOf:
      - description: scale current by 0.5
        const: 0
      - description: scale current by 0.75
        const: 1
      - description: scale current by 1.0
        const: 2
      - description: scale current by 1.5
        const: 3

additionalProperties: false

required:
  - compatible
  - reg

examples:
  - |
    #include <dt-bindings/gpio/tegra-gpio.h>
    #include <dt-bindings/interrupt-controller/irq.h>

    i2c {
      #address-cells = <1>;
      #size-cells = <0>;

      audio-codec@1c {
        compatible = "realtek,rt5640";
        reg = <0x1c>;
        interrupt-parent = <&gpio>;
        interrupts = <TEGRA_GPIO(W, 3) IRQ_TYPE_LEVEL_HIGH>;
        realtek,ldo1-en-gpios =
                <&gpio TEGRA_GPIO(V, 3) GPIO_ACTIVE_HIGH>;
      };
    };
```

## Documentation/devicetree/bindings/sound/realtek,rt5658.yaml
```yaml
# SPDX-License-Identifier: GPL-2.0-only
%YAML 1.2
---
$id: http://devicetree.org/schemas/sound/realtek,rt5658.yaml#
$schema: http://devicetree.org/meta-schemas/core.yaml#

title: RT5658/RT5659 audio codec

maintainers:
  - Bard Liao <bardliao@realtek.com>
  - Mark Brown <broonie@kernel.org>

description: |
  This device supports I2C only.

properties:
  compatible:
    enum:
      - realtek,rt5658
      - realtek,rt5659

  reg:
    maxItems: 1

  interrupts:
    maxItems: 1

  clocks:
    items:
      - description: codec master clock

  clock-names:
    items:
      - const: mclk

  realtek,in1-differential:
    description: Indicates that the MIC1 input is differential, rather than single-ended.
    $ref: /schemas/types.yaml#/definitions/flag

  realtek,in3-differential:
    description: Indicates that the MIC3 input is differential, rather than single-ended.
    $ref: /schemas/types.yaml#/definitions/flag

  realtek,in4-differential:
    description: Indicates that the MIC4 input is differential, rather than single-ended.
    $ref: /schemas/types.yaml#/definitions/flag

  realtek,dmic1-data-pin:
    description: DMIC1 pin configuration
    $ref: /schemas/types.yaml#/definitions/uint32
    oneOf:
      - description: dmic1 is not used
        const: 0
      - description: using IN2N pin as dmic1 data pin
        const: 1
      - description: using GPIO5 pin as dmic1 data pin
        const: 2
      - description: using GPIO9 pin as dmic1 data pin
        const: 3
      - description: using GPIO11 pin as dmic1 data pin
        const: 4

  realtek,dmic2-data-pin:
    description: DMIC2 pin configuration
    $ref: /schemas/types.yaml#/definitions/uint32
    oneOf:
      - description: dmic2 is not used
        const: 0
      - description: using IN2P pin as dmic2 data pin
        const: 1
      - description: using GPIO6 pin as dmic2 data pin
        const: 2
      - description: using GPIO10 pin as dmic2 data pin
        const: 3
      - description: using GPIO12 pin as dmic2 data pin
        const: 4

  realtek,jd-src:
    description: JD source configuration
    $ref: /schemas/types.yaml#/definitions/uint32
    oneOf:
      - description: No JD is used
        const: 0
      - description: using JD3 as JD source
        const: 1
      - description: JD source for Intel HDA header
        const: 2

  realtek,ldo1-en-gpios:
    description: The GPIO that controls the CODEC's LDO1_EN pin.

  realtek,reset-gpios:
    description: The GPIO that controls the CODEC's RESET pin.

  port:
    description: |
      A codec may have a single or multiple I2S interfaces. These interfaces on codec side can be
      described under 'ports' or 'port'. When the SoC or host device is connected to multiple
      interfaces of the codec, the connectivity can be described using 'ports' property. If a
      single interface is used, then 'port' can be used. The usage depends on the platform or
      board design. Please refer to Documentation/devicetree/bindings/graph.txt.

      Pins on the device (for linking into audio routes) for RT5658/RT5659:

        * DMIC L1
        * DMIC R1
        * DMIC L2
        * DMIC R2
        * IN1P
        * IN1N
        * IN2P
        * IN2N
        * IN3P
        * IN3N
        * IN4P
        * IN4N
        * HPOL
        * HPOR
        * SPOL
        * SPOR
        * LOUTL
        * LOUTR
        * MONOOUT
        * PDML
        * PDMR
        * SPDIF
    type: object

  # from name-prefix.yaml
  sound-name-prefix:
    description: Please refer to name-prefix.yaml

allOf:
  - $ref: name-prefix.yaml

additionalProperties: false

required:
  - compatible
  - reg
  - interrupts

examples:
  - |
    #include <dt-bindings/clock/tegra194-clock.h>
    #include <dt-bindings/gpio/tegra194-gpio.h>
    #include <dt-bindings/interrupt-controller/arm-gic.h>
    #include <dt-bindings/reset/tegra194-reset.h>

    i2c@c250000 {
      compatible = "nvidia,tegra194-i2c";
      reg = <0x0c250000 0x10000>;
      interrupts = <GIC_SPI 32 IRQ_TYPE_LEVEL_HIGH>;
      clocks = <&bpmp TEGRA194_CLK_I2C8>;
      clock-names = "div-clk";
      resets = <&bpmp TEGRA194_RESET_I2C8>;
      reset-names = "i2c";

      #address-cells = <1>;
      #size-cells = <0>;

      audio-codec@1a {
        compatible = "realtek,rt5658";
        reg = <0x1a>;
        interrupt-parent = <&gpio>;
        interrupts = <TEGRA194_MAIN_GPIO(S, 5) GPIO_ACTIVE_HIGH>;
        clocks = <&bpmp TEGRA194_CLK_AUD_MCLK>;
        clock-names = "mclk";
        realtek,jd-src = <2>;
        sound-name-prefix = "CVB-RT";

        port {
          endpoint {
            remote-endpoint = <&i2s1_dap_ep>;
            mclk-fs = <256>;
          };
        };
      };
    };
```

## Documentation/devicetree/bindings/sound/realtek,rt5677.yaml
```yaml
# SPDX-License-Identifier: GPL-2.0-only
%YAML 1.2
---
$id: http://devicetree.org/schemas/sound/realtek,rt5677.yaml#
$schema: http://devicetree.org/meta-schemas/core.yaml#

title: Realtek RT5677 audio codec

maintainers:
  - Mark Brown <broonie@kernel.org>

description: |
  This device supports I2C only. Pins on the device (for linking into audio routes):

    * IN1P
    * IN1N
    * IN2P
    * IN2N
    * MICBIAS1
    * DMIC1
    * DMIC2
    * DMIC3
    * DMIC4
    * LOUT1
    * LOUT2
    * LOUT3

properties:
  compatible:
    const: realtek,rt5677

  reg:
    maxItems: 1

  interrupts:
    maxItems: 1

  realtek,pow-ldo2-gpio:
    description: The GPIO that controls the CODEC's POW_LDO2 pin.

  realtek,reset-gpio:
    description: The GPIO that controls the CODEC's RESET pin. Active low.

  realtek,in1-differential:
    $ref: /schemas/types.yaml#/definitions/flag
    description: Indicates that the MIC1 input is differential, rather than single-ended.

  realtek,in2-differential:
    $ref: /schemas/types.yaml#/definitions/flag
    description: Indicates that the MIC2 input is differential, rather than single-ended.

  realtek,lout1-differential:
    $ref: /schemas/types.yaml#/definitions/flag
    description: Indicates that the LOUT1 output is differential, rather than single-ended.

  realtek,lout2-differential:
    $ref: /schemas/types.yaml#/definitions/flag
    description: Indicates that the LOUT1 output is differential, rather than single-ended.

  realtek,lout3-differential:
    $ref: /schemas/types.yaml#/definitions/flag
    description: Indicates that the LOUT1 output is differential, rather than single-ended.

  realtek,gpio-config:
    $ref: /schemas/types.yaml#/definitions/uint8-array
    description: Array of six 8-bit elements that configures GPIO.
    minItems: 6
    maxItems: 6
    items:
      oneOf:
        - description: floating (reset value)
          const: 0
        - description: pull down
          const: 1
        - description: pull up
          const: 2

  realtek,jd1-config:
    $ref: /schemas/types.yaml#/definitions/uint32
    description: Configures GPIO Mic Jack detection 1.
    oneOf:
      - description: off
        const: 0
      - description: GPIO1
        const: 1
      - description: GPIO2
        const: 2
      - description: GPIO3
        const: 3

  realtek,jd2-config:
    $ref: /schemas/types.yaml#/definitions/uint32
    description: Configures GPIO Mic Jack detection 2.
    oneOf:
      - description: off
        const: 0
      - description: GPIO4
        const: 1
      - description: GPIO5
        const: 2
      - description: GPIO6
        const: 3

  realtek,jd3-config:
    $ref: /schemas/types.yaml#/definitions/uint32
    description: Configures GPIO Mic Jack detection 2.
    oneOf:
      - description: off
        const: 0
      - description: GPIO4
        const: 1
      - description: GPIO5
        const: 2
      - description: GPIO6
        const: 3

allOf:
  - $ref: /schemas/gpio/gpio.yaml

unevaluatedProperties: false

required:
  - compatible
  - reg
  - interrupts
  - gpio-controller
  - "#gpio-cells"

examples:
  - |
    #include <dt-bindings/gpio/tegra-gpio.h>
    #include <dt-bindings/interrupt-controller/irq.h>

    i2c {
      #address-cells = <1>;
      #size-cells = <0>;

      audio-codec@2c {
        compatible = "realtek,rt5677";
        reg = <0x2c>;
        interrupt-parent = <&gpio>;
        interrupts = <TEGRA_GPIO(W, 3) IRQ_TYPE_LEVEL_HIGH>;

        gpio-controller;
        #gpio-cells = <2>;

        realtek,pow-ldo2-gpio = <&gpio TEGRA_GPIO(V, 3) GPIO_ACTIVE_HIGH>;
        realtek,reset-gpio = <&gpio TEGRA_GPIO(BB, 3) GPIO_ACTIVE_LOW>;
        realtek,in1-differential;
        realtek,gpio-config = /bits/ 8 <0 0 0 0 0 2>; /* pull up GPIO6 */
        realtek,jd2-config = <3>; /* Enables Jack detection for GPIO6 */
      };
    };
```
