## Documentation/devicetree/bindings/sound/ti,tlv320aic23.yaml
```yaml
# SPDX-License-Identifier: (GPL-2.0-only OR BSD-2-Clause)
%YAML 1.2
---
$id: http://devicetree.org/schemas/sound/ti,tlv320aic23.yaml#
$schema: http://devicetree.org/meta-schemas/core.yaml#

title: Texas Instruments TLV320AIC23 audio codec

maintainers:
  - Mark Brown <broonie@kernel.org>

description: |
  The TLV320AIC23 serial control bus communicates through both I2C and SPI bus protocols.

  CODEC output pins:
    * LHPOUT
    * RHPOUT
    * LOUT
    * ROUT

  CODEC input pins:
    * LLINEIN
    * RLINEIN
    * MICIN

  The pins can be used in referring sound node's audio-routing property.

properties:
  compatible:
    const: ti,tlv320aic23

  reg:
    maxItems: 1

additionalProperties: false

required:
  - compatible
  - reg

examples:
  - |
    i2c {
      #address-cells = <1>;
      #size-cells = <0>;

      audio-codec@1a {
        compatible = "ti,tlv320aic23";
        reg = <0x1a>;
      };
    };
```

## Documentation/devicetree/bindings/spi/nvidia,tegra114-spi.yaml
```yaml
# SPDX-License-Identifier: (GPL-2.0-only OR BSD-2-Clause)
%YAML 1.2
---
$id: http://devicetree.org/schemas/spi/nvidia,tegra114-spi.yaml#
$schema: http://devicetree.org/meta-schemas/core.yaml#

title: NVIDIA Tegra114 SPI controller

maintainers:
  - Thierry Reding <thierry.reding@gmail.com>
  - Jon Hunter <jonathanh@nvidia.com>

allOf:
  - $ref: "spi-controller.yaml"

properties:
  compatible:
    oneOf:
      - const: nvidia,tegra114-spi

      - items:
          - enum:
              - nvidia,tegra210-spi
              - nvidia,tegra124-spi
          - const: nvidia,tegra114-spi

  reg:
    maxItems: 1

  interrupts:
    maxItems: 1

  clocks:
    items:
      - description: SPI module clock

  clock-names:
    items:
      - const: spi

  resets:
    items:
      - description: SPI module reset

  reset-names:
    items:
      - const: spi

  dmas:
    items:
      - description: DMA channel for the reception FIFO
      - description: DMA channel for the transmission FIFO

  dma-names:
    items:
      - const: rx
      - const: tx

  spi-max-frequency:
    description: Maximum SPI clocking speed of the controller in Hz.
    $ref: /schemas/types.yaml#/definitions/uint32

  '#address-cells': true
  '#size-cells': true

patternProperties:
  "^.*@[0-9a-f]+$":
    type: object
    properties:
      nvidia,tx-clk-tap-delay:
        description: Delays the clock going out to the external device with
          this tap value. This property is used to tune the outgoing data from
          Tegra SPI master with respect to outgoing Tegra SPI master clock.
          Tap values vary based on the platform design trace lengths from
          Tegra SPI to corresponding slave devices.
        $ref: /schemas/types.yaml#/definitions/uint32
        minimum: 0
        maximum: 63

      nvidia,rx-clk-tap-delay:
        description: Delays the clock coming in from the external device with
          this tap value. This property is used to adjust the Tegra SPI master
          clock with respect to the data from the SPI slave device. Tap values
          vary based on the platform design trace lengths from Tegra SPI to
          corresponding slave devices.
        $ref: /schemas/types.yaml#/definitions/uint32
        minimum: 0
        maximum: 63

required:
  - compatible
  - reg
  - interrupts
  - clocks
  - clock-names
  - resets
  - reset-names
  - dmas
  - dma-names

additionalProperties: false

examples:
  - |
    spi@7000d600 {
        compatible = "nvidia,tegra114-spi";
        reg = <0x7000d600 0x200>;
        interrupts = <0 82 0x04>;
        clocks = <&tegra_car 44>;
        clock-names = "spi";
        resets = <&tegra_car 44>;
        reset-names = "spi";
        dmas = <&apbdma 16>, <&apbdma 16>;
        dma-names = "rx", "tx";

        spi-max-frequency = <25000000>;

        #address-cells = <1>;
        #size-cells = <0>;

        flash@0 {
            compatible = "spi-nor";
            reg = <0>;
            spi-max-frequency = <20000000>;
            nvidia,rx-clk-tap-delay = <0>;
            nvidia,tx-clk-tap-delay = <16>;
        };
    };
```

## Documentation/devicetree/bindings/timer/nvidia,tegra186-timer.yaml
```yaml
# SPDX-License-Identifier: (GPL-2.0-only OR BSD-2-Clause)
%YAML 1.2
---
$id: http://devicetree.org/schemas/timer/nvidia,tegra186-timer.yaml#
$schema: http://devicetree.org/meta-schemas/core.yaml#

title: NVIDIA Tegra186 timers

maintainers:
  - Thierry Reding <thierry.reding@gmail.com>
  - Jonathan Hunter <jonathanh@nvidia.com>

description: |
  The Tegra186 timer provides ten 29-bit timer counters and one 32-bit TSC
  (timestamp counter). The timers run at either a fixed 1 MHz clock rate
  derived from the oscillator clock. Each timer can be programmed to raise
  one-shot, periodic, or watchdog interrupts.

properties:
  compatible:
    oneOf:
      - description: NVIDIA Tegra186
        items:
          - const: nvidia,tegra186-timer

      - description: NVIDIA Tegra194
        items:
          - const: nvidia,tegra194-timer
          - const: nvidia,tegra186-timer

  reg:
    maxItems: 1

  interrupts:
    maxItems: 10

required:
  - compatible
  - reg
  - interrupts

additionalProperties: false

examples:
  - |
    #include <dt-bindings/interrupt-controller/arm-gic.h>

    timer@3010000 {
        compatible = "nvidia,tegra186-timer";
        reg = <0x03010000 0x000e0000>;
        interrupts = <GIC_SPI 0 IRQ_TYPE_LEVEL_HIGH>,
                     <GIC_SPI 1 IRQ_TYPE_LEVEL_HIGH>,
                     <GIC_SPI 2 IRQ_TYPE_LEVEL_HIGH>,
                     <GIC_SPI 3 IRQ_TYPE_LEVEL_HIGH>,
                     <GIC_SPI 4 IRQ_TYPE_LEVEL_HIGH>,
                     <GIC_SPI 5 IRQ_TYPE_LEVEL_HIGH>,
                     <GIC_SPI 6 IRQ_TYPE_LEVEL_HIGH>,
                     <GIC_SPI 7 IRQ_TYPE_LEVEL_HIGH>,
                     <GIC_SPI 8 IRQ_TYPE_LEVEL_HIGH>,
                     <GIC_SPI 9 IRQ_TYPE_LEVEL_HIGH>;
    };
```

## Documentation/devicetree/bindings/timer/nvidia,tegra20-timer.yaml
```yaml
# SPDX-License-Identifier: (GPL-2.0-only OR BSD-2-Clause)
%YAML 1.2
---
$id: http://devicetree.org/schemas/timer/nvidia,tegra20-timer.yaml#
$schema: http://devicetree.org/meta-schemas/core.yaml#

title: NVIDIA Tegra20 (and later) Timer

maintainers:
  - Thierry Reding <thierry.reding@gmail.com>
  - Jon Hunter <jonathanh@nvidia.com>

description: The Tegra20 timer provides four 29-bit timer channels and a single 32-bit free
  running counter. The first two channels may also trigger a watchdog reset.

  The timer found on Tegra30 provides ten 29-bit timer channels, a single 32-bit free running
  counter, and 5 watchdog modules. The first two channels may also trigger a legacy watchdog
  reset.

properties:
  compatible:
    oneOf:
      - items:
          - enum:
              - nvidia,tegra114-timer
              - nvidia,tegra124-timer
          - const: nvidia,tegra30-timer

      - items:
          - const: nvidia,tegra30-timer
          - const: nvidia,tegra20-timer

      - const: nvidia,tegra20-timer

  reg:
    maxItems: 1

  interrupts:
    minItems: 4
    maxItems: 6

  clocks:
    items:
      - description: module clock

  clock-names:
    items:
      - const: timer

allOf:
  - if:
      properties:
        compatible:
          contains:
            const: nvidia,tegra30-timer
    then:
      properties:
        interrupts:
          description: One interrupt per each of timer channels 1 through 5 and one shared
            interrupt for the remaining channels.
          minItems: 6
    else:
      properties:
        interrupts:
          description: One interrupt for each timer channel.
          maxItems: 4

additionalProperties: false

required:
  - compatible
  - reg
  - interrupts
  - clocks

examples:
  - |
    #include <dt-bindings/clock/tegra20-car.h>
    #include <dt-bindings/interrupt-controller/arm-gic.h>

    timer@60005000 {
        compatible = "nvidia,tegra20-timer";
        reg = <0x60005000 0x60>;
        interrupts = <GIC_SPI 0 IRQ_TYPE_LEVEL_HIGH>,
                     <GIC_SPI 1 IRQ_TYPE_LEVEL_HIGH>,
                     <GIC_SPI 41 IRQ_TYPE_LEVEL_HIGH>,
                     <GIC_SPI 42 IRQ_TYPE_LEVEL_HIGH>;
        clocks = <&tegra_car TEGRA20_CLK_TWD>;
    };

  - |
    #include <dt-bindings/clock/tegra30-car.h>
    #include <dt-bindings/interrupt-controller/arm-gic.h>

    timer@60005000 {
        compatible = "nvidia,tegra30-timer", "nvidia,tegra20-timer";
        reg = <0x60005000 0x400>;
        interrupts = <GIC_SPI 0   IRQ_TYPE_LEVEL_HIGH>,
                     <GIC_SPI 1   IRQ_TYPE_LEVEL_HIGH>,
                     <GIC_SPI 41  IRQ_TYPE_LEVEL_HIGH>,
                     <GIC_SPI 42  IRQ_TYPE_LEVEL_HIGH>,
                     <GIC_SPI 121 IRQ_TYPE_LEVEL_HIGH>,
                     <GIC_SPI 122 IRQ_TYPE_LEVEL_HIGH>;
        clocks = <&tegra_car TEGRA30_CLK_TWD>;
    };

  - |
    #include <dt-bindings/clock/tegra114-car.h>
    #include <dt-bindings/interrupt-controller/arm-gic.h>

    timer@60005000 {
      compatible = "nvidia,tegra114-timer", "nvidia,tegra30-timer";
      reg = <0x60005000 0x400>;
      interrupts = <GIC_SPI 0 IRQ_TYPE_LEVEL_HIGH>,
                   <GIC_SPI 1 IRQ_TYPE_LEVEL_HIGH>,
                   <GIC_SPI 41 IRQ_TYPE_LEVEL_HIGH>,
                   <GIC_SPI 42 IRQ_TYPE_LEVEL_HIGH>,
                   <GIC_SPI 121 IRQ_TYPE_LEVEL_HIGH>,
                   <GIC_SPI 122 IRQ_TYPE_LEVEL_HIGH>;
      clocks = <&tegra_car TEGRA114_CLK_TIMER>;
    };
```

## Documentation/devicetree/bindings/timer/nvidia,tegra210-timer.yaml
```yaml
# SPDX-License-Identifier: (GPL-2.0-only OR BSD-2-Clause)
%YAML 1.2
---
$id: http://devicetree.org/schemas/timer/nvidia,tegra210-timer.yaml#
$schema: http://devicetree.org/meta-schemas/core.yaml#

title: NVIDIA Tegra210 Timer

maintainers:
  - Thierry Reding <thierry.reding@gmail.com>
  - Jon Hunter <jonathanh@nvidia.com>

description: The Tegra210 timer provides fourteen 29-bit timer counters and one 32-bit timestamp
  counter. The TMRs run at either a fixed 1 MHz clock rate derived from the oscillator clock
  (TMR0-TMR9) or directly at the oscillator clock (TMR10-TMR13). Each TMR can be programmed to
  generate one-shot, periodic, or watchdog interrupts.

properties:
  compatible:
    const: nvidia,tegra210-timer

  reg:
    maxItems: 1

  interrupts:
    description: One interrupt per each timer channels 0 through 13.
    minItems: 14
    maxItems: 14

  clocks:
    items:
      - description: module clock

  clock-names:
    items:
      - const: timer

additionalProperties: false

required:
  - compatible
  - reg
  - interrupts
  - clocks

examples:
  - |
    #include <dt-bindings/clock/tegra210-car.h>
    #include <dt-bindings/interrupt-controller/arm-gic.h>

    timer@60005000 {
        compatible = "nvidia,tegra210-timer";
        reg = <0x60005000 0x400>;
        interrupts = <GIC_SPI 156 IRQ_TYPE_LEVEL_HIGH>,
                     <GIC_SPI 0 IRQ_TYPE_LEVEL_HIGH>,
                     <GIC_SPI 1 IRQ_TYPE_LEVEL_HIGH>,
                     <GIC_SPI 41 IRQ_TYPE_LEVEL_HIGH>,
                     <GIC_SPI 42 IRQ_TYPE_LEVEL_HIGH>,
                     <GIC_SPI 121 IRQ_TYPE_LEVEL_HIGH>,
                     <GIC_SPI 152 IRQ_TYPE_LEVEL_HIGH>,
                     <GIC_SPI 153 IRQ_TYPE_LEVEL_HIGH>,
                     <GIC_SPI 154 IRQ_TYPE_LEVEL_HIGH>,
                     <GIC_SPI 155 IRQ_TYPE_LEVEL_HIGH>,
                     <GIC_SPI 176 IRQ_TYPE_LEVEL_HIGH>,
                     <GIC_SPI 177 IRQ_TYPE_LEVEL_HIGH>,
                     <GIC_SPI 178 IRQ_TYPE_LEVEL_HIGH>,
                     <GIC_SPI 179 IRQ_TYPE_LEVEL_HIGH>;
        clocks = <&tegra_car TEGRA210_CLK_TIMER>;
        clock-names = "timer";
    };
```
