## Documentation/devicetree/bindings/usb/chipidea,usb2-core.yaml
```yaml
# SPDX-License-Identifier: GPL-2.0-only
%YAML 1.2
---
$id: "http://devicetree.org/schemas/usb/chipidea,usb2-core.yaml#"
$schema: "http://devicetree.org/meta-schemas/core.yaml#"

title: USB2 ChipIdea USB controller for ci13xxx

maintainers:
  - Peter Chen <peter.chen@freescale.com>

properties:
  reg:
    minItems: 1
    maxItems: 2

  interrupts:
    minItems: 1
    maxItems: 2

  clocks:
    minItems: 1
    maxItems: 3

  clock-names:
    minItems: 1
    maxItems: 3

  resets:
    maxItems: 1

  reset-names:
    maxItems: 1

  phys:
    items:
      - description: reference to the USB PHY

  phy-names:
    items:
      - const: usb-phy

  vbus-supply:
    description: reference to the VBUS regulator

  itc-setting:
    $ref: "/schemas/types.yaml#/definitions/uint32"
    description: Interrupt threshold control register control, the setting should be aligned with
      ITC bits at register USBCMD.

  ahb-burst-config:
    $ref: "/schemas/types.yaml#/definitions/uint32"
    description: This vendor-dependent property is used to change the AHB burst configuration and
      should be aligned with AHBBRST at SBUSCFG. See the ChipIdea specification for the details on
      each of those values. If this property does not exist, the reset value will be used.
    minimum: 0
    maximum: 7

  tx-burst-size-dword:
    description: This vendor-dependent property is used to configure the TX burst size (in 32-bit
      words). The value represents the maximum length of a burst while moving data from system
      memory to the USB bus. This property takes effect only if the "ahb-burst-config" property is
      set to 0. If this property is missing the reset default of the hardware implementation will
      be used.

  rx-burst-size-dword:
    description: This vendor-dependent property is used to configure the RX burst size (in 32-bit
      words). This value represents the maximum length of a burst while moving data from the USB
      bus to system memory. This property takes effect only if the "ahb-burst-config" property is
      set to 0. If this property is missing the reset default of the hardware implementation will
      be used.

  extcon:
    description: A list of phandles to external connector devices. The first phandle should point
      to the external connector which provides "USB" cable events. The second should point to the
      external connector device that provide "USB-HOST" cable events. If one of the external
      connector devices is not required, an empty phandle (0) should be specified.

  phy-clkgate-delay-us:
    description: The delay time (in microseconds) between putting the PHY into low power mode and
      gating the PHY clock.

  non-zero-ttctrl-ttha:
    description: |
      After setting this property, the value of register ttctrl.ttha will be 0x7f; if not, the
      value will be 0x0 (the default). The value for this property needs to be chosen very
      carefully after consulting with your IC engineer.

      On most ChipIdea platforms, the "usage_tt" flag at RTL is 0, so this property only affects
      siTD.

      If this property is not set, the maximum packet size is 1023 bytes, and if the total packet
      size for previous transactions is more than 256 bytes, no further transactions can be
      accepted within the frame. The use case is single transaction, but higher frame rate.

      If this property is set, the maximum packet size is limited to 188 bytes and more
      transactions than in the above case can be handled. Transactions will be accepted as long as
      188 bytes or more of space are left within a frame. Software needs to make sure it does not
      send more than 90% maximum_periodic_data_per_frame. The use case is higher amount of
      transactions at the cost of a lower frame rate.

  mux-controls:
    $ref: "/schemas/types.yaml#/definitions/phandle-array"
    description: The mux control for toggling host/device output of this controller. It's expected
      that a mux state of 0 indicates device mode and a mux state of 1 indicates host mode.

  mux-control-names:
    const: usb_switch

  pinctrl-names:
    description: In case of HSIC-mode, "idle" and "active" pin modes are mandatory. In this case,
      the "idle" state needs to pull down the data and strobe pin and the "active" state needs to
      pull up the strobe pin.
    minItems: 1
    maxItems: 5
    items:
      enum:
        - default
        - host
        - device
        - idle # mandatory for HSIC
        - active # mandatory for HSIC

  # i.MX specific properties
  fsl,usbmisc:
    $ref: "/schemas/types.yaml#/definitions/phandle-array"
    description: phandle to non-core register device, with one argument that indicate USB
      controller index.

  disable-over-current:
    $ref: "/schemas/types.yaml#/definitions/flag"
    description: disable over current detect

  over-current-active-low:
    $ref: "/schemas/types.yaml#/definitions/flag"
    description: Over-current signal polarity is active low. It's recommended to specify the
      over-current polarity.

  over-current-active-high:
    $ref: "/schemas/types.yaml#/definitions/flag"
    description: Over-current signal polarity is active high. It's recommended to specify the
      over-current polarity.

  power-active-high:
    $ref: "/schemas/types.yaml#/definitions/flag"
    description: power signal polarity is active high

  external-vbus-divider:
    $ref: "/schemas/types.yaml#/definitions/flag"
    description: enables off-chip resistor divider for Vbus

  samsung,picophy-pre-emp-curr-control:
    $ref: "/schemas/types.yaml#/definitions/uint32"
    description: HS Transmitter Pre-Emphasis Current Control. This signal controls the amount of
      current sourced to the USB_OTG*_DP and USB_OTG*_DN pins after a J-to-K or K-to-J transition.
      Refer to the TXPREEMPAMPTUNE0 bits of register USBNC_n_PHY_CFG1 in the documentation for
      more details.
    minimum: 0
    maximum: 3
    default: 1

  samsung,picophy-dc-vol-level-adjust:
    $ref: "/schemas/types.yaml#/definitions/uint32"
    description: HS DC Voltage Level Adjustment. Adjust the high-speed transmitter DC level
      voltage. Refer to the TXVREFTUNE0 bits of register USBNC_n_PHY_CFG1 in the documentation for
      more details.
    minimum: 0
    maximum: 0xf
    default: 3

  # NVIDIA Tegra specific properties
  nvidia,needs-double-reset:
    $ref: "/schemas/types.yaml#/definitions/flag"
    description: Specifies a workaround for the USB1 port that needs to be reset twice internally
      some Tegra devices.

  # deprecated properties
  fsl,usbphy:
    $ref: "/schemas/types.yaml#/definitions/phandle"
    description: phandle of usb phy that connects to the port. Use "phys" instead.
    deprecated: true

  nvidia,phy:
    $ref: "/schemas/types.yaml#/definitions/phandle"
    description: phandle for the PHY device. Use "phys" instead.
    deprecated: true

allOf:
  - $ref: usb-drd.yaml
  - $ref: usb-hcd.yaml

additionalProperties: true

required:
  - compatible
  - reg
  - interrupts

dependencies:
  mux-control-names: [ mux-controls ]
```
