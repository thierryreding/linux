## Documentation/devicetree/bindings/sound/nuvoton,nau8825.yaml
```yaml
# SPDX-License-Identifier: GPL-2.0-only
%YAML 1.2
---
$id: http://devicetree.org/schemas/sound/nuvoton,nau8825.yaml#
$schema: http://devicetree.org/meta-schemas/core.yaml#

title: Nuvoton NAU8825 audio codec

maintainers:
  - Anatol Pomozov <anatol.pomozov@gmail.com>
  - Mark Brown <broonie@kernel.org>

description: |
  This device supports I2C only.

properties:
  compatible:
    const: nuvoton,nau8825

  reg:
    # 0x1a for CSB = 0, 0x1b for CSB = 1
    maxItems: 1

  interrupts:
    maxItems: 1

  clocks:
    items:
      - description: MCLK master clock

  clock-names:
    items:
      - const: mclk

  nuvoton,jkdet-enable:
    $ref: /schemas/types.yaml#/definitions/flag
    description: Enable jack detection via JKDET pin.

  nuvoton,jkdet-pull-enable:
    $ref: /schemas/types.yaml#/definitions/flag
    description: Enable JKDET pin pull. If set, pin pull is enabled, otherwise pin is in high
      impedance state.

  nuvoton,jkdet-pull-up:
    $ref: /schemas/types.yaml#/definitions/flag
    description: Pull-up JKDET pin. If set then JKDET pin is pull up, otherwise pull down.

  nuvoton,jkdet-polarity:
    $ref: /schemas/types.yaml#/definitions/uint32
    description: JKDET pin polarity
    oneOf:
      - description: active-high
        const: 0
      - description: active-low
        const: 1

  nuvoton,vref-impedance:
    $ref: /schemas/types.yaml#/definitions/uint32
    description: VREF impedance selection
    oneOf:
      - description: open
        const: 0
      - description: 25 kOhm
        const: 1
      - description: 125 kOhm
        const: 2
      - description: 2.5 kOhm
        const: 3

  nuvoton,micbias-voltage:
    $ref: /schemas/types.yaml#/definitions/uint32
    description: Micbias voltage level
    oneOf:
      - description: VDDA
        const: 0
      - description: VDDA
        const: 1
      - description: VDDA * 1.1
        const: 2
      - description: VDDA * 1.2
        const: 3
      - description: VDDA * 1.3
        const: 4
      - description: VDDA * 1.4
        const: 5
      - description: VDDA * 1.53
        const: 6
      - description: VDDA * 1.53
        const: 7

  nuvoton,sar-threshold-num:
    $ref: /schemas/types.yaml#/definitions/uint32
    description: number of buttons supported

  nuvoton,sar-threshold:
    $ref: /schemas/types.yaml#/definitions/uint32-array
    minItems: 1
    maxItems: 8
    description: |
      Impedance threshold for each button. Array that contains up to 8 buttons configuration. SAR
      value is calculated as

        SAR = 255 * MICBIAS / SAR_VOLTAGE * R / (2000 + R)

      where MICBIAS is configured by 'nuvoton,micbias-voltage', SAR_VOLTAGE is configured by
      'nuvoton,sar-voltage', R - button impedance.

      Refer datasheet section 10.2 for more information about threshold calculation.

  nuvoton,sar-hysteresis:
    $ref: /schemas/types.yaml#/definitions/uint32
    description: button impedance measurement hysteresis

  nuvoton,sar-voltage:
    $ref: /schemas/types.yaml#/definitions/uint32
    description: reference voltage for button impedance measurement
    oneOf:
      - description: VDDA
        const: 0
      - description: VDDA
        const: 1
      - description: VDDA * 1.1
        const: 2
      - description: VDDA * 1.2
        const: 3
      - description: VDDA * 1.3
        const: 4
      - description: VDDA * 1.4
        const: 5
      - description: VDDA * 1.53
        const: 6
      - description: VDDA * 1.53
        const: 7

  nuvoton,sar-compare-time:
    $ref: /schemas/types.yaml#/definitions/uint32
    description: SAR compare time
    oneOf:
      - description: 500 ns
        const: 0
      - description: 1 us
        const: 1
      - description: 2 us
        const: 2
      - description: 4 us
        const: 3

  nuvoton,sar-sampling-time:
    $ref: /schemas/types.yaml#/definitions/uint32
    description: SAR sampling time
    oneOf:
      - description: 2 us
        const: 0
      - description: 4 us
        const: 1
      - description: 8 us
        const: 2
      - description: 16 us
        const: 3

  nuvoton,short-key-debounce:
    $ref: /schemas/types.yaml#/definitions/uint32
    description: button short key press debounce time
    oneOf:
      - description: 30 ms
        const: 0
      - description: 50 ms
        const: 1
      - description: 100 ms
        const: 2
      - description: 30 ms
        const: 3

  nuvoton,jack-insert-debounce:
    $ref: /schemas/types.yaml#/definitions/uint32
    description: number from 0 to 7 that sets debounce time to 2^(n+2) ms
    minimum: 0
    maximum: 7

  nuvoton,jack-eject-debounce:
    $ref: /schemas/types.yaml#/definitions/uint32
    description: number from 0 to 7 that sets debounce time to 2^(n+2) ms
    minimum: 0
    maximum: 7

  nuvoton,crosstalk-enable:
    description: If set, enables crosstalk function.
    $ref: /schemas/types.yaml#/definitions/flag

  nuvoton,adcout-drive-strong:
    description: If set, makes the drive strength of ADCOUT I/O pin strong.
      Otherwise, keep the drive strength at normal level.
    $ref: /schemas/types.yaml#/definitions/flag

additionalProperties: false

required:
  - compatible
  - reg

examples:
  - |
    #include <dt-bindings/gpio/tegra-gpio.h>
    #include <dt-bindings/interrupt-controller/irq.h>
    #include <dt-bindings/soc/tegra-pmc.h>

    i2c {
      #address-cells = <1>;
      #size-cells = <0>;

      audio-codec@1a {
        compatible = "nuvoton,nau8825";
        reg = <0x1a>;
        interrupt-parent = <&gpio>;
        interrupts = <TEGRA_GPIO(E, 6) IRQ_TYPE_LEVEL_LOW>;
        nuvoton,jkdet-enable;
        nuvoton,jkdet-pull-enable;
        nuvoton,jkdet-pull-up;
        nuvoton,jkdet-polarity = <GPIO_ACTIVE_LOW>;
        nuvoton,vref-impedance = <2>;
        nuvoton,micbias-voltage = <6>;
        // Setup 4 buttons impedance according to Android specification
        nuvoton,sar-threshold-num = <4>;
        nuvoton,sar-threshold = <0xc 0x1e 0x38 0x60>;
        nuvoton,sar-hysteresis = <1>;
        nuvoton,sar-voltage = <0>;
        nuvoton,sar-compare-time = <0>;
        nuvoton,sar-sampling-time = <0>;
        nuvoton,short-key-debounce = <2>;
        nuvoton,jack-insert-debounce = <7>;
        nuvoton,jack-eject-debounce = <7>;
        nuvoton,crosstalk-enable;

        clock-names = "mclk";
        clocks = <&tegra_pmc TEGRA_PMC_CLK_OUT_2>;
      };
    };
```

## Documentation/devicetree/bindings/sound/nvidia,tegra20-ac97.yaml
```yaml
# SPDX-License-Identifier: (GPL-2.0+ OR BSD-2-Clause)
%YAML 1.2
---
$id: http://devicetree.org/schemas/sound/nvidia,tegra20-ac97.yaml#
$schema: http://devicetree.org/meta-schemas/core.yaml#

title: NVIDIA Tegra20 (and later) AC97 controller

maintainers:
  - Thierry Reding <thierry.reding@gmail.com>
  - Jon Hunter <jonathanh@nvidia.com>

properties:
  compatible:
    enum:
      - nvidia,tegra20-ac97

  reg:
    maxItems: 1

  interrupts:
    maxItems: 1

  clocks:
    items:
      - description: module clock

  resets:
    items:
      - description: module reset

  reset-names:
    items:
      - const: ac97

  dmas:
    items:
      - description: reception DMA channel
      - description: transmission DMA channel

  dma-names:
    items:
      - const: rx
      - const: tx

  nvidia,codec-reset-gpio:
    description: Reference to the GPIO used to reset the external AC97 codec.

  nvidia,codec-sync-gpio:
    description: Reference to the GPIO connected to the AC97 DAP _FS line.

additionalProperties: false

required:
  - compatible
  - reg
  - interrupts
  - clocks
  - resets
  - reset-names
  - dmas
  - dma-names
  - nvidia,codec-reset-gpio
  - nvidia,codec-sync-gpio

examples:
  - |
    #include <dt-bindings/clock/tegra20-car.h>
    #include <dt-bindings/gpio/tegra-gpio.h>
    #include <dt-bindings/interrupt-controller/arm-gic.h>

    ac97@70002000 {
        compatible = "nvidia,tegra20-ac97";
        reg = <0x70002000 0x200>;
        interrupts = <GIC_SPI 81 IRQ_TYPE_LEVEL_HIGH>;
        clocks = <&tegra_car TEGRA20_CLK_AC97>;
        resets = <&tegra_car 3>;
        reset-names = "ac97";
        dmas = <&apbdma 12>, <&apbdma 12>;
        dma-names = "rx", "tx";
        nvidia,codec-reset-gpio = <&gpio TEGRA_GPIO(V, 0) GPIO_ACTIVE_HIGH>;
        nvidia,codec-sync-gpio = <&gpio TEGRA_GPIO(P, 0) GPIO_ACTIVE_HIGH>;
    };
```

## Documentation/devicetree/bindings/sound/nvidia,tegra234-hdacodec.yaml
```yaml
# SPDX-License-Identifier: (GPL-2.0-only OR BSD-2-Clause)
%YAML 1.2
---
$id: http://devicetree.org/schemas/sound/nvidia,tegra234-hdacodec.yaml#
$schema: http://devicetree.org/meta-schemas/core.yaml#

title: NVIDIA Tegra234 HDA Codec

description: |
  The HDA codec is used to control various aspects of HDA audio output.

maintainers:
  - Thierry Reding <thierry.reding@gmail.com>
  - Jonathan Hunter <jonathanh@nvidia.com>

properties:
  $nodename:
    pattern: "^codec@[0-9a-f]*$"

  compatible:
    enum:
      - nvidia,tegra234-hdacodec

  reg:
    maxItems: 1

  interrupts:
    maxItems: 1

  clocks:
    maxItems: 2

  clock-names:
    items:
      - const: 2x-bit
      - const: bit

additionalProperties: false

required:
  - compatible
  - reg
  - interrupts
  - clocks
  - clock-names

examples:
  - |
    #include <dt-bindings/clock/tegra234-clock.h>
    #include <dt-bindings/interrupt-controller/arm-gic.h>

    codec@242c000 {
        compatible = "nvidia,tegra234-hdacodec";
        reg = <0x242c000 0x1000>;
        interrupts = <GIC_SPI 61 IRQ_TYPE_LEVEL_HIGH>;
        clocks = <&bpmp TEGRA234_CLK_AZA_2XBIT>,
                 <&bpmp TEGRA234_CLK_AZA_BIT>;
        clock-names = "2x-bit", "bit";
    };
...
```

## Documentation/devicetree/bindings/sound/nvidia,tegra30-hda.yaml
```yaml
# SPDX-License-Identifier: (GPL-2.0-only OR BSD-2-Clause)
%YAML 1.2
---
$id: http://devicetree.org/schemas/sound/nvidia,tegra30-hda.yaml#
$schema: http://devicetree.org/meta-schemas/core.yaml#

title: NVIDIA Tegra30 HDA controller

maintainers:
  - Thierry Reding <thierry.reding@nvidia.com>
  - Jon Hunter <jonathanh@nvidia.com>

properties:
  compatible:
    oneOf:
      - description: NVIDIA Tegra30
        const: nvidia,tegra30-hda

      - description: NVIDIA Tegra114
        items:
          - const: nvidia,tegra114-hda
          - const: nvidia,tegra30-hda

      - description: NVIDIA Tegra124
        items:
          - const: nvidia,tegra124-hda
          - const: nvidia,tegra30-hda

      - description: NVIDIA Tegra132
        items:
          - const: nvidia,tegra132-hda
          - const: nvidia,tegra124-hda
          - const: nvidia,tegra30-hda

      - description: NVIDIA Tegra210
        items:
          - const: nvidia,tegra210-hda
          - const: nvidia,tegra30-hda

      - description: NVIDIA Tegra186
        items:
          - const: nvidia,tegra186-hda
          - const: nvidia,tegra30-hda

      - description: NVIDIA Tegra194
        items:
          - const: nvidia,tegra194-hda
          - const: nvidia,tegra30-hda

  reg:
    description: base address and size of the register region for the HDA
      controller

  interrupts:
    description: interrupt from the HDA controller

  clocks:
    items:
      - description: The main HDA controller clock
      - description: The clock for the logic feeding data from HDA to HDMI.
      - description: The clock for the logic feeding data from HDA to codec.

  clock-names:
    contains:
      enum:
        - hda
        - hda2hdmi
        - hda2codec_2x

  resets:
    items:
      - description: Reset for the HDA controller.
      - description: Reset for the HDA to HDMI logic.
      - description: Reset for the HDA to codec logic.

  reset-names:
    contains:
      enum:
        - hda
        - hda2hdmi
        - hda2codec_2x

  interconnects:
    description: Description of the interconnect paths for the HDA controller;
      see ../interconnect/interconnect.txt for details.
    $ref: /schemas/types.yaml#/definitions/phandle-array

  interconnect-names:
    description: A list of names identifying each entry listed in the
      "interconnects" property.
    $ref: /schemas/types.yaml#/definitions/non-unique-string-array

  nvidia,model:
    description: The user-visible name of this sound complex. Since the
      property is optional, legacy boards can use default name provided in HDA
      driver.
    $ref: /schemas/types.yaml#/definitions/string

required:
  - compatible
  - reg
  - interrupts
  - clocks
  - clock-names
  - resets
  - reset-names

examples:
  - |
    #include <dt-bindings/interrupt-controller/arm-gic.h>
    #include <dt-bindings/clock/tegra124-car.h>

    hda@70030000 {
        compatible = "nvidia,tegra124-hda", "nvidia,tegra30-hda";
        reg = <0x0 0x70030000 0x0 0x10000>;
        interrupts = <GIC_SPI 81 IRQ_TYPE_LEVEL_HIGH>;
        clocks = <&tegra_car TEGRA124_CLK_HDA>,
                 <&tegra_car TEGRA124_CLK_HDA2HDMI>,
                 <&tegra_car TEGRA124_CLK_HDA2CODEC_2X>;
        clock-names = "hda", "hda2hdmi", "hda2codec_2x";
        resets = <&tegra_car 125>, /* hda */
                 <&tegra_car 128>, /* hda2hdmi */
                 <&tegra_car 111>; /* hda2codec_2x */
        reset-names = "hda", "hda2hdmi", "hda2codec_2x";
        nvidia,model = "jetson-tk1-hda";
    };
```

## Documentation/devicetree/bindings/sound/nvidia,tegra30-i2s.yaml
```yaml
# SPDX-License-Identifier: (GPL-2.0-only OR BSD-2-Clause)
%YAML 1.2
---
$id: http://devicetree.org/schemas/sound/nvidia,tegra30-i2s.yaml#
$schema: http://devicetree.org/meta-schemas/core.yaml#

title: NVIDIA Tegra30 (and later) I2S Controller

maintainers:
  - Thierry Reding <thierry.reding@gmail.com>
  - Jon Hunter <jonathanh@nvidia.com>

properties:
  $nodename:
    pattern: "^i2s@[0-9a-f]*"

  compatible:
    oneOf:
      - const: nvidia,tegra30-i2s

      - items:
          - const: nvidia,tegra114-i2s
          - const: nvidia,tegra30-i2s

      - const: nvidia,tegra124-i2s

      - items:
          - const: nvidia,tegra132-i2s
          - const: nvidia,tegra124-i2s

  reg:
    maxItems: 1

  clocks:
    items:
      - description: module clock

  clock-names:
    items:
      - const: i2s

  resets:
    items:
      - description: module reset

  reset-names:
    items:
      - const: i2s

  nvidia,ahub-cif-ids:
    description: The list of AHUB CIF IDs for this port, RX (playback) first, TX (capture) second.
      See nvidia,tegra30-ahub.yaml for a list of valid values.
    $ref: /schemas/types.yaml#/definitions/uint32-array
    minItems: 2
    maxItems: 2

additionalProperties: false

required:
  - compatible
  - reg
  - clocks
  - resets
  - reset-names
  - nvidia,ahub-cif-ids

examples:
  - |
    #include <dt-bindings/clock/tegra30-car.h>

    i2s@70080300 {
        compatible = "nvidia,tegra30-i2s";
        reg = <0x70080300 0x100>;
        clocks = <&tegra_car TEGRA30_CLK_I2S0>;
        resets = <&tegra_car 11>;
        reset-names = "i2s";
        nvidia,ahub-cif-ids = <4 4>;
    };
```
