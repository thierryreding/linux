## Documentation/devicetree/bindings/interrupt-controller/nvidia,tegra20-ictlr.txt
```
NVIDIA Tegra Legacy Interrupt Controller

The legacy interrupt controller serves as the primary interrupt controller for
the AVP coprocessor. It also forwards interrupts to the GIC for redistribution
to the CPUs. Interrupts can be configured as wakeup sources within this legacy
interrupt controller.

The legacy interrupt controller is divided into identical units that serve 32
interrupts each. A different number of units are implemented in different SoC
generations:

  - Tegra20 implements four units.
  - Tegra30, Tegra114, Tegra148, Tegra124 and Tegra132 implement five units.
  - Tegra210 implements six units.

Required properties:
- compatible: Should be: "nvidia,tegra<chip>-ictlr". For Tegra114, Tegra148,
  Tegra124 and Tegra132 the LIC is backwards-compatible with Tegra30, and so
  the compatible value should include "nvidia,tegra30-ictlr".
- reg: Physical base address and length of the controller's registers. There
  should be one entry for each unit. See above for the number of implemented
  units for the different SoC generations.
- interrupt-controller: Identifies the node as an interrupt controller.
- #interrupt-cells: Specifies the number of cells required to describe an
  interrupt source. Since the LIC ultimately forwards interrupts to the GIC,
  the interrupt specifier must be that of the GIC.
- interrupt-parent: A phandle to the GIC that the LIC forwards interrupts to
  for redistribution to the CPUs.

Notes:
- Since only SPIs are routed through the LIC, SGIs and PPIs are explicitly
  disallowed.

Example:

	interrupt-controller@60004000 {
		compatible = "nvidia,tegra20-ictlr";
		reg = <0x60004000 0x40>, /* primary controller */
		      <0x60004100 0x40>, /* secondary controller */
		      <0x60004200 0x40>, /* tertiary controller */
		      <0x60004300 0x40>; /* quaternary controller */
		interrupt-parent = <&gic>;
		#interrupt-cells = <3>;
		interrupt-controller;
	};
```

## Documentation/devicetree/bindings/interrupt-controller/nvidia,tegra20-ictlr.yaml
```yaml
# SPDX-License-Identifier: (GPL-2.0-only OR BSD-2-Clause)
%YAML 1.2
---
$id: http://devicetree.org/schemas/interrupt-controller/nvidia,tegra20-ictlr.yaml#
$schema: http://devicetree.org/meta-schemas/core.yaml#

title: NVIDIA Tegra Legacy Interrupt Controller

maintainers:
  - Thierry Reding <thierry.reding@gmail.com>
  - Jon Hunter <jonathanh@nvidia.com>

description: |
  All Tegra SoCs contain a legacy interrupt controller that routes interrupts to the GIC, and also
  serves as a wakeup source. It is also referred to as "ictlr", hence the name of the binding.

  The HW block exposes a number of interrupt controllers, each implementing a set of 32 interrupts.

  Because this HW ultimately routes interrupts to the GIC, the interrupt specifier must be that of
  the GIC. Only SPIs can use the ictlr as an interrupt parent. SGIs and PPIs are explicitly
  forbidden.

properties:
  compatible:
    oneOf:
      - const: nvidia,tegra20-ictlr

      - const: nvidia,tegra30-ictlr

      - items:
          - enum:
              - nvidia,tegra114-ictlr
              - nvidia,tegra124-ictlr
          - const: nvidia,tegra30-ictlr

      - const: nvidia,tegra210-ictlr

  reg:
    minItems: 4 # Tegra20
    maxItems: 6 # Tegra210

  # from interrupt-controller.yaml
  interrupt-controller: true
  "#interrupt-cells": true

allOf:
  - $ref: /schemas/interrupt-controller.yaml#
  - if:
      properties:
        compatible:
          const: nvidia,tegra20-ictlr
    then:
      properties:
        reg:
          minItems: 4
          maxItems: 4

  - if:
      properties:
        compatible:
          contains:
            const: nvidia,tegra30-ictlr
    then:
      properties:
        reg:
          minItems: 5
          maxItems: 5

  - if:
      properties:
        compatible:
          contains:
            const: nvidia,tegra210-ictlr
    then:
      properties:
        reg:
          minItems: 6
          maxItems: 6

additionalProperties: false

examples:
  - |
    interrupt-controller@60004000 {
        compatible = "nvidia,tegra20-ictlr";
        reg = <0x60004000 64>,
              <0x60004100 64>,
              <0x60004200 64>,
              <0x60004300 64>;
        interrupt-controller;
        #interrupt-cells = <3>;
        interrupt-parent = <&intc>;
    };
```

## Documentation/devicetree/bindings/media/cec-gpio.yaml
```yaml
# SPDX-License-Identifier: GPL-2.0-only
%YAML 1.2
---
$id: http://devicetree.org/schemas/media/cec-gpio.yaml#
$schema: http://devicetree.org/meta-schemas/core.yaml#

title: HDMI CEC GPIO driver

maintainers:
  - Hans Verkuil <hverkuil@xs4all.nl>

description: |
  The HDMI CEC GPIO module supports CEC implementations where the CEC line is hooked up to a pull-
  up GPIO line and - optionally - the HPD line is hooked up to another GPIO line.

  Please note: the maximum voltage for the CEC line is 3.63V, for the HPD and 5V lines it is 5.3V.
  So you may need some sort of level conversion circuitry when connecting them to a GPIO line.

properties:
  compatible:
    const: cec-gpio

  cec-gpios:
    description: Reference to the GPIO that the CEC line is connected to. The line should be
      tagged as open drain.

  hpd-gpios:
    description: Reference to the GPIO that the HPD is connected to. This property is optional and
      can be used for debugging HPD changes.

  v5-gpios:
    description: Reference to the GPIO that the 5V line is connected to. This property is optional
      and can be used for debugging changes on the 5V line.

  # from cec.yaml
  hdmi-phandle: true

allOf:
  - $ref: cec.yaml

required:
  - compatible
  - cec-gpios

additionalProperties: false

examples:
  # Example for the Raspberry Pi 3 where the CEC line is connected to pin 26 aka BCM7 aka CE1 on
  # the GPIO pin header, the HPD line is connected to pin 11 aka BCM17 and the 5V line is
  # connected to pin 15 aka BCM22 (some level shifter is needed for the HPD and 5V lines!)
  - |
    #include <dt-bindings/gpio/gpio.h>

    cec {
        compatible = "cec-gpio";
        cec-gpios = <&gpio 7 (GPIO_ACTIVE_HIGH|GPIO_OPEN_DRAIN)>;
        hpd-gpios = <&gpio 17 GPIO_ACTIVE_HIGH>;
        v5-gpios = <&gpio 22 GPIO_ACTIVE_HIGH>;
    };
```

## Documentation/devicetree/bindings/media/cec.yaml
```yaml
# SPDX-License-Identifier: GPL-2.0-only
%YAML 1.2
---
$id: http://devicetree.org/schemas/media/cec.yaml#
$schema: http://devicetree.org/meta-schemas/core.yaml#

title: Common bindings for HDMI CEC adapters

maintainers:
  - Hans Verkuil <hverkuil@xs4all.nl>

properties:
  $nodename:
    pattern: "^cec(@.*)?$"

  hdmi-phandle:
    description: phandle to the HDMI controller
    $ref: /schemas/types.yaml#/definitions/phandle

  needs-hpd:
    description: If present the CEC support is only available when the HPD is high. Some boards
      only let the CEC pin through if the HPD is high, for example if there is a level converter
      that uses the HPD to power up or down.
    $ref: /schemas/types.yaml#/definitions/flag

additionalProperties: true
```

## Documentation/devicetree/bindings/media/nvidia,tegra114-cec.yaml
```yaml
# SPDX-License-Identifier: (GPL-2.0-only OR BSD-2-Clause)
%YAML 1.2
---
$id: http://devicetree.org/schemas/media/nvidia,tegra114-cec.yaml#
$schema: http://devicetree.org/meta-schemas/core.yaml#

title: NVIDIA Tegra114 (and later) HDMI CEC Controller

maintainers:
  - Thierry Reding <thierry.reding@gmail.com>
  - Jon Hunter <jonathanh@nvidia.com>

description:
  The HDMI CEC module is present in Tegra SoCs and its purpose is to handle communication between
  HDMI connected devices over the CEC bus.

properties:
  compatible:
    enum:
      - nvidia,tegra114-cec
      - nvidia,tegra124-cec
      - nvidia,tegra210-cec
      - nvidia,tegra186-cec
      - nvidia,tegra194-cec

  reg:
    maxItems: 1

  interrupts:
    maxItems: 1

  clocks:
    items:
      - description: module clock

  clock-names:
    items:
      - const: cec

  hdmi-phandle: true

additionalProperties: false

required:
  - compatible
  - reg
  - interrupts
  - clocks
  - clock-names
  - hdmi-phandle

allOf:
  - $ref: cec.yaml

examples:
  - |
    #include <dt-bindings/clock/tegra124-car.h>
    #include <dt-bindings/interrupt-controller/arm-gic.h>

    cec@70015000 {
        compatible = "nvidia,tegra124-cec";
        reg = <0x70015000 0x00001000>;
        interrupts = <GIC_SPI 3 IRQ_TYPE_LEVEL_HIGH>;
        clocks = <&tegra_car TEGRA124_CLK_CEC>;
        clock-names = "cec";
        hdmi-phandle = <&hdmi>;
    };
```

## Documentation/devicetree/bindings/media/nvidia,tegra20-vde.yaml
```yaml
# SPDX-License-Identifier: (GPL-2.0-only OR BSD-2-Clause)
%YAML 1.2
---
$id: http://devicetree.org/schemas/media/nvidia,tegra20-vde.yaml#
$schema: http://devicetree.org/meta-schemas/core.yaml#

title: NVIDIA Tegra Video Decoder Engine

maintainers:
  - Thierry Reding <thierry.reding@gmail.com>
  - Jon Hunter <jonathanh@nvidia.com>
  - Dmitry Osipenko <digetx@gmail.com>

properties:
  compatible:
    oneOf:
      - const: nvidia,tegra20-vde

      - items:
          - const: nvidia,tegra30-vde
          - const: nvidia,tegra20-vde

      - const: nvidia,tegra114-vde

      - items:
          - const: nvidia,tegra124-vde
          - const: nvidia,tegra114-vde

      - items:
          - const: nvidia,tegra132-vde
          - const: nvidia,tegra124-vde
          - const: nvidia,tegra114-vde

  reg:
    minItems: 9
    maxItems: 9

  reg-names:
    items:
      - const: sxe
      - const: bsev
      - const: mbe
      - const: ppe
      - const: mce
      - const: tfe
      - const: ppb
      - const: vdma
      - const: frameid

  interrupts:
    maxItems: 3

  interrupt-names:
    items:
      - const: sync-token
      - const: bsev
      - const: sxe

  clocks:
    items:
      - description: module clock

  clock-names:
    items:
      - const: vde

  resets:
    items:
      - description: module reset
      - description: memory controller hotflush reset

  reset-names:
    items:
      - const: vde
      - const: mc

  iommus:
    maxItems: 1

  operating-points-v2:
    $ref: "/schemas/types.yaml#/definitions/phandle"

  power-domains:
    items:
      - description: phandle to the VDEC power domain

  iram:
    description: Must contain a phandle to the mmio-sram device node that represents the IRAM
      region used by VDE.
    $ref: /schemas/types.yaml#/definitions/phandle

additionalProperties: false

examples:
  - |
    #include <dt-bindings/clock/tegra30-car.h>
    #include <dt-bindings/interrupt-controller/arm-gic.h>
    #include <dt-bindings/memory/tegra30-mc.h>

    video-codec@6001a000 {
        compatible = "nvidia,tegra30-vde", "nvidia,tegra20-vde";
        reg = <0x6001a000 0x1000>, /* Syntax Engine */
              <0x6001b000 0x1000>, /* Video Bitstream Engine */
              <0x6001c000  0x100>, /* Macroblock Engine */
              <0x6001c200  0x100>, /* Post-processing Engine */
              <0x6001c400  0x100>, /* Motion Compensation Engine */
              <0x6001c600  0x100>, /* Transform Engine */
              <0x6001c800  0x100>, /* Pixel prediction block */
              <0x6001ca00  0x100>, /* Video DMA */
              <0x6001d800  0x300>; /* Video frame controls */
        reg-names = "sxe", "bsev", "mbe", "ppe", "mce",
                    "tfe", "ppb", "vdma", "frameid";
        interrupts = <GIC_SPI  9 IRQ_TYPE_LEVEL_HIGH>, /* Sync token interrupt */
                     <GIC_SPI 10 IRQ_TYPE_LEVEL_HIGH>, /* BSE-V interrupt */
                     <GIC_SPI 12 IRQ_TYPE_LEVEL_HIGH>; /* SXE interrupt */
        interrupt-names = "sync-token", "bsev", "sxe";
        clocks = <&tegra_car TEGRA30_CLK_VDE>;
        resets = <&tegra_car 61>, <&mc TEGRA30_MC_RESET_VDE>;
        reset-names = "vde", "mc";
        iommus = <&mc TEGRA_SWGROUP_VDE>;
        iram = <&vde_pool>; /* IRAM region */
    };
```

## Documentation/devicetree/bindings/media/s5p-cec.yaml
```yaml
# SPDX-License-Identifier: GPL-2.0-only
%YAML 1.2
---
$id: http://devicetree.org/schemas/media/s5p-cec.yaml#
$schema: http://devicetree.org/meta-schemas/core.yaml#

title: Samsung HDMI CEC driver

maintainers:
  - Hans Verkuil <hverkuil@xs4all.nl>

description: The HDMI CEC module is present is Samsung SoCs and its purpose is to handle
  communication between HDMI connected devices over the CEC bus.

properties:
  compatible:
    const: samsung,s5p-cec

  reg:
    maxItems: 1

  interrupts:
    maxItems: 1

  clocks:
    items:
      - description: module clock

  clock-names:
    items:
      - const: hdmicec

  samsung,syscon-phandle:
    description: reference to the PMU system controller
    $ref: /schemas/types.yaml#/definitions/phandle

  # from cec.yaml
  hdmi-phandle: true
  needs-hpd: true

allOf:
  - $ref: cec.yaml

additionalProperties: false

required:
  - compatible
  - reg
  - interrupts
  - clocks
  - clock-names
  - samsung,syscon-phandle
  - hdmi-phandle

examples:
  - |
    #include <dt-bindings/clock/exynos4.h>
    #include <dt-bindings/interrupt-controller/arm-gic.h>

    hdmicec: cec@100b0000 {
        compatible = "samsung,s5p-cec";
        reg = <0x100b0000 0x200>;
        interrupts = <GIC_SPI 114 IRQ_TYPE_LEVEL_HIGH>;
        clocks = <&clock CLK_HDMI_CEC>;
        clock-names = "hdmicec";
        samsung,syscon-phandle = <&pmu_system_controller>;
        hdmi-phandle = <&hdmi>;
        pinctrl-names = "default";
        pinctrl-0 = <&hdmi_cec>;
    };
```

## Documentation/devicetree/bindings/media/stih-cec.yaml
```yaml
# SPDX-License-Identifier: GPL-2.0-only
%YAML 1.2
---
$id: http://devicetree.org/schemas/media/stih-cec.yaml#
$schema: http://devicetree.org/meta-schemas/core.yaml#

title: STMicroelectronics STIH4xx HDMI CEC driver

maintainers:
  - Hans Verkuil <hverkuil@xs4all.nl>

properties:
  compatible:
    const: st,stih-cec

  reg:
    maxItems: 1

  interrupts:
    maxItems: 1

  interrupt-names:
    items:
      - const: cec-irq

  clocks:
    items:
      - description: module clock

  clock-names:
    items:
      - const: cec-clk

  resets:
    items:
      - description: module reset

  pinctrl-names:
    items:
      - const: default

  pinctrl-0: true

  # from cec.yaml
  hdmi-phandle: true

additionalProperties: false

required:
  - compatible
  - reg
  - interrupts
  - clocks
  - resets

examples:
  # STIH407
  - |
    #include <dt-bindings/interrupt-controller/arm-gic.h>
    #include <dt-bindings/reset/stih407-resets.h>

    cec@94a087c {
        compatible = "st,stih-cec";
        reg = <0x94a087c 0x64>;
        clocks = <&clk_sysin>;
        clock-names = "cec-clk";
        interrupts = <GIC_SPI 140 IRQ_TYPE_NONE>;
        interrupt-names = "cec-irq";
        pinctrl-names = "default";
        pinctrl-0 = <&pinctrl_cec0_default>;
        resets = <&softreset STIH407_LPM_SOFTRESET>;
        hdmi-phandle = <&hdmi>;
    };
```

## Documentation/devicetree/bindings/memory-controllers/consumer.yaml
```yaml
# SPDX-License-Identifier: (GPL-2.0-only OR BSD-2-Clause)
%YAML 1.2
---
$id: http://devicetree.org/schemas/memory-controllers/consumer.yaml#
$schema: http://devicetree.org/meta-schemas/core.yaml#

title: Common memory controller consumer binding

maintainers:
  - Thierry Reding <thierry.reding@gmail.com>

properties:
  memory-controller:
    $ref: /schemas/types.yaml#/definitions/phandle-array
```
