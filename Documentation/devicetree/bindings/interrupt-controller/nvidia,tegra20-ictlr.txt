## Documentation/devicetree/bindings/mmc/nvidia,tegra20-sdhci.yaml
```yaml
# SPDX-Licens-Identifier: (GPL-2.0-only OR BSD-2-Clause)
%YAML 1.2
---
$id: http://devicetree.org/schemas/mmc/nvidia,tegra20-sdhci.yaml#
$schema: http://devicetree.org/meta-schemas/core.yaml#

title: NVIDIA Tegra Secure Digital Host Controller

maintainers:
  - Thierry Reding <thierry.reding@gmail.com>
  - Jon Hunter <jonathanh@nvidia.com>

description: |
  This controller on Tegra family SoCs provides an interface for MMC, SD, and
  SDIO types of memory cards.

  This file documents differences between the core properties described by
  mmc-controller.yaml and the properties for the Tegra SDHCI controller.

properties:
  # required properties
  compatible:
    items:
      - enum:
          - nvidia,tegra20-sdhci # for Tegra20
          - nvidia,tegra30-sdhci # for Tegra30
          - nvidia,tegra114-sdhci # for Tegra114
          - nvidia,tegra124-sdhci # for Tegra124 and Tegra132
          - nvidia,tegra210-sdhci # for Tegra210
          - nvidia,tegra186-sdhci # for Tegra186
          - nvidia,tegra194-sdhci # for Tegra194

  clocks:
    items:
      - description: module clock

  resets:
    items:
      - description: module reset

  reset-names:
    items:
      - const: sdhci

  # optional properties
  power-gpios:
    description: specify GPIOs for power control

  interconnects:
    $ref: /schemas/types.yaml#/definitions/phandle-array
    description: A list of phandle and specifier pairs that describe the
      interconnect paths to and from the SDHCI controller.

  interconnect-names:
    $ref: /schemas/types.yaml#/definitions/non-unique-string-array
    description: One string for each pair of phandle and specifier in the
      "interconnects" property.
    # XXX We need at least one of these to be named dma-mem so that the core
    # will set the DMA mask based on the DMA parent, but all of these go to
    # the system memory eventually.
    items:
      - const: dma-mem
      - const: dma-mem

allOf:
  - if:
      properties:
        compatible:
          contains:
            const: nvidia,tegra210-sdhci

    then:
      properties:
        pinctrl-names:
          $ref: /schemas/types.yaml#/definitions/string-array
          items:
            - const: sdmmc-3v3
              description: pad configuration for 3.3 V
            - const: sdmmc-1v8
              description: pad configuration for 1.8 V
            - const: sdmmc-3v3-drv
              description: pull-up/down configuration for 3.3 V
            - const: sdmmc-1v8-drv
              description: pull-up/down configuration for 1.8 V

  - if:
      properties:
        compatible:
          contains:
            anyOf:
              - const: nvidia,tegra186-sdhci
              - const: nvidia,tegra194-sdhci

    then:
      properties:
        pinctrl-names:
          $ref: /schemas/types.yaml#/definitions/string-array
          items:
            - const: sdmmc-3v3
              description: pad configuration for 3.3 V
            - const: sdmmc-1v8
              description: pad configuration for 1.8 V

  - if:
      properties:
        compatible:
          contains:
            anyOf:
              - const: nvidia,tegra210-sdhci
              - const: nvidia,tegra186-sdhci
              - const: nvidia,tegra194-sdhci

    then:
      properties:
        nvidia,only-1-8v:
          $ref: /schemas/types.yaml#/definitions/flag
          description: The presence of this property indicates that the
            controller operates at a 1.8 V fixed I/O voltage.

        nvidia,pad-autocal-pull-up-offset-3v3:
          $ref: /schemas/types.yaml#/definitions/uint32
          description: Specify drive strength calibration offsets for 3.3 V
            signaling modes.

            The property values are drive codes which are programmed into the
            PD_OFFSET and PU_OFFSET sections of the SDHCI_TEGRA_AUTO_CAL_CONFIG
            register. A higher value corresponds to higher drive strength.
            Please refer to the reference manual of the SoC for correct values.
            The SDR104 and HS400 timing specific values are used in
            corresponding modes if specified.

        nvidia,pad-autocal-pull-down-offset-3v3:
          $ref: /schemas/types.yaml#/definitions/uint32
          description: Specify drive strength calibration offsets for 3.3 V
            signaling modes.

        nvidia,pad-autocal-pull-up-offset-1v8:
          $ref: /schemas/types.yaml#/definitions/uint32
          description: Specify drive strength calibration offsets for 1.8 V
            signaling modes.

        nvidia,pad-autocal-pull-down-offset-1v8:
          $ref: /schemas/types.yaml#/definitions/uint32
          description: Specify drive strength calibration offsets for 1.8 V
            signaling modes.

        nvidia,pad-autocal-pull-up-offset-3v3-timeout:
          $ref: /schemas/types.yaml#/definitions/uint32
          description: Specify drive strength used as a fallback in case the
            automatic calibration times out on a 3.3 V signaling mode.

        nvidia,pad-autocal-pull-down-offset-3v3-timeout:
          $ref: /schemas/types.yaml#/definitions/uint32
          description: Specify drive strength used as a fallback in case the
            automatic calibration times out on a 3.3 V signaling mode.

        nvidia,pad-autocal-pull-up-offset-1v8-timeout:
          $ref: /schemas/types.yaml#/definitions/uint32
          description: Specify drive strength used as a fallback in case the
            automatic calibration times out on a 1.8 V signaling mode.

        nvidia,pad-autocal-pull-down-offset-1v8-timeout:
          $ref: /schemas/types.yaml#/definitions/uint32
          description: Specify drive strength used as a fallback in case the
            automatic calibration times out on a 1.8 V signaling mode.

        nvidia,pad-autocal-pull-up-offset-sdr104:
          $ref: /schemas/types.yaml#/definitions/uint32
          description: Specify drive strength calibration offsets for SDR104
            mode.

        nvidia,pad-autocal-pull-down-offset-sdr104:
          $ref: /schemas/types.yaml#/definitions/uint32
          description: Specify drive strength calibration offsets for SDR104
            mode.

        nvidia,pad-autocal-pull-up-offset-hs400:
          $ref: /schemas/types.yaml#/definitions/uint32
          description: Specify drive strength calibration offsets for HS400
            mode.

        nvidia,pad-autocal-pull-down-offset-hs400:
          $ref: /schemas/types.yaml#/definitions/uint32
          description: Specify drive strength calibration offsets for HS400
            mode.

        nvidia,default-tap:
          $ref: /schemas/types.yaml#/definitions/uint32
          description: Specify the default inbound sampling clock trimmer
            value for non-tunable modes.

            The values are used for compensating trace length differences
            by adjusting the sampling point. The values are programmed to the
            Vendor Clock Control Register. Please refer to the reference
            manual of the SoC for correct values.

            The DQS trim values are only used on controllers which support
            HS400 timing. Only SDMMC4 on Tegra210 and Tegra186 supports
            HS400.

        nvidia,default-trim:
          description: Specify the default outbound clock trimmer value.

        nvidia,dqs-trim:
          description: Specify DQS trim value for HS400 timing.

required:
  - compatible
  - clocks
  - resets
  - reset-names

examples:
  - |
    #include <dt-bindings/interrupt-controller/arm-gic.h>

    sdhci@c8000200 {
        compatible = "nvidia,tegra20-sdhci";
        reg = <0xc8000200 0x200>;
        interrupts = <47>;
        clocks = <&tegra_car 14>;
        resets = <&tegra_car 14>;
        reset-names = "sdhci";
        cd-gpios = <&gpio 69 0>; /* gpio PI5 */
        wp-gpios = <&gpio 57 0>; /* gpio PH1 */
        power-gpios = <&gpio 155 0>; /* gpio PT3 */
        bus-width = <8>;
    };

  - |
    #include <dt-bindings/clock/tegra210-car.h>
    #include <dt-bindings/interrupt-controller/arm-gic.h>

    sdhci@700b0000 {
        compatible = "nvidia,tegra210-sdhci";
        reg = <0x0 0x700b0000 0x0 0x200>;
        interrupts = <GIC_SPI 14 IRQ_TYPE_LEVEL_HIGH>;
        clocks = <&tegra_car TEGRA210_CLK_SDMMC1>;
        clock-names = "sdhci";
        resets = <&tegra_car 14>;
        reset-names = "sdhci";
        pinctrl-names = "sdmmc-3v3", "sdmmc-1v8";
        pinctrl-0 = <&sdmmc1_3v3>;
        pinctrl-1 = <&sdmmc1_1v8>;
        nvidia,pad-autocal-pull-up-offset-3v3 = <0x00>;
        nvidia,pad-autocal-pull-down-offset-3v3 = <0x7d>;
        nvidia,pad-autocal-pull-up-offset-1v8 = <0x7b>;
        nvidia,pad-autocal-pull-down-offset-1v8 = <0x7b>;
        status = "disabled";
    };
```

## Documentation/devicetree/bindings/mmc/sdhci.yaml
```yaml
# SPDX-License-Identifier: GPL-2.0
%YAML 1.2
---
$id: http://devicetree.org/schemas/mmc/sdhci.yaml#
$schema: http://devicetree.org/meta-schemas/core.yaml#

title: SDHCI Controller Bindings

maintainers:
  - Ulf Hansson <ulf.hansson@linaro.org>

description: |
  These properties are specific for SD host controllers. For properties shared by MMC host
  controllers refer to the MMC bindings in mmc-controller.yaml.

properties:
  sdhci-caps-mask:
    $ref: /schemas/types.yaml#/definitions/uint64
    description: The SDHCI capabilities register is incorrect. This 64-bit property corresponds to
      the bits in the SDHCI capability register. If the bit is on in the mask then the bit is
      incorrect in the register and should be turned off, before applying sdhci-caps.

  sdhci-caps:
    $ref: /schemas/types.yaml#/definitions/uint64
    description: The SDHCI capabilities register is incorrect. This 64-bit property corresponds to
      the bits in the SDHCI capability register. If the bit is on in the property then the bit
      should be turned on.

additionalProperties: true
```

## Documentation/devicetree/bindings/mtd/nvidia,tegra20-nand.yaml
```yaml
# SPDX-License-Identifier: (GPL-2.0-only OR BSD-2-Clause)
%YAML 1.2
---
$id: http://devicetree.org/schemas/mtd/nvidia,tegra20-nand.yaml#
$schema: http://devicetree.org/meta-schemas/core.yaml#

title: NVIDIA Tegra NAND Flash controller

maintainers:
  - Thierry Reding <thierry.reding@gmail.com>
  - Jon Hunter <jonathanh@nvidia.com>

properties:
  compatible:
    const: nvidia,tegra20-nand

  reg:
    maxItems: 1

  interrupts:
    maxItems: 1

  clocks:
    items:
      - description: module clock

  clock-names:
    items:
      - const: nand

  resets:
    items:
      - description: module reset

  reset-names:
    items:
      - const: nand

  operating-points-v2:
    $ref: "/schemas/types.yaml#/definitions/phandle"

  power-domains:
    items:
      - description: phandle to the core power domain

required:
  - compatible
  - reg
  - interrupts
  - clocks
  - clock-names
  - resets
  - reset-names

allOf:
  - $ref: nand-controller.yaml

patternProperties:
  "^nand@[a-f0-9]$":
    type: object
    properties:
      nand-ecc-mode:
        description: String, operation mode of the NAND ecc mode.
        const: hw

      nand-ecc-algo:
        enum: [ bch, rs ]

      nand-ecc-strength:
        enum: [ 4, 6, 8, 14, 16 ]

      wp-gpios:
        $ref: /schemas/types.yaml#/definitions/phandle-array
        description: GPIO specifier for the write protect pin.

unevaluatedProperties: false

examples:
  - |
    #include <dt-bindings/clock/tegra20-car.h>
    #include <dt-bindings/gpio/tegra-gpio.h>
    #include <dt-bindings/interrupt-controller/arm-gic.h>

    nand-controller@70008000 {
      compatible = "nvidia,tegra20-nand";
      reg = <0x70008000 0x100>;
      interrupts = <GIC_SPI 24 IRQ_TYPE_LEVEL_HIGH>;
      clocks = <&tegra_car TEGRA20_CLK_NDFLASH>;
      clock-names = "nand";
      resets = <&tegra_car 13>;
      reset-names = "nand";

      #address-cells = <1>;
      #size-cells = <0>;

      nand@0 {
        reg = <0>;
        #address-cells = <1>;
        #size-cells = <1>;
        nand-bus-width = <8>;
        nand-on-flash-bbt;
        nand-ecc-algo = "bch";
        nand-ecc-strength = <8>;
        wp-gpios = <&gpio TEGRA_GPIO(S, 0) GPIO_ACTIVE_LOW>;
      };
    };
```

## Documentation/devicetree/bindings/net/axis,artpec6-eqos.yaml
```yaml
# SPDX-License-Identifier: GPL-2.0
%YAML 1.2
---
$id: http://devicetree.org/schemas/net/axis,artpec6-eqos.yaml#
$schema: http://devicetree.org/meta-schemas/core.yaml#

title: Axis ARTPEC-6 Ethernet QoS

maintainers:
  - Rob Herring <robh+dt@kernel.org>

description: This binding describes the instantiation of the DWC EQoS
  IP in the Axis ARTPEC-6 SoC.

properties:
  compatible:
    items:
      - const: axis,artpec6-eqos
      - const: snps,dwc-qos-ethernet-4.10

  reg:
    maxItems: 1

  clocks:
    items:
      - description: The EQOS transmit path clock. The HW signal name is
          clk_tx_i. In some configurations (e.g. GMII/RGMII), this clock
          also drives the PHY TX path. In other configurations, other
          clocks (such as tx_125, rmii) may drive the PHY TX path.
      - description: The CPU/slave-bus (CSR) interface clock. This
          applies to any bus type; APB, AHB, AXI, etc. The HW signal
          name is hclk_i (AHB) or clk_csr_i (other buses).
      - description: The master bus interface clock. Only required in
          configurations that use a separate clock for the master and
          slave bus interfaces. The HW signal name is hclk_i (AHB) or
          aclk_i (AXI).
      - description: The PTP reference clock. The HW signal name is
          clk_ptp_ref_i.

  clock-names:
    items:
      - const: tx
      - const: slave_bus
      - const: master_bus
      - const: ptp_ref

allOf:
  - $ref: snps,dwc-qos-ethernet.yaml#
```
