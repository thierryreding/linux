## Documentation/devicetree/bindings/pci/pci-iommu.yaml
```yaml
# SPDX-License-Identifier: GPL-2.0-only
%YAML 1.2
---
$id: http://devicetree.org/schemas/pci/pci-iommu.yaml#
$schema: http://devicetree.org/meta-schemas/core.yaml#

title: PCI IOMMU bindings

maintainers:
  - Rob Herring <robh+dt@kernel.org>

description: |
  This document describes the generic device tree binding for describing the
  relationship between PCI(e) devices and IOMMU(s).

  Each PCI(e) device under a root complex is uniquely identified by its
  Requester ID (AKA RID). A Requester ID is a triplet of a Bus number, Device
  number, and Function number.

  For the purpose of this document, when treated as a numeric value, a RID is
  formatted such that:

    * Bits [15:8] are the Bus number.
    * Bits [7:3] are the Device number.
    * Bits [2:0] are the Function number.
    * Any other bits required for padding must be zero.

  IOMMUs may distinguish PCI devices through sideband data derived from the
  Requester ID. While a given PCI device can only master through one IOMMU, a
  root complex may split masters across a set of IOMMUs (e.g. with one IOMMU
  per bus).

  The generic 'iommus' property is insufficient to describe this relationship,
  and a mechanism is required to map from a PCI device to its IOMMU and
  sideband data.

  For generic IOMMU bindings, see
  Documentation/devicetree/bindings/iommu/iommu.txt.

properties:
  iommu-map:
    $ref: "/schemas/types.yaml#/definitions/phandle-array"
    description: |
      Maps a Requester ID to an IOMMU and associated IOMMU specifier data.

      The property is an arbitrary number of tuples of (rid-base, iommu,
      iommu-base, length).

      Any RID r in the interval [rid-base, rid-base + length) is associated
      with the listed IOMMU, with the IOMMU specifier (r - rid-base +
      iommu-base).

  iommu-map-mask:
    $ref: "/schemas/types.yaml#/definitions/uint32"
    description:
      A mask to be applied to each Requester ID prior to being mapped to an
      IOMMU specifier per the iommu-map property.

additionalProperties: true

examples:
  - |
    iommu0: iommu@a {
        reg = <0xa 0x1>;
        compatible = "vendor,some-iommu";
        #iommu-cells = <1>;
    };

    pci@f {
        reg = <0xf 0x1>;
        compatible = "vendor,pcie-root-complex";
        device_type = "pci";

        #address-cells = <3>;
        #size-cells = <2>;
        ranges = <0x02000000 0 0x00000000 0x00000000 0 0x00000000>;

        /*
         * The sideband data provided to the IOMMU is the RID,
         * identity-mapped.
         */
        iommu-map = <0x0 &iommu0 0x0 0x10000>;
    };

  - |
    iommu1: iommu@a {
        reg = <0xa 0x1>;
        compatible = "vendor,some-iommu";
        #iommu-cells = <1>;
    };

    pci@f {
        reg = <0xf 0x1>;
        compatible = "vendor,pcie-root-complex";
        device_type = "pci";

        #address-cells = <3>;
        #size-cells = <2>;
        ranges = <0x02000000 0 0x00000000 0x00000000 0 0x00000000>;

        /*
         * The sideband data provided to the IOMMU is the RID with the
         * function bits masked out.
         */
        iommu-map = <0x0 &iommu 0x0 0x10000>;
        iommu-map-mask = <0xfff8>;
    };

  - |
    iommu2: iommu@a {
        reg = <0xa 0x1>;
        compatible = "vendor,some-iommu";
        #iommu-cells = <1>;
    };

    pci@f {
        reg = <0xf 0x1>;
        compatible = "vendor,pcie-root-complex";
        device_type = "pci";

        #address-cells = <3>;
        #size-cells = <2>;
        ranges = <0x02000000 0 0x00000000 0x00000000 0 0x00000000>;

        /*
         * The sideband data provided to the IOMMU is the RID,
         * but the high bits of the bus number are flipped.
         */
        iommu-map = <0x0000 &iommu2 0x8000 0x8000>,
                    <0x8000 &iommu2 0x0000 0x8000>;
    };

  - |
    iommu_a: iommu@a {
        reg = <0xa 0x1>;
        compatible = "vendor,some-iommu";
        #iommu-cells = <1>;
    };

    iommu_b: iommu@b {
        reg = <0xb 0x1>;
        compatible = "vendor,some-iommu";
        #iommu-cells = <1>;
    };

    iommu_c: iommu@c {
        reg = <0xc 0x1>;
        compatible = "vendor,some-iommu";
        #iommu-cells = <1>;
    };

    pci@f {
        reg = <0xf 0x1>;
        compatible = "vendor,pcie-root-complex";
        device_type = "pci";

        #address-cells = <3>;
        #size-cells = <2>;
        ranges = <0x02000000 0 0x00000000 0x00000000 0 0x00000000>;

        /*
         * Devices with bus number 0-127 are mastered via IOMMU
         * a, with sideband data being RID[14:0].
         * Devices with bus number 128-255 are mastered via
         * IOMMU b, with sideband data being RID[14:0].
         * No devices master via IOMMU c.
         */
        iommu-map = <0x0000 &iommu_a 0x0000 0x8000>,
                    <0x8000 &iommu_b 0x0000 0x8000>;
    };
```

## Documentation/devicetree/bindings/pci/plx,pex8605.yaml
```yaml
# SPDX-License-Identifier: (GPL-2.0-only OR BSD-2-Clause)
%YAML 1.2
---
$id: http://devicetree.org/schemas/pci/plx,pex8605.yaml#
$schema: http://devicetree.org/meta-schemas/core.yaml#

title: PLX Technology PEX8605 PCIe Gen2 switch

maintainers:
  - Rob Herring <robh+dt@kernel.org>

description:
  The PLX Technology PEX8605 is a 4-lane, 4-port PCIe Gen2 switch.

properties:
  compatible:
    const: plx,pex8605

  reg:
    maxItems: 1

additionalProperties: false

required:
  - compatible
  - reg

examples:
  - |
    i2c {
      #address-cells = <1>;
      #size-cells = <0>;

      pcie-switch@58 {
        compatible = "plx,pex8605";
        reg = <0x58>;
      };
    };
```

## Documentation/devicetree/bindings/phy/nvidia,tegra20-usb-phy.yaml
```yaml
# SPDX-License-Identifier: (GPL-2.0 OR BSD-2-Clause)
%YAML 1.2
---
$id: "http://devicetree.org/schemas/phy/nvidia,tegra20-usb-phy.yaml#"
$schema: "http://devicetree.org/meta-schemas/core.yaml#"

title: Device tree binding for NVIDIA Tegra USB PHY

maintainers:
  - Thierry Reding <treding@nvidia.com>
  - Jon Hunter <jonathanh@nvidia.com>

properties:
  # required properties
  compatible:
    oneOf:
      - items:
          - enum:
              - nvidia,tegra210-usb-phy
              - nvidia,tegra124-usb-phy
              - nvidia,tegra114-usb-phy
          - const: nvidia,tegra30-usb-phy
      - items:
          - const: nvidia,tegra30-usb-phy
      - items:
          - const: nvidia,tegra20-usb-phy

  reg:
    minItems: 1
    maxItems: 2
    items:
      - description: PHY register set
      - description: register set of the PHY containing the UTMI pad control registers

  phy_type:
    items:
      enum:
        - utmi
        - ulpi
        - hsic

  clocks:
    minItems: 2
    maxItems: 4

  clock-names:
    minItems: 2
    maxItems: 4

  resets:
    items:
      - description: PHY's reset signal
      - description: reset of the PHY containing the chip-wide UTMI pad control
          registers

  reset-names:
    items:
      - const: usb
      - const: utmi-pads

  '#phy-cells':
    const: 0

  nvidia,phy-reset-gpio:
    $ref: '/schemas/types.yaml#/definitions/phandle-array'
    description: GPIO used to reset the PHY

  nvidia,hssync-start-delay:
    $ref: '/schemas/types.yaml#/definitions/uint32'
    description: Number of 480 Mhz clock cycles to wait before start of
      sync launches RxActive

  nvidia,elastic-limit:
    $ref: '/schemas/types.yaml#/definitions/uint32'
    description: Variable FIFO Depth of elastic input store

  nvidia,idle-wait-delay:
    $ref: '/schemas/types.yaml#/definitions/uint32'
    description: Number of 480 Mhz clock cycles of idle to wait before
      declare IDLE.

  nvidia,term-range-adj:
    $ref: '/schemas/types.yaml#/definitions/uint32'
    description: Range adjusment on terminations

  nvidia,xcvr-setup:
    $ref: '/schemas/types.yaml#/definitions/uint32'
    description: uses the provided values for the HS driver

  nvidia,xcvr-setup-use-fuses:
    type: boolean
    description: When present, indicates that HS driver values are read
      from the on-chip fuses. Takes precedence over nvidia,xcvr-setup if
      both are provided.

  nvidia,xcvr-lsfslew:
    $ref: '/schemas/types.yaml#/definitions/uint32'
    description: LS falling slew rate control

  nvidia,xcvr-lsrslew:
    $ref: '/schemas/types.yaml#/definitions/uint32'
    description: LS rising slew rate control

  nvidia,xcvr-hsslew:
    $ref: '/schemas/types.yaml#/definitions/uint32'
    description: HS slew rate control

  nvidia,hssquelch-level:
    $ref: '/schemas/types.yaml#/definitions/uint32'
    description: HS squelch detector level

  nvidia,hsdiscon-level:
    $ref: '/schemas/types.yaml#/definitions/uint32'
    description: HS disconnect detector level

  vbus-supply:
    description: regulator for VBUS

  # optional properties
  nvidia,has-legacy-mode:
    type: boolean
    description: Indicates whether this controller can operate in legacy
      mode (as APX 2500 / 2600). In legacy mode some registers are accessed
      through the APB_MISC base address instead of the USB controller.

  nvidia,is-wired:
    type: boolean
    description: Indicates whether we can do certain kind of power
      optimizations for the devices that are always connected. e.g. modem.

  dr_mode:
    items:
      enum:
        - host
        - peripheral
        - otg
    description: Dual role mode. Indicates the working mode for the PHY.
      Defaults to "host" if not defined. "host" means this is a host
      controller, "peripheral" means it is device controller and "otg"
      means it can operate as either ("on the go").

  nvidia,has-utmi-pad-registers:
    type: boolean
    description: Indicates whether this controller contains the UTMI pad
      control registers common to all USB controllers.

allOf:
  - if:
      properties:
        phy_type:
          const: utmi
    then:
      properties:
        reg:
          maxItems: 2

        clocks:
          items:
            - description: Clock needed to access the PHY's own registers.
                This is the associated EHCI controller's clock.
            - description: USB PLL
            - description: timeout clock (clk_m)
            - description: Clock needed to access the UTMI pad control
                registers.

        clock-names:
          items:
            - const: reg
            - const: pll_u
            - const: timer
            - const: utmi-pads

      required:
        - nvidia,hssync-start-delay
        - nvidia,elastic-limit
        - nvidia,idle-wait-delay
        - nvidia,term-range-adj
        - nvidia,xcvr-lsfslew
        - nvidia,xcvr-lsrslew

      oneOf:
        - required:
            - nvidia,xcvr-setup-use-fuses
        - required:
            - nvidia,xcvr-setup

  - if:
      properties:
        compatible:
          contains:
            const: nvidia,tegra30-usb-phy
        phy_type:
          const: utmi
    then:
      required:
        - nvidia,xcvr-hsslew
        - nvidia,hssquelch-level
        - nvidia,hsdiscon-level

  - if:
      properties:
        phy_type:
          const: ulpi
    then:
      properties:
        clocks:
          items:
            - description: Clock needed to access the PHY's own registers.
                This is the associated EHCI controller's clock.
            - description: USB PLL
            - description: Clock provided by Tegra to the ULPI PHY (usually
                pad DAP_MCLK2 with pad group aka "nvidia,pins" cdev2 and pin
                mux option config aka "nvidia,function" pllp_out4).

        clock-names:
          items:
            - const: reg
            - const: pll_u
            - const: ulpi-link

      required:
        - nvidia,phy-reset-gpio

  - if:
      properties:
        dr_mode:
          const: otg
    then:
      required:
        - vbus-supply

additionalProperties: false

examples:
  - |
    #include <dt-bindings/clock/tegra20-car.h>
    #include <dt-bindings/gpio/tegra-gpio.h>
    #include <dt-bindings/interrupt-controller/arm-gic.h>

    usb-phy@c5000000 {
        compatible = "nvidia,tegra20-usb-phy";
        reg = <0xc5000000 0x4000>,
              <0xc5000000 0x4000>;
        phy_type = "utmi";
        clocks = <&tegra_car TEGRA20_CLK_USBD>,
                 <&tegra_car TEGRA20_CLK_PLL_U>,
                 <&tegra_car TEGRA20_CLK_CLK_M>,
                 <&tegra_car TEGRA20_CLK_USBD>;
        clock-names = "reg", "pll_u", "timer", "utmi-pads";
        resets = <&tegra_car 22>, <&tegra_car 22>;
        reset-names = "usb", "utmi-pads";
        #phy-cells = <0>;
        nvidia,has-legacy-mode;
        nvidia,hssync-start-delay = <9>;
        nvidia,idle-wait-delay = <17>;
        nvidia,elastic-limit = <16>;
        nvidia,term-range-adj = <6>;
        nvidia,xcvr-setup = <9>;
        nvidia,xcvr-lsfslew = <1>;
        nvidia,xcvr-lsrslew = <1>;
        nvidia,has-utmi-pad-registers;
        vbus-supply = <&vdd_vbus>;
    };

    usb-phy@c5004000 {
        compatible = "nvidia,tegra20-usb-phy";
        reg = <0xc5004000 0x4000>;
        phy_type = "ulpi";
        clocks = <&tegra_car TEGRA20_CLK_USB2>,
                 <&tegra_car TEGRA20_CLK_PLL_U>,
                 <&tegra_car TEGRA20_CLK_CDEV2>;
        clock-names = "reg", "pll_u", "ulpi-link";
        resets = <&tegra_car 58>, <&tegra_car 22>;
        reset-names = "usb", "utmi-pads";
        #phy-cells = <0>;
        nvidia,phy-reset-gpio = <&gpio TEGRA_GPIO(V, 1) GPIO_ACTIVE_LOW>;
        vbus-supply = <&vdd_vbus>;
    };
```
