## Documentation/devicetree/bindings/net/nvidia,tegra186-eqos.yaml
```yaml
# SPDX-License-Identifier: GPL-2.0
%YAML 1.2
---
$id: http://devicetree.org/schemas/net/nvidia,tegra186-eqos.yaml#
$schema: http://devicetree.org/meta-schemas/core.yaml#

title: NVIDIA Tegra186 (and later) Ethernet QoS

maintainers:
  - Thierry Reding <thierry.reding@gmail.com>
  - Jon Hunter <jonathanh@nvidia.com>

properties:
  compatible:
    oneOf:
      - items:
          - const: nvidia,tegra186-eqos
          - const: snps,dwc-qos-ethernet-4.10

      - items:
          - enum:
              - nvidia,tegra194-eqos
              - nvidia,tegra234-eqos
          - const: nvidia,tegra186-eqos
          - const: snps,dwc-qos-ethernet-4.10

  reg:
    maxItems: 1

  interrupts:
    items:
      - description: common interrupt
      - description: power interrupt
      - description: RX0 interrupt
      - description: TX0 interrupt
      - description: RX1 interrupt
      - description: TX1 interrupt
      - description: RX2 interrupt
      - description: TX2 interrupt
      - description: RX3 interrupt
      - description: TX3 interrupt
    minItems: 1

  clocks:
    items:
      - description: parent bus clock
      - description: child bus clock
      - description: receiver clock
      - description: transmitter clock
      - description: PTP reference clock

  clock-names:
    items:
      - const: master_bus
      - const: slave_bus
      - const: rx
      - const: tx
      - const: ptp_ref

  resets:
    items:
      - description: module reset

  reset-names:
    items:
      - const: eqos

  interconnects:
    items:
      - description: memory read interconnect path
      - description: memory write interconnect path

  interconnect-names:
    items:
      - const: dma-mem # read
      - const: write

  iommus:
    maxItems: 1

  mdio:
    $ref: mdio.yaml

  phy-reset-gpios:
    description: Specifies the GPIO used to reset the PHY.

  snps,write-requests:
    $ref: /schemas/types.yaml#/definitions/uint32
    description: Number of write requests that the AXI port can issue.
      It depends on the SoC configuration.

  snps,read-requests:
    $ref: /schemas/types.yaml#/definitions/uint32
    description: Number of read requests that the AXI port can issue.
      It depends on the SoC configuration.

  snps,burst-map:
    $ref: /schemas/types.yaml#/definitions/uint32
    description: Bitmap of allowed AXI burst lengts, with the LSB
      representing 4, then 8 etc.

  snps,txpbl:
    $ref: /schemas/types.yaml#/definitions/uint32
    description: DMA Programmable burst length for the TX DMA

  snps,rxpbl:
    $ref: /schemas/types.yaml#/definitions/uint32
    description: DMA Programmable burst length for the RX DMA

allOf:
  - $ref: ethernet-controller.yaml#

unevaluatedProperties: false

required:
  - compatible
  - reg
  - interrupts
  - clocks
  - clock-names
  - resets
  - reset-names
  - interconnects
  - interconnect-names
  - iommus

examples:
  - |
    #include <dt-bindings/clock/tegra186-clock.h>
    #include <dt-bindings/gpio/tegra186-gpio.h>
    #include <dt-bindings/interrupt-controller/arm-gic.h>
    #include <dt-bindings/memory/tegra186-mc.h>
    #include <dt-bindings/reset/tegra186-reset.h>

    ethernet@2490000 {
      compatible = "nvidia,tegra186-eqos",
                   "snps,dwc-qos-ethernet-4.10";
      reg = <0x02490000 0x10000>;
      interrupts = <GIC_SPI 194 IRQ_TYPE_LEVEL_HIGH>, /* common */
                   <GIC_SPI 195 IRQ_TYPE_LEVEL_HIGH>, /* power */
                   <GIC_SPI 190 IRQ_TYPE_LEVEL_HIGH>, /* rx0 */
                   <GIC_SPI 186 IRQ_TYPE_LEVEL_HIGH>, /* tx0 */
                   <GIC_SPI 191 IRQ_TYPE_LEVEL_HIGH>, /* rx1 */
                   <GIC_SPI 187 IRQ_TYPE_LEVEL_HIGH>, /* tx1 */
                   <GIC_SPI 192 IRQ_TYPE_LEVEL_HIGH>, /* rx2 */
                   <GIC_SPI 188 IRQ_TYPE_LEVEL_HIGH>, /* tx2 */
                   <GIC_SPI 193 IRQ_TYPE_LEVEL_HIGH>, /* rx3 */
                   <GIC_SPI 189 IRQ_TYPE_LEVEL_HIGH>; /* tx3 */
      clocks = <&bpmp TEGRA186_CLK_AXI_CBB>,
               <&bpmp TEGRA186_CLK_EQOS_AXI>,
               <&bpmp TEGRA186_CLK_EQOS_RX>,
               <&bpmp TEGRA186_CLK_EQOS_TX>,
               <&bpmp TEGRA186_CLK_EQOS_PTP_REF>;
      clock-names = "master_bus", "slave_bus", "rx", "tx", "ptp_ref";
      resets = <&bpmp TEGRA186_RESET_EQOS>;
      reset-names = "eqos";
      interconnects = <&mc TEGRA186_MEMORY_CLIENT_EQOSR &emc>,
                      <&mc TEGRA186_MEMORY_CLIENT_EQOSW &emc>;
      interconnect-names = "dma-mem", "write";
      iommus = <&smmu TEGRA186_SID_EQOS>;

      snps,write-requests = <1>;
      snps,read-requests = <3>;
      snps,burst-map = <0x7>;
      snps,txpbl = <32>;
      snps,rxpbl = <8>;

      phy-reset-gpios = <&gpio TEGRA186_MAIN_GPIO(M, 4) GPIO_ACTIVE_LOW>;
      phy-handle = <&phy>;
      phy-mode = "rgmii";

      mdio {
        #address-cells = <1>;
        #size-cells = <0>;

        phy: phy@0 {
          compatible = "ethernet-phy-ieee802.3-c22";
          reg = <0x0>;
          interrupt-parent = <&gpio>;
          interrupts = <TEGRA186_MAIN_GPIO(M, 5) IRQ_TYPE_LEVEL_LOW>;

          #phy-cells = <0>;
        };
      };
    };
```

## Documentation/devicetree/bindings/net/nvidia,tegra234-mgbe.yaml
```yaml
# SPDX-License-Identifier: (GPL-2.0-only OR BSD-2-Clause)
%YAML 1.2
---
$id: http://devicetree.org/schemas/net/nvidia,tegra234-mgbe.yaml#
$schema: http://devicetree.org/meta-schemas/core.yaml#

title: NVIDIA Tegra234 (and later) MGBE Ethernet Device Tree Bindings

maintainers:
  - Thierry Reding <treding@nvidia.com>
  - Jon Hunter <jonathanh@nvidia.com>

properties:
  compatible:
    contains:
      enum:
        - nvidia,tegra234-mgbe

  reg:
    minItems: 3
    maxItems: 3

  reg-names:
    items:
      - const: hypervisor
      - const: mac
      - const: xpcs

  interrupts:
    items:
      - description: common interrupt

  interrupt-names:
    items:
      - const: common

  clocks:
    items:
      - description: MGBE
      - description: MAC layer clock
      - description: MAC divider
      - description: PTP reference clock
      - description: RX input (m)
      - description: RX input
      - description: TX
      - description: EEE PCS
      - description: RX PCS input
      - description: RX PCS (m)
      - description: RX PCS
      - description: TX PCS

  clock-names:
    items:
      - const: mgbe
      - const: mac
      - const: mac-divider
      - const: ptp-ref
      - const: rx-input-m
      - const: rx-input
      - const: tx
      - const: eee-pcs
      - const: rx-pcs-input
      - const: rx-pcs-m
      - const: rx-pcs
      - const: tx-pcs

  resets:
    minItems: 2
    maxItems: 2

  reset-names:
    items:
      - const: mac
      - const: pcs

  interconnects:
    minItems: 2
    maxItems: 2

  interconnect-names:
    items:
      - const: dma-mem # read
      - const: write

  iommus:
    items:
      - description: MGBE stream ID

  power-domains:
    items:
      - description: MGBE power partition

  # these are specified in more detail in ethernet-controller.yaml
  phy-handle: true
  phy-mode: true
  mdio: true

allOf:
  - $ref: ethernet-controller.yaml#

additionalProperties: false

required:
  - compatible
  - reg
  - reg-names
  - interrupts
  - interrupt-names
  - clocks
  - clock-names
  - resets
  - reset-names
  - interconnects
  - interconnect-names
  - iommus
  - power-domains

examples:
  - |
    #include <dt-bindings/clock/tegra234-clock.h>
    #include <dt-bindings/interrupt-controller/arm-gic.h>
    #include <dt-bindings/memory/tegra234-mc.h>
    #include <dt-bindings/power/tegra234-powergate.h>
    #include <dt-bindings/reset/tegra234-reset.h>

    ethernet@6800000 {
        compatible = "nvidia,tegra234-mgbe";
        reg = <0x06800000 0x10000>,
              <0x06810000 0x10000>,
              <0x068a0000 0x10000>;
        reg-names = "hypervisor", "mac", "xpcs";
        interrupts = <GIC_SPI 384 IRQ_TYPE_LEVEL_HIGH>;
        interrupt-names = "common";
        clocks = <&bpmp TEGRA234_CLK_MGBE0_APP>,
                 <&bpmp TEGRA234_CLK_MGBE0_MAC>,
                 <&bpmp TEGRA234_CLK_MGBE0_MAC_DIVIDER>,
                 <&bpmp TEGRA234_CLK_MGBE0_PTP_REF>,
                 <&bpmp TEGRA234_CLK_MGBE0_RX_INPUT_M>,
                 <&bpmp TEGRA234_CLK_MGBE0_RX_INPUT>,
                 <&bpmp TEGRA234_CLK_MGBE0_TX>,
                 <&bpmp TEGRA234_CLK_MGBE0_EEE_PCS>,
                 <&bpmp TEGRA234_CLK_MGBE0_RX_PCS_INPUT>,
                 <&bpmp TEGRA234_CLK_MGBE0_RX_PCS_M>,
                 <&bpmp TEGRA234_CLK_MGBE0_RX_PCS>,
                 <&bpmp TEGRA234_CLK_MGBE0_TX_PCS>;
        clock-names = "mgbe", "mac", "mac-divider", "ptp-ref", "rx-input-m",
                      "rx-input", "tx", "eee-pcs", "rx-pcs-input", "rx-pcs-m",
                      "rx-pcs", "tx-pcs";
        resets = <&bpmp TEGRA234_RESET_MGBE0_MAC>,
                 <&bpmp TEGRA234_RESET_MGBE0_PCS>;
        reset-names = "mac", "pcs";
        interconnects = <&mc TEGRA234_MEMORY_CLIENT_MGBEARD &emc>,
                        <&mc TEGRA234_MEMORY_CLIENT_MGBEAWR &emc>;
        interconnect-names = "dma-mem", "write";
        iommus = <&smmu_niso0 TEGRA234_SID_MGBE>;
        power-domains = <&bpmp TEGRA234_POWER_DOMAIN_MGBEA>;
        status = "disabled";
    };
```

## Documentation/devicetree/bindings/net/snps,dwc-qos-ethernet.yaml
```yaml
# SPDX-License-Identifier: GPL-2.0
%YAML 1.2
---
$id: http://devicetree.org/schemas/net/snps,dwc-qos-ethernet.yaml#
$schema: http://devicetree.org/meta-schemas/core.yaml#

title: Synopsys DWC Ethernet QoS IP version 4.10 driver (GMAC)

maintainers:
  - Thierry Reding <thierry.reding@gmail.com>
  - Jon Hunter <jonathanh@nvidia.com>

description:
  This binding is deprecated, but it continues to be supported, but new
  features should be preferably added to the stmmac binding document.

  This binding supports the Synopsys Designware Ethernet QoS (Quality Of
  Service) IP block. The IP supports multiple options for bus type,
  clocking and reset structure, and feature list. Consequently, a number
  of properties and list entries in properties are marked as optional,
  or only required in specific HW configurations.

properties:
  #compatible:
  #  const: snps,dwc-qos-ethernet-4.10

  #clocks:
  #  description: |
  #    Note: Support for additional IP configurations may require adding
  #    the following clocks to this list in the future: clk_rx_125_i,
  #    clk_tx_125_i, clk_pmarx_0_i, clk_pmarx1_i, clk_rmii_i,
  #    clk_revmii_rx_i, clk_revmii_tx_i.

  #    Configurations exist where multiple similar clocks are used at
  #    once, e.g. all of clk_rx_125_i, clk_pmarx_0_i, clk_pmarx1_i. For
  #    this reason it is best to extend the binding with a separate
  #    clock-names entry for each of those RX clocks, rather than
  #    repurposing the existing "rx" clock-names entry as a generic/
  #    logical clock in a similar fashion to "master_bus" and
  #    "slave_bus". This will allow easy support for configurations that
  #    support multiple PHY interfaces using a mux, and hence need to
  #    have explicit control over specific RX clocks.
  #  items:
  #    - description: The EQOS transmit path clock. The HW signal name is
  #        clk_tx_i. In some configurations (e.g. GMII/RGMII), this clock
  #        also drives the PHY TX path. In other configurations, other
  #        clocks (such as tx_125, rmii) may drive the PHY TX path.
  #    - description: The EQOS receive path clock. The HW signal name is
  #        clk_rx_i. In some configurations (e.g. GMII/RGMII), this clock
  #        is derived from the PHY's RX clock output. In other
  #        configurations, other clocks (such as rx_125, rmii) may drive
  #        the EQOS RX path.

  #        In cases where the PHY clock is directly fed into the EQOS
  #        receive path without intervening logic, the DT need not
  #        represent this clock, since it is assumed to be fully under
  #        the control of the PHY device/driver. In cases where SoC
  #        integration adds additional logic to this path, such as a SW-
  #        controlled clock gate, this clock should be represented in DT.
  #    - description: The CPU/slave-bus (CSR) interface clock. This
  #        applies to any bus type; APB, AHB, AXI, etc. The HW signal
  #        name is hclk_i (AHB) or clk_csr_i (other buses).
  #    - description: The master bus interface clock. Only required in
  #        configurations that use a separate clock for the master and
  #        slave bus interfaces. The HW signal name is hclk_i (AHB) or
  #        aclk_i (AXI).
  #    - description: The PTP reference clock. The HW signal name is
  #        clk_ptp_ref_i.
  #    - description: This clock is deprecated and should not be used by
  #        new compatible values. It is equivalent to "tx".
  #    - description: This clock is deprecated and should not be used by
  #        new compatible values. It is equivalent to "slave_bus".

  #clock-names:
  #  items:
  #    - const: tx
  #    - const: rx
  #    - const: slave_bus
  #    - const: master_bus
  #    - const: ptp_ref
  #    - const: phy_ref_clk
  #    - const: apb_pclk

  #interrupts:
  #  description: Should contain the core's combined interrupt signal.

  dma-coherent: true

  phy-reset-gpios:
    description: phandle and specifier for any GPIO used to reset the PHY

  snps,en-lpi:
    $ref: /schemas/types.yaml#/definitions/flag
    description: If present it enables use of the AXI low-power
      interface.

  snps,write-requests:
    $ref: /schemas/types.yaml#/definitions/uint32
    description: Number of write requests that the AXI port can issue.
      It depends on the SoC configuration.

  snps,read-requests:
    $ref: /schemas/types.yaml#/definitions/uint32
    description: Number of read requests that the AXI port can issue.
      It depends on the SoC configuration.

  snps,burst-map:
    $ref: /schemas/types.yaml#/definitions/uint32
    description: Bitmap of allowed AXI burst lengts, with the LSB
      representing 4, then 8 etc.

  snps,txpbl:
    $ref: /schemas/types.yaml#/definitions/uint32
    description: DMA Programmable burst length for the TX DMA

  snps,rxpbl:
    $ref: /schemas/types.yaml#/definitions/uint32
    description: DMA Programmable burst length for the RX DMA

  snps,en-tx-lpi-clockgating:
    $ref: /schemas/types.yaml#/definitions/flag
    description: Enable gating of the MAC TX clock during TX low-power
      mode.

  mdio:
    $ref: mdio.yaml#

allOf:
  - $ref: ethernet-controller.yaml#

additionalProperties: true

#examples:
#  - |
#    #include <dt-bindings/gpio/gpio.h>
#
#    ethernet2@40010000 {
#        clock-names = "phy_ref_clk", "apb_pclk";
#        clocks = <&clkc 17>, <&clkc 15>;
#        compatible = "snps,dwc-qos-ethernet-4.10";
#        interrupt-parent = <&intc>;
#        interrupts = <0x0 0x1e 0x4>;
#        reg = <0x40010000 0x4000>;
#        phy-handle = <&phy2>;
#        phy-mode = "gmii";
#        phy-reset-gpios = <&gpioctlr 43 GPIO_ACTIVE_LOW>;
#
#        snps,en-tx-lpi-clockgating;
#        snps,en-lpi;
#        snps,write-requests = <2>;
#        snps,read-requests = <16>;
#        snps,burst-map = <0x7>;
#        snps,txpbl = <8>;
#        snps,rxpbl = <2>;
#
#        dma-coherent;
#
#        mdio {
#            #address-cells = <0x1>;
#            #size-cells = <0x0>;
#            phy2: phy@1 {
#                    compatible = "ethernet-phy-ieee802.3-c22";
#                    device_type = "ethernet-phy";
#                    reg = <0x1>;
#            };
#        };
#    };
```
