## Documentation/devicetree/bindings/mfd/ti,palmas.yaml
```yaml
# SPDX-License-Identifier: GPL-2.0-only
%YAML 1.2
---
$id: http://devicetree.org/schemas/mfd/ti,palmas.yaml#
$schema: http://devicetree.org/meta-schemas/core.yaml#

title: Texas Instruments Palmas family of Power-Management ICs

maintainers:
  - Lee Jones <lee.jones@linaro.org>

properties:
  compatible:
    items:
      - enum:
          - ti,twl6035
          - ti,twl6036
          - ti,twl6037
          - ti,tps65913
          - ti,tps65914
          - ti,tps80036
          - ti,tps659038
          - ti,tps65917
      - const: ti,palmas

  reg:
    maxItems: 1

  interrupts:
    maxItems: 1

  interrupt-controller:
    description: The Palmas chip has its own internal IRQs.

  "#interrupt-cells":
    description: The first cell is the IRQ number and the second cell is the flags, encoded as the
      trigger mask from ../interrupt-controller/interrupts.txt.
    const: 2

  pinctrl-names: true

  ti,mux-pad1:
    $ref: /schemas/types.yaml#/definitions/uint32
    description: Set the pad register 1 to the correct muxing for the hardware. Otherwise the
     muxing will be obtained from OTP.

  ti,mux-pad2:
    $ref: /schemas/types.yaml#/definitions/uint32
    description: Set the pad register 2 to the correct muxing for the hardware. Otherwise the
     muxing will be obtained from OTP.

  ti,power-ctrl:
    $ref: /schemas/types.yaml#/definitions/flag
    description: Specifies the value to program into the POWER_CTRL register.

  ti,system-power-controller:
    $ref: /schemas/types.yaml#/definitions/flag
    description: Specifies whether or not this PMIC is controlling the system power.

  ti,palmas-override-powerhold:
    $ref: /schemas/types.yaml#/definitions/flag
    description: This is applicable for PMICs for which GPIO7 is configured in POWERHOLD mode
      which has higher priority over DEV_ON bit and keeps the PMIC supplies on even after the
      DEV_ON bit is turned off. This property enables driver to over ride the POWERHOLD value to
      GPIO7 so as to turn off the PMIC in power off scenarios. So for GPIO7 if this property is
      set then the GPIO_7 field should never be muxed to anything else. It should be set to
      POWERHOLD by default and only in case of power off scenarios the driver will over ride the
      mux value.

patternProperties:
  "^(palmas_)?adc$":
    $ref: ../iio/adc/ti,palmas-gpadc.yaml

  "^(palmas_)?(clk32k|clk32kg|clk32kgaudio)$":
    $ref: ../clock/ti,palmas-clk32k.yaml

  "^(palmas_)?gpio$":
    $ref: ../gpio/ti,palmas-gpio.yaml

  "^(palmas_)?(pinctrl|pinmux)$":
    $ref: ../pinctrl/ti,palmas-pinctrl.yaml

  "^(palmas_)?pmic$":
    $ref: ../regulator/ti,palmas-pmic.yaml

  "^(palmas_)?pwrbutton$":
    $ref: ../input/ti,palmas-pwrbutton.yaml

  "^(palmas_)?rtc$":
    $ref: ../rtc/ti,palmas-rtc.yaml

  "^(palmas_)?usb$":
    $ref: ../extcon/ti,palmas-usb-vid.yaml

  "^pinctrl-[0-9]+$": true

additionalProperties: false

required:
  - compatible
  - reg
  - interrupt-controller
  - "#interrupt-cells"

examples:
  - |
    #include <dt-bindings/interrupt-controller/irq.h>

    i2c {
      #address-cells = <1>;
      #size-cells = <0>;

      pmic@48 {
        compatible = "ti,twl6035", "ti,palmas";
        reg = <0x48>;
        interrupts = <16 IRQ_TYPE_LEVEL_LOW>;
        interrupt-parent = <&intc>;
        interrupt-controller;
        #interrupt-cells = <2>;

        ti,mux-pad1 = <0>;
        ti,mux-pad2 = <0>;

        pmic {
          compatible = "ti,twl6035-pmic", "ti,palmas-pmic";
        };
      };
    };
```

## Documentation/devicetree/bindings/mfd/ti,tps65910.yaml
```yaml
# SPDX-License-Identifier: GPL-2.0-only
%YAML 1.2
---
$id: http://devicetree.org/schemas/mfd/ti,tps65910.yaml#
$schema: http://devicetree.org/meta-schemas/core.yaml#

title: Texas Instruments TPS65910 Power-Management Integrated Circuit

maintainers:
  - Lee Jones <lee.jones@linaro.org>

properties:
  compatible:
    enum:
      - ti,tps65910
      - ti,tps65911

  reg:
    maxItems: 1

  interrupts:
    maxItems: 1

  interrupt-controller:
    description: Marks this device as interrupt provider.

  "#interrupt-cells":
    const: 2

  wakeup-source:
    description: device can wake the system from suspend

  ti,vmbch-threshold:
    $ref: /schemas/types.yaml#/definitions/uint32
    description: main battery charged threshold comparator (TPS65911, see VMBCH_VSEL in TPS65910
      datasheet)

  ti,vmbch2-threshold:
    $ref: /schemas/types.yaml#/definitions/uint32
    description: main battery discharged threshold comparator (TPS65911, see VMBCH_VSEL in
      TPS65910 datasheet)

  ti,en-ck32k-xtal:
    $ref: /schemas/types.yaml#/definitions/flag
    description: enable external 32-kHz crystal oscillator (see CK32K_CTRL in TPS6591X datasheet)

  ti,en-gpio-sleep:
    $ref: /schemas/types.yaml#/definitions/uint32-array
    description: Enable sleep control for GPIOs. There should be 9 entries here, one for each
      GPIO.
    minItems: 1
    maxItems: 9

  ti,system-power-controller:
    $ref: /schemas/types.yaml#/definitions/flag
    description: If present, specifies that this PMIC controls the system power.

  ti,sleep-enable:
    $ref: /schemas/types.yaml#/definitions/flag
    description: enable SLEEP state

  ti,sleep-keep-therm:
    $ref: /schemas/types.yaml#/definitions/flag
    description: keep thermal monitoring on in sleep state

  ti,sleep-keep-ck32k:
    $ref: /schemas/types.yaml#/definitions/flag
    description: keep the 32KHz clock output on in sleep state

  ti,sleep-keep-hsclk:
    $ref: /schemas/types.yaml#/definitions/flag
    description: keep high speed internal clock on in sleep state

  regulators:
    description: |
      This is the list of child nodes that specify the regulator initialization data for defined
      regulators. Not all regulators for the given device need to be present. The definition for
      each of these nodes is defined using the standard binding for regulators found at
      Documentation/devicetree/bindings/regulator/regulator.txt.

      The regulator is matched with the regulator-compatible.

      The valid regulator-compatible values are:

        tps65910: vrtc, vio, vdd1, vdd2, vdd3, vdig1, vdig2, vpll, vdac, vaux1, vaux2, vaux33,
          vmmc, vbb

        tps65911: vrtc, vio, vdd1, vdd2, vddctrl, ldo1, ldo2, ldo3, ldo4, ldo5, ldo6, ldo7, ldo8

    patternProperties:
      # TPS65910
      "^vrtc|vio|vdd1|vdd2|vdd3|vdig1|vdig2|vpll|vdac|vaux1|vaux2|vaux33|vmmc|vbb$":
        $ref: ../regulator/regulator.yaml
        properties:
          ti,regulator-ext-sleep-control:
            $ref: /schemas/types.yaml#/definitions/uint32
            description: Enable external sleep control through external inputs.
            oneOf:
              - description: not enabled
                const: 0
              - description: EN1
                const: 1
              - description: EN2
                const: 2
              - description: EN3
                const: 4
              - description: SLEEP
                const: 8
            default: 0

      # TPS65911
      "^vrtc|vio|vdd1|vdd2|vddctrl|ldo1|ldo2|ldo3|ldo4|ldo5|ldo6|ldo7|ldo8$":
        $ref: ../regulator/regulator.yaml
        properties:
          ti,regulator-ext-sleep-control:
            $ref: /schemas/types.yaml#/definitions/uint32
            description: Enable external sleep control through external inputs.
            oneOf:
              - description: not enabled
                const: 0
              - description: EN1
                const: 1
              - description: EN2
                const: 2
              - description: EN3
                const: 4
              - description: SLEEP
                const: 8
            default: 0

patternProperties:
  "^(hog-[0-9]+|.+-hog(-[0-9]+)?)$":
    $ref: /schemas/gpio/gpio-hog.yaml#

allOf:
  #- $ref: /schemas/interrupt-controller.yaml
  - $ref: /schemas/gpio/gpio.yaml
  - if:
      properties:
        compatible:
          contains:
            const: ti,tps65910
    then:
      properties:
        vcc1-supply:
          description: VDD1 input

        vcc2-supply:
          description: VDD2 input

        vcc3-supply:
          description: VAUX33 and VMMC input

        vcc4-supply:
          description: VAUX1 and VAUX2 input

        vcc5-supply:
          description: VPLL and VDAC input

        vcc6-supply:
          description: VDIG1 and VDIG2 input

        vcc7-supply:
          description: VRTC and VBB input

        vccio-supply:
          description: VIO input

  - if:
      properties:
        compatible:
          contains:
            const: ti,tps65911
    then:
      properties:
        vcc1-supply:
          description: VDD1 input

        vcc2-supply:
          description: VDD2 input

        vcc3-supply:
          description: LDO6, LDO7 and LDO8 input

        vcc4-supply:
          description: LDO5 input

        vcc5-supply:
          description: LDO3 and LDO4 input

        vcc6-supply:
          description: LDO1 and LDO2 input

        vcc7-supply:
          description: VRTC input

        vccio-supply:
          description: VIO input

unevaluatedProperties: false

required:
  - compatible
  - reg
  - interrupts

examples:
  - |
    i2c {
      #address-cells = <1>;
      #size-cells = <0>;

      tps65910@2d {
        compatible = "ti,tps65910";
        reg = <0x2d>;
        interrupt-parent = <&intc>;
        interrupts = < 0 118 0x04 >;

        #gpio-cells = <2>;
        gpio-controller;

        #interrupt-cells = <2>;
        interrupt-controller;

        ti,system-power-controller;

        ti,vmbch-threshold = <0>;
        ti,vmbch2-threshold = <0>;
        ti,en-ck32k-xtal;
        ti,en-gpio-sleep = <0 0 1 0 0 0 0 0 0>;

        vcc1-supply = <&dummy>;
        vcc2-supply = <&dummy>;
        vcc3-supply = <&dummy>;
        vcc4-supply = <&dummy>;
        vcc5-supply = <&dummy>;
        vcc6-supply = <&dummy>;
        vcc7-supply = <&dummy>;
        vccio-supply = <&dummy>;

        regulators {
          #address-cells = <1>;
          #size-cells = <0>;

          vdd1_reg: regulator@0 {
            regulator-compatible = "vdd1";
            reg = <0>;
            regulator-min-microvolt = < 600000>;
            regulator-max-microvolt = <1500000>;
            regulator-always-on;
            regulator-boot-on;
            ti,regulator-ext-sleep-control = <0>;
          };

          vdd2_reg: regulator@1 {
            regulator-compatible = "vdd2";
            reg = <1>;
            regulator-min-microvolt = < 600000>;
            regulator-max-microvolt = <1500000>;
            regulator-always-on;
            regulator-boot-on;
            ti,regulator-ext-sleep-control = <4>;
          };

          vddctrl_reg: regulator@2 {
            regulator-compatible = "vddctrl";
            reg = <2>;
            regulator-min-microvolt = < 600000>;
            regulator-max-microvolt = <1400000>;
            regulator-always-on;
            regulator-boot-on;
            ti,regulator-ext-sleep-control = <0>;
          };

          vio_reg: regulator@3 {
            regulator-compatible = "vio";
            reg = <3>;
            regulator-min-microvolt = <1500000>;
            regulator-max-microvolt = <1800000>;
            regulator-always-on;
            regulator-boot-on;
            ti,regulator-ext-sleep-control = <1>;
          };

          ldo1_reg: regulator@4 {
            regulator-compatible = "ldo1";
            reg = <4>;
            regulator-min-microvolt = <1000000>;
            regulator-max-microvolt = <3300000>;
            ti,regulator-ext-sleep-control = <0>;
          };

          ldo2_reg: regulator@5 {
            regulator-compatible = "ldo2";
            reg = <5>;
            regulator-min-microvolt = <1050000>;
            regulator-max-microvolt = <1050000>;
            ti,regulator-ext-sleep-control = <0>;
          };

          ldo3_reg: regulator@6 {
            regulator-compatible = "ldo3";
            reg = <6>;
            regulator-min-microvolt = <1000000>;
            regulator-max-microvolt = <3300000>;
            ti,regulator-ext-sleep-control = <0>;
          };

          ldo4_reg: regulator@7 {
            regulator-compatible = "ldo4";
            reg = <7>;
            regulator-min-microvolt = <1000000>;
            regulator-max-microvolt = <3300000>;
            regulator-always-on;
            ti,regulator-ext-sleep-control = <0>;
          };

          ldo5_reg: regulator@8 {
            regulator-compatible = "ldo5";
            reg = <8>;
            regulator-min-microvolt = <1000000>;
            regulator-max-microvolt = <3300000>;
            ti,regulator-ext-sleep-control = <0>;
          };

          ldo6_reg: regulator@9 {
            regulator-compatible = "ldo6";
            reg = <9>;
            regulator-min-microvolt = <1200000>;
            regulator-max-microvolt = <1200000>;
            ti,regulator-ext-sleep-control = <0>;
          };

          ldo7_reg: regulator@10 {
            regulator-compatible = "ldo7";
            reg = <10>;
            regulator-min-microvolt = <1200000>;
            regulator-max-microvolt = <1200000>;
            regulator-always-on;
            regulator-boot-on;
            ti,regulator-ext-sleep-control = <1>;
          };

          ldo8_reg: regulator@11 {
            regulator-compatible = "ldo8";
            reg = <11>;
            regulator-min-microvolt = <1000000>;
            regulator-max-microvolt = <3300000>;
            regulator-always-on;
            ti,regulator-ext-sleep-control = <1>;
          };
        };
      };
    };
```
