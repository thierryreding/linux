## Documentation/devicetree/bindings/memory-controllers/memory-controller.yaml
```yaml
# SPDX-License-Identifier: (GPL-2.0-only OR BSD-2-Clause)
%YAML 1.2
---
$id: http://devicetree.org/schemas/memory-controllers/memory-controller.yaml#
$schema: http://devicetree.org/meta-schemas/core.yaml#

title: Common memory controller binding

maintainers:
  - Thierry Reding <thierry.reding@gmail.com>

description: |
  The memory access hierarchy in a modern device can be fairly complicated.
  Accesses to system memory typically end up going through a memory controller
  that ensures that data is stored. Along the way, these accesses can undergo
  classification and be prioritized and/or arbitrated.

  The interconnect bindings (see ../interconnect/interconnect.txt) provides a
  way of describing the data paths between devices and system memory. However
  these interconnect paths, in order to be most flexible, describe the paths
  in a very fine-grained way, so situations can arise where it is no longer
  possible to derive a unique memory parent for any given device.

  In order to remove such potential ambiguities, a memory controller can be
  specified in device tree. A memory controller specified in this way will be
  used as the DMA parent for a given device. The memory controller defines a
  memory bus via the "dma-ranges" property, which will in turn be used to set
  the range of memory accessible to DMA children of the memory controller.

properties:
  "#memory-controller-cells": true
  dma-ranges: true
```

## Documentation/devicetree/bindings/mfd/ams,as3722.yaml
```yaml
# SPDX-License-Identifier: GPL-2.0-only
%YAML 1.2
---
$id: http://devicetree.org/schemas/mfd/ams,as3722.yaml#
$schema: http://devicetree.org/meta-schemas/core.yaml#

title: AMS AS3722 Power Management IC

maintainers:
  - Laxman Dewangan <ldewangan@nvidia.com>
  - Lee Jones <lee.jones@linaro.org>

properties:
  compatible:
    const: ams,as3722

  reg:
    maxItems: 1

  interrupts:
    maxItems: 1

  # standard properties
  interrupt-controller:
    description: The AS3722 has an internal interrupt controller which takes the interrupt request
      from internal sub-blocks like RTC, regulators, GPIOs as well as external input.

  "#interrupt-cells":
    description: The first cell is the IRQ number. IRQ numbers for different interrupt source of
      AS3722 are defined at dt-bindings/mfd/as3722.h The second cell is the flags, encoded as the
      trigger masks from binding document interrupts.txt, using dt-bindings/irq.
    const: 2

  # from gpio.yaml
  gpio-controller: true
  "#gpio-cells": true

  # optional properties
  ams,enable-internal-int-pullup:
    $ref: /schemas/types.yaml#/definitions/flag
    description: Boolean property, to enable internal pullup on interrupt pin. Omitting this will
      disable internal pullup on INT pin.

  ams,enable-internal-i2c-pullup:
    $ref: /schemas/types.yaml#/definitions/flag
    description: Boolean property, to enable internal pullup on I2C SCL/SDA pins. Omitting this
      will disable internal pullup on I2C SCL/SDA lines.

  ams,enable-ac-ok-power-on:
    $ref: /schemas/types.yaml#/definitions/flag
    description: Boolean property, to enable exit out of power off mode with AC_OK pin (pin
      enabled in power off mode).

  ams,system-power-controller:
    $ref: /schemas/types.yaml#/definitions/flag
    description: The AS3722 supports the system power off by turning off all its rails. The device
      node should contain this boolean property to enable this functionality.

  pinmux:
    type: object
    description: |
      Device has 8 GPIO pins which can be configured as GPIO as well as the special IO functions.

      Please refer to pinctrl-bindings.txt in this directory for details of the common pinctrl
      bindings used by client devices, including the meaning of the phrase "pin configuration
      node".

    patternProperties:
      "^gpio[0-7_]+$":
        description: |
          Child nodes of the pinmux node represent some desired configuration for a list of pins.
          This configuration can include the mux function to select on those pin(s), and various
          pin configuration parameters, such as pull-up, open drain.
        type: object
        properties:
          pins:
            $ref: /schemas/types.yaml#/definitions/string-array
            description: List of pins for this configuration group.
            items:
              enum: [ gpio0, gpio1, gpio2, gpio3, gpio4, gpio5, gpio6, gpio7 ]

          function:
            $ref: /schemas/types.yaml#/definitions/string
            description: Function configuration for this configuration group.
            enum: [ gpio, interrupt-out, gpio-in-interrupt, vsup-vbat-low-undebounce-out,
                    vsup-vbat-low-debounce-out, voltage-in-standby, oc-pg-sd0, oc-pg-sd6,
                    powergood-out, pwm-in, pwm-out, clk32k-out, watchdog-in, soft-reset-in ]

          bias-disable:
            $ref: /schemas/types.yaml#/definitions/flag

          bias-pull-up:
            $ref: /schemas/types.yaml#/definitions/flag

          bias-pull-down:
            $ref: /schemas/types.yaml#/definitions/flag

          bias-high-impedance:
            $ref: /schemas/types.yaml#/definitions/flag

          drive-open-drain:
            $ref: /schemas/types.yaml#/definitions/flag

        additionalProperties: false

        required:
          - pins

  regulators:
    type: object
    description: Device has multiple DCDC and LDOs. The node "regulators" is require if regulator
      functionality is needed.

    properties:
      vsup-sd2-supply:
        description: input supply for SD2

      vsup-sd3-supply:
        description: input supply for SD3

      vsup-sd4-supply:
        description: input supply for SD4

      vsup-sd5-supply:
        description: input supply for SD5

      vin-ldo0-supply:
        description: input supply for LDO0

      vin-ldo1-6-supply:
        description: input supply for LDO1 and LDO6

      vin-ldo2-5-7-supply:
        description: input supply for LDO2, LDO5 and LDO7

      vin-ldo3-4-supply:
        description: input supply for LDO3 and LDO4

      vin-ldo9-10-supply:
        description: input supply for LDO9 and LDO10

      vin-ldo11-supply:
        description: input supply for LDO11

    patternProperties:
      "^(sd[0-6]|ldo[0-7]|ldo9|ldo10|ldo11)$":
        type: object
        description: These sub-nodes must be named after one of the regulators found on the AS3277.
          Each sub-node should contain the constraints and initialization information for that
          regulator. See regulator.txt for a description of standard properties for these
          sub-nodes.

        properties:
          ams,ext-control:
            $ref: /schemas/types.yaml#/definitions/uint32
            description: External control of the rail. The option of this properties will tell
              which external input is controlling this rail. Valid values are 0, 1, 2 ad 3. If
              this property does not exist, the default value is 0. The external control pin
              macros are defined in dt-bindings/mfd/as3722.h.
            oneOf:
              - description: there is no external control of this rail
                const: 0
              - description: rail is controlled by ENABLE1 input pin
                const: 1
              - description: rail is controlled by ENABLE2 input pin
                const: 2
              - description: rail is controlled by ENABLE3 input pin
                const: 3

          ams,enable-tracking:
            $ref: /schemas/types.yaml#/definitions/flag
            description: Enable tracking with SD1, only supported by LDO3.

additionalProperties: false

required:
  - compatible
  - reg
  - interrupt-controller
  - "#interrupt-cells"

allOf:
  - $ref: /schemas/gpio/gpio.yaml

examples:
  - |
    #include <dt-bindings/mfd/as3722.h>

    i2c {
      #address-cells = <1>;
      #size-cells = <0>;

      pmic@48 {
        compatible = "ams,as3722";
        reg = <0x48>;

        ams,system-power-controller;

        interrupt-parent = <&intc>;
        interrupt-controller;
        #interrupt-cells = <2>;

        gpio-controller;
        #gpio-cells = <2>;

        pinctrl-names = "default";
        pinctrl-0 = <&as3722_default>;

        as3722_default: pinmux {
          gpio0 {
            pins = "gpio0";
            function = "gpio";
            bias-pull-down;
          };

          gpio1_2_4_7 {
            pins = "gpio1", "gpio2", "gpio4", "gpio7";
            function = "gpio";
            bias-pull-up;
          };

          gpio5 {
            pins = "gpio5";
            function = "clk32k-out";
          };
        };

        regulators {
          vsup-sd2-supply = <&vdd_5v0_sys>;

          sd0 {
            regulator-name = "vdd_cpu";
            regulator-min-microvolt = <700000>;
            regulator-max-microvolt = <1400000>;
            regulator-always-on;
            ams,ext-control = <2>;
          };

          sd1 {
            regulator-name = "vdd_core";
            regulator-min-microvolt = <700000>;
            regulator-max-microvolt = <1400000>;
            regulator-always-on;
            ams,ext-control = <1>;
          };

          sd2 {
            regulator-name = "vddio_ddr";
            regulator-min-microvolt = <1350000>;
            regulator-max-microvolt = <1350000>;
            regulator-always-on;
          };

          sd4 {
            regulator-name = "avdd-hdmi-pex";
            regulator-min-microvolt = <1050000>;
            regulator-max-microvolt = <1050000>;
            regulator-always-on;
          };

          sd5 {
            regulator-name = "vdd-1v8";
            regulator-min-microvolt = <1800000>;
            regulator-max-microvolt = <1800000>;
            regulator-always-on;
          };
        };
      };
    };
```

## Documentation/devicetree/bindings/mfd/st,stmpe.yaml
```yaml
# SPDX-License-Identifier: GPL-2.0-only
%YAML 1.2
---
$id: http://devicetree.org/schemas/mfd/st,stmpe.yaml#
$schema: http://devicetree.org/meta-schemas/core.yaml#

title: ST Microelectronics STMPE Multi-Functional Device

maintainers:
  - Lee Jones <lee.jones@linaro.org>

description: |
  STMPE is an MFD device which may expose the following inbuilt devices: gpio, keypad,
  touchscreen, adc, pwm, rotator.

properties:
  compatible:
    enum:
      - st,stmpe610
      - st,stmpe801
      - st,stmpe811
      - st,stmpe1600
      - st,stmpe1601
      - st,stmpe2401
      - st,stmpe2403

  reg:
    maxItems: 1

  interrupts:
    maxItems: 1

  interrupt-controller:
    description: marks the device as an interrupt provider

  wakeup-source:
    description: marks the input device as wakable

  st,autosleep-timeout:
    $ref: /schemas/types.yaml#/definitions/uint32
    description: auto-sleep timeout (in ms)
    enum: [ 4, 16, 32, 64, 128, 256, 512, 1024 ]

  irq-gpio:
    description: if present, specifies which GPIO to use for event IRQ

  # Optional properties for devices with touch and ADC (STMPE811|STMPE610):
  st,sample-time:
    $ref: /schemas/types.yaml#/definitions/uint32
    description: ADC conversion time in number of clocks
    oneOf:
      - description: 36 clocks
        const: 0
      - description: 44 clocks
        const: 1
      - description: 56 clocks
        const: 2
      - description: 64 clocks
        const: 3
      - description: 80 clocks (recommended)
        const: 4
      - description: 96 clocks
        const: 5
      - description: 124 clocks
        const: 6

  st,mod-12b:
    $ref: /schemas/types.yaml#/definitions/uint32
    description: ADC bit mode
    oneOf:
      - description: 10 bit ADC
        const: 0
      - description: 12 bit ADC
        const: 1

  st,ref-sel:
    $ref: /schemas/types.yaml#/definitions/uint32
    description: ADC reference source
    oneOf:
      - description: internal
        const: 0
      - description: extenal
        const: 1

  st,adc-freq:
    $ref: /schemas/types.yaml#/definitions/uint32
    description: ADC clock speed
    oneOf:
      - description: 1.625 MHz
        const: 0
      - description: 3.25 MHz
        const: 1
      - description: 6.5 MHz
        const: 2
      - description: 6.5 MHz
        const: 3

  stmpe_adc:
    $ref: ../iio/adc/st,stmpe-adc.yaml

  stmpe_gpio:
    $ref: ../gpio/st,stmpe-gpio.yaml

  stmpe_keypad:
    $ref: ../input/st,stmpe-keypad.yaml

  stmpe_pwm:
    $ref: ../pwm/st,stmpe-pwm.yaml

  stmpe_touchscreen:
    $ref: ../input/touchscreen/st,stmpe-ts.yaml

additionalProperties: false

required:
  - compatible
  - reg
  - interrupt-controller

examples:
  - |
    i2c {
      #address-cells = <1>;
      #size-cells = <0>;

      stmpe1601@40 {
        compatible = "st,stmpe1601";
        reg = <0x40>;
        interrupts = <26 0x4>;
        interrupt-parent = <&gpio6>;
        interrupt-controller;

        wakeup-source;
        st,autosleep-timeout = <1024>;
      };
    };
```
