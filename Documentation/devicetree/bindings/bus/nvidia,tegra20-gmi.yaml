## Documentation/devicetree/bindings/clock/nvidia,tegra124-dfll.yaml
```yaml
# SPDX-License-Identifier: (GPL-2.0+ OR BSD-2-Clause)
%YAML 1.2
---
$id: http://devicetree.org/schemas/clock/nvidia,tegra124-dfll.yaml#
$schema: http://devicetree.org/meta-schemas/core.yaml#

title: NVIDIA Tegra124 (and later) DFLL FCPU clocksource

maintainers:
  - Thierry Reding <thierry.reding@gmail.com>
  - Jon Hunter <jonathanh@nvidia.com>

description:
  The DFLL IP block on Tegra is a root clocksource designed for clocking
  the fast CPU cluster. It consists of a free-running voltage controlled
  oscillator connected to the CPU voltage rail (VDD_CPU), and a closed
  loop control module that will automatically adjust the VDD_CPU voltage
  by communicating with an off-chip PMIC either via an I2C bus or via
  PWM signals.

properties:
  compatible:
    enum:
      - nvidia,tegra124-dfll
      - nvidia,tegra210-dfll

  reg:
    items:
      - description: DFLL control logic
      - description: I2C output logic
      - description: integrated I2C controller
      - description: look-up table RAM for voltage register values

  interrupts:
    maxItems: 1

  clocks:
    items:
      - description: clock source for the DFLL control logic
      - description: closed loop reference clock
      - description: clock source for the integrated I2C controller

  clock-names:
    items:
      - const: soc
      - const: ref
      - const: i2c

  resets:
    minItems: 1
    maxItems: 2

  reset-names:
    minItems: 1
    maxItems: 2

  "#clock-cells":
    const: 0

  clock-output-names:
    description: name of the clock output

  vdd-cpu-supply:
    description: Regulator for the CPU voltage rail that the DFLL
      hardware will start controlling. The regulator will be queried for
      the I2C register, control values and supported voltages.

  nvidia,sample-rate:
    description: Sample rate of the DFLL control loop.
    $ref: /schemas/types.yaml#/definitions/uint32

  nvidia,droop-ctrl:
    description: See the register CL_DVFS_DROOP_CTRL in the TRM.
    $ref: /schemas/types.yaml#/definitions/uint32

  nvidia,force-mode:
    description: See the field DFLL_PARAMS_FORCE_MODE in the TRM.
    $ref: /schemas/types.yaml#/definitions/uint32

  nvidia,cf:
    description: Numeric value, see the field DFLL_PARAMS_CF_PARAM in
      the TRM.
    $ref: /schemas/types.yaml#/definitions/uint32

  nvidia,ci:
    description: Numeric value, see the field DFLL_PARAMS_CI_PARAM in
      the TRM.
    $ref: /schemas/types.yaml#/definitions/uint32

  nvidia,cg:
    description: Numeric value, see the field DFLL_PARAMS_CG_PARAM in
      the TRM.
    $ref: /schemas/types.yaml#/definitions/uint32

  # optional properties
  nvidia,cg-scale:
    description: Boolean value, see the field DFLL_PARAMS_CG_SCALE in
      the TRM.
    $ref: /schemas/types.yaml#/definitions/flag

  nvidia,pwm-to-pmic:
    description: Use PWM to control regulator rather then I2C.
    $ref: /schemas/types.yaml#/definitions/flag

  nvidia,i2c-fs-rate:
    description: I2C transfer rate, if using full speed mode.
    $ref: /schemas/types.yaml#/definitions/uint32

  # required properties for PWM mode
  nvidia,pwm-period-nanoseconds:
    description: period of PWM square wave in nanoseconds.
    $ref: /schemas/types.yaml#/definitions/uint32

  nvidia,pwm-tristate-microvolts:
    description: Regulator voltage in micro volts when PWM control is
      disabled and the PWM output is tristated. Note that this voltage
      is configured in hardware, typically via a resistor divider.
    $ref: /schemas/types.yaml#/definitions/uint32

  nvidia,pwm-min-microvolts:
    description: Regulator voltage in micro volts when PWM control is
      enabled and PWM output is low. Hence, this is the minimum output
      voltage that the regulator supports when PWM control is enabled.
    $ref: /schemas/types.yaml#/definitions/uint32

  nvidia,pwm-voltage-step-microvolts:
    description: |
      Voltage increase in micro volts corresponding to a 1/33th increase
      in duty cycle. Eg the voltage for 2/33th duty cycle would be:

        nvidia,pwm-min-microvolts + nvidia,pwm-voltage-step-microvolts * 2
    $ref: /schemas/types.yaml#/definitions/uint32

  pinctrl-names:
    items:
      # I/O pad configuration when PWM control is enabled
      - const: dvfs_pwm_enable
      # I/O pad configuration when PWM control is disabled
      - const: dvfs_pwm_disable

  pinctrl-0: true
  pinctrl-1: true

allOf:
  - if:
      properties:
        compatible:
          contains:
            const: nvidia,tegra124-dfll
    then:
      properties:
        resets:
          items:
            - description: DFLL DVCO reset

        reset-names:
          items:
            - const: dvco

  - if:
      properties:
        compatible:
          contains:
            const: nvidia,tegra210-dfll
    then:
      properties:
        resets:
          items:
            - description: DFLL DVCO reset
            - description: DFLL reset

        reset-names:
          items:
            - const: dvco
            - const: dfll

additionalProperties: false

examples:
  - |
    #include <dt-bindings/clock/tegra124-car.h>
    #include <dt-bindings/interrupt-controller/arm-gic.h>
    #include <dt-bindings/pinctrl/pinctrl-tegra.h>
    #include <dt-bindings/reset/tegra124-car.h>

    clock@70110000 {
        compatible = "nvidia,tegra124-dfll";
        reg = <0x70110000 0x100>, /* DFLL control */
              <0x70110000 0x100>, /* I2C output control */
              <0x70110100 0x100>, /* Integrated I2C controller */
              <0x70110200 0x100>; /* Look-up table RAM */
        interrupts = <GIC_SPI 62 IRQ_TYPE_LEVEL_HIGH>;
        clocks = <&tegra_car TEGRA124_CLK_DFLL_SOC>,
                 <&tegra_car TEGRA124_CLK_DFLL_REF>,
                 <&tegra_car TEGRA124_CLK_I2C5>;
        clock-names = "soc", "ref", "i2c";
        resets = <&tegra_car TEGRA124_RST_DFLL_DVCO>;
        reset-names = "dvco";
        #clock-cells = <0>;
        clock-output-names = "dfllCPU_out";
        vdd-cpu-supply = <&vdd_cpu>;

        nvidia,sample-rate = <12500>;
        nvidia,droop-ctrl = <0x00000f00>;
        nvidia,force-mode = <1>;
        nvidia,cf = <10>;
        nvidia,ci = <0>;
        nvidia,cg = <2>;

        nvidia,i2c-fs-rate = <400000>;
    };

  - |
    #include <dt-bindings/clock/tegra210-car.h>
    #include <dt-bindings/interrupt-controller/arm-gic.h>
    #include <dt-bindings/pinctrl/pinctrl-tegra.h>
    #include <dt-bindings/reset/tegra210-car.h>

    clock@70110000 {
        compatible = "nvidia,tegra210-dfll";
        reg = <0x70110000 0x100>, /* DFLL control */
              <0x70110000 0x100>, /* I2C output control */
              <0x70110100 0x100>, /* Integrated I2C controller */
              <0x70110200 0x100>; /* Look-up table RAM */
        interrupts = <GIC_SPI 62 IRQ_TYPE_LEVEL_HIGH>;
        clocks = <&tegra_car TEGRA210_CLK_DFLL_SOC>,
                 <&tegra_car TEGRA210_CLK_DFLL_REF>,
                 <&tegra_car TEGRA210_CLK_I2C5>;
        clock-names = "soc", "ref", "i2c";
        resets = <&tegra_car TEGRA210_RST_DFLL_DVCO>,
                 <&tegra_car 155>;
        reset-names = "dvco", "dfll";
        #clock-cells = <0>;
        clock-output-names = "dfllCPU_out";

        nvidia,sample-rate = <25000>;
        nvidia,droop-ctrl = <0x00000f00>;
        nvidia,force-mode = <1>;
        nvidia,cf = <6>;
        nvidia,ci = <0>;
        nvidia,cg = <2>;

        nvidia,pwm-min-microvolts = <708000>; /* 708mV */
        nvidia,pwm-period-nanoseconds = <2500>; /* 2.5us */
        nvidia,pwm-to-pmic;
        nvidia,pwm-tristate-microvolts = <1000000>;
        nvidia,pwm-voltage-step-microvolts = <19200>; /* 19.2mV */

        pinctrl-names = "dvfs_pwm_enable", "dvfs_pwm_disable";
        pinctrl-0 = <&dvfs_pwm_active_state>;
        pinctrl-1 = <&dvfs_pwm_inactive_state>;
    };

    /*
     * pinmux nodes added for completeness. Binding doc can be found in:
     * Documentation/devicetree/bindings/pinctrl/nvidia,tegra210-pinmux.yaml
     */

    pinmux: pinmux@700008d4 {
        compatible = "nvidia,tegra210-pinmux";
        reg = <0x700008d4 0x29c>, /* Pad control registers */
              <0x70003000 0x294>; /* Mux registers */

        dvfs_pwm_active_state: dvfs_pwm_active {
            dvfs_pwm_pbb1 {
                nvidia,pins = "dvfs_pwm_pbb1";
                nvidia,tristate = <TEGRA_PIN_DISABLE>;
            };
        };

        dvfs_pwm_inactive_state: dvfs_pwm_inactive {
            dvfs_pwm_pbb1 {
                nvidia,pins = "dvfs_pwm_pbb1";
                nvidia,tristate = <TEGRA_PIN_ENABLE>;
            };
        };
    };
```

## Documentation/devicetree/bindings/display/panel/auo,b101ew05.yaml
```yaml
# SPDX-License-Identifier: (GPL-2.0-only OR BSD-2-Clause)
%YAML 1.2
---
$id: http://devicetree.org/schemas/display/panel/auo,b101ew05.yaml#
$schema: http://devicetree.org/meta-schemas/core.yaml#

title: AU Optronics Corporation 10.1" WXGA LVDS panel

maintainers:
  - Thierry Reding <thierry.reding@gmail.com>

properties:
  compatible:
    items:
      - const: auo,b101ew05
      - {} # panel-lvds, but not listed here to avoid false select

  data-mapping:
    const: jeida-18

  width-mm:
    const: 218

  height-mm:
    const: 135

allOf:
  - $ref: panel-lvds.yaml#

unevaluatedProperties: false

examples:
  - |
    display-panel {
      compatible = "auo,b101ew05", "panel-lvds";

      ddc-i2c-bus = <&panel_ddc>;
      power-supply = <&vdd_pnl>;
      backlight = <&backlight>;

      width-mm = <218>;
      height-mm = <135>;

      data-mapping = "jeida-18";

      panel-timing {
        clock-frequency = <71200000>;
        hactive = <1280>;
        vactive = <800>;
        hfront-porch = <8>;
        hback-porch = <18>;
        hsync-len = <184>;
        vsync-len = <3>;
        vfront-porch = <4>;
        vback-porch = <8>;
      };

      port {
        panel_input: endpoint {
          remote-endpoint = <&lvds_encoder_output>;
        };
      };
    };
```
