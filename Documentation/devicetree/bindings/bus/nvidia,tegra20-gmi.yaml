## Documentation/devicetree/bindings/gpu/host1x/nvidia,tegra20-host1x.yaml
```yaml
# SPDX-License-Identifier: (GPL-2.0 OR BSD-2-Clause)
%YAML 1.2
---
$id: "http://devicetree.org/schemas/gpu/host1x/nvidia,tegra20-host1x.yaml#"
$schema: "http://devicetree.org/meta-schemas/core.yaml#"

title: Device tree binding for NVIDIA Host1x

maintainers:
  - Thierry Reding <treding@gmail.com>
  - Mikko Perttunen <mperttunen@nvidia.com>

properties:
  $nodename:
    pattern: "^host1x@[0-9a-f]*$"

  compatible:
    oneOf:
      - const: nvidia,tegra20-host1x
      - const: nvidia,tegra30-host1x
      - const: nvidia,tegra114-host1x
      - const: nvidia,tegra124-host1x
      - items:
          - const: nvidia,tegra132-host1x
          - const: nvidia,tegra124-host1x
      - const: nvidia,tegra210-host1x

  reg:
    maxItems: 1

  interrupts:
    items:
      - description: Syncpoint threshold interrupt
      - description: General interrupt

  interrupt-names:
    items:
      - const: syncpt
      - const: host1x

  clocks:
    maxItems: 1

  clock-names:
    items:
      - const: host1x

  resets:
    maxItems: 1

  reset-names:
    items:
      - const: host1x

  iommus:
    maxItems: 1

  interconnects:
    maxItems: 1

  interconnect-names:
    items:
      - const: dma-mem

  '#address-cells':
    const: 1

  '#size-cells':
    const: 1

  ranges: true

required:
  - compatible
  - reg
  - interrupts
  - interrupt-names
  - clocks
  - clock-names
  - resets
  - reset-names
  - '#address-cells'
  - '#size-cells'
  - ranges

additionalProperties:
  type: object

if:
  properties:
    compatible:
      contains:
        anyOf:
          - const: nvidia,tegra186-host1x
          - const: nvidia,tegra194-host1x
then:
  properties:
    reg:
      items:
        - description: Hypervisor-accessible register area
        - description: VM-accessible register area
    reg-names:
      items:
        - const: hypervisor
        - const: vm
  required:
    - reg-names

examples:
  - |
    #include <dt-bindings/clock/tegra20-car.h>
    #include <dt-bindings/interrupt-controller/arm-gic.h>

    host1x@50000000 {
        compatible = "nvidia,tegra20-host1x";
        reg = <0x50000000 0x00024000>;
        interrupts = <GIC_SPI 65 IRQ_TYPE_LEVEL_HIGH>, /* syncpt */
                      <GIC_SPI 67 IRQ_TYPE_LEVEL_HIGH>; /* general */
        interrupt-names = "syncpt", "host1x";
        clocks = <&tegra_car TEGRA20_CLK_HOST1X>;
        clock-names = "host1x";
        resets = <&tegra_car 28>;
        reset-names = "host1x";

        #address-cells = <1>;
        #size-cells = <1>;

        ranges = <0x54000000 0x54000000 0x04000000>;
    };
```

## Documentation/devicetree/bindings/gpu/nvidia,gk20a.yaml
```yaml
# SPDX-License-Identifier: (GPL-2.0-only OR BSD-2-Clause)
%YAML 1.2
---
$id: http://devicetree.org/schemas/gpu/nvidia,gk20a.yaml#
$schema: http://devicetree.org/meta-schemas/core.yaml#

title: NVIDIA Tegra Graphics Processing Units

maintainers:
  - Thierry Reding <thierry.reding@gmail.com>
  - Jon Hunter <jonathanh@nvidia.com>

properties:
  compatible:
    items:
      - enum:
          - nvidia,gk20a
          - nvidia,gm20b
          - nvidia,gp10b
          - nvidia,gv11b

  reg:
    items:
      - description: base address and size for BAR0
      - description: base address and size for BAR1

  interrupts:
    items:
      - description: stalling interrupt
      - description: non-stalling interrupt

  interrupt-names:
    items:
      - const: stall
      - const: nonstall

  clocks:
    minItems: 2
    maxItems: 3

  clock-names:
    minItems: 2
    maxItems: 3

  resets:
    items:
      - description: GPU reset

  reset-names:
    items:
      - const: gpu

  power-domains:
    description: GPUs that make use of power domains can define this property
      instead of vdd-supply. Currently "nvidia,gp10b" and "nvidia,gv11b" make
      use of this.
    maxItems: 1

  vdd-supply:
    description: GPU power supply.

  interconnect-names: true
  interconnects: true

  iommus:
    maxItems: 1

  dma-coherent: true

required:
  - compatible
  - reg
  - interrupts
  - interrupt-names
  - clocks
  - clock-names
  - resets
  - reset-names

allOf:
  - if:
      properties:
        compatible:
          contains:
            const: nvidia,gk20a
    then:
      properties:
        clocks:
          items:
            - description: GPU clock
            - description: PWR clock

        clock-names:
          items:
            - const: gpu
            - const: pwr

  - if:
      properties:
        compatible:
          contains:
            const: nvidia,gm20b
    then:
      properties:
        clocks:
          items:
            - description: GPU clock
            - description: PWR clock
            - description: REF clock

        clock-names:
          items:
            - const: gpu
            - const: pwr
            - const: ref

      required:
        - vdd-supply

  - if:
      properties:
        compatible:
          contains:
            const: nvidia,gp10b
    then:
      properties:
        clocks:
          items:
            - description: GPU clock
            - description: PWR clock

        clock-names:
          items:
            - const: gpu
            - const: pwr

        interconnects:
          minItems: 4
          maxItems: 4

        interconnect-names:
          items:
            - const: dma-mem # read-0
            - const: write-0
            - const: read-1
            - const: write-1

      required:
        - power-domains

  - if:
      properties:
        compatible:
          contains:
            const: nvidia,gv11b
    then:
      properties:
        clocks:
          items:
            - description: GPU clock
            - description: PWR clock
            - description: FUSE clock

        clock-names:
          items:
            - const: gpu
            - const: pwr
            - const: fuse

        interconnects:
          minItems: 12
          maxItems: 12

        interconnect-names:
          items:
            - const: dma-mem # read-0
            - const: read-0-hp
            - const: write-0
            - const: read-1
            - const: read-1-hp
            - const: write-1
            - const: read-2
            - const: read-2-hp
            - const: write-2
            - const: read-3
            - const: read-3-hp
            - const: write-3

      required:
        - power-domains

additionalProperties: false

examples:
  - |
    #include <dt-bindings/clock/tegra124-car.h>
    #include <dt-bindings/interrupt-controller/arm-gic.h>
    #include <dt-bindings/memory/tegra124-mc.h>

    gpu@57000000 {
        compatible = "nvidia,gk20a";
        reg = <0x57000000 0x01000000>,
              <0x58000000 0x01000000>;
        interrupts = <GIC_SPI 157 IRQ_TYPE_LEVEL_HIGH>,
                     <GIC_SPI 158 IRQ_TYPE_LEVEL_HIGH>;
        interrupt-names = "stall", "nonstall";
        vdd-supply = <&vdd_gpu>;
        clocks = <&tegra_car TEGRA124_CLK_GPU>,
                 <&tegra_car TEGRA124_CLK_PLL_P_OUT5>;
        clock-names = "gpu", "pwr";
        resets = <&tegra_car 184>;
        reset-names = "gpu";
        iommus = <&mc TEGRA_SWGROUP_GPU>;
    };

  - |
    #include <dt-bindings/clock/tegra210-car.h>
    #include <dt-bindings/interrupt-controller/arm-gic.h>
    /*
     * XXX can't include this because it conflicts with the tegra124-mc.h
     * include from the Tegra124 example above.
     */
    /*
    #include <dt-bindings/memory/tegra210-mc.h>
    */

    gpu@57000000 {
        compatible = "nvidia,gm20b";
        reg = <0x57000000 0x01000000>,
              <0x58000000 0x01000000>;
        interrupts = <GIC_SPI 157 IRQ_TYPE_LEVEL_HIGH>,
                     <GIC_SPI 158 IRQ_TYPE_LEVEL_HIGH>;
        interrupt-names = "stall", "nonstall";
        vdd-supply = <&vdd_gpu>;
        clocks = <&tegra_car TEGRA210_CLK_GPU>,
                 <&tegra_car TEGRA210_CLK_PLL_P_OUT5>,
                 <&tegra_car TEGRA210_CLK_PLL_G_REF>;
        clock-names = "gpu", "pwr", "ref";
        resets = <&tegra_car 184>;
        reset-names = "gpu";
        iommus = <&mc TEGRA_SWGROUP_GPU>;
    };

  - |
    #include <dt-bindings/clock/tegra186-clock.h>
    #include <dt-bindings/interrupt-controller/arm-gic.h>
    #include <dt-bindings/memory/tegra186-mc.h>
    #include <dt-bindings/power/tegra186-powergate.h>
    #include <dt-bindings/reset/tegra186-reset.h>

    gpu@17000000 {
        compatible = "nvidia,gp10b";
        reg = <0x17000000 0x1000000>,
              <0x18000000 0x1000000>;
        interrupts = <GIC_SPI 70 IRQ_TYPE_LEVEL_HIGH>,
                     <GIC_SPI 71 IRQ_TYPE_LEVEL_HIGH>;
        interrupt-names = "stall", "nonstall";
        clocks = <&bpmp TEGRA186_CLK_GPCCLK>,
                 <&bpmp TEGRA186_CLK_GPU>;
        clock-names = "gpu", "pwr";
        resets = <&bpmp TEGRA186_RESET_GPU>;
        reset-names = "gpu";
        power-domains = <&bpmp TEGRA186_POWER_DOMAIN_GPU>;
        iommus = <&smmu TEGRA186_SID_GPU>;
    };

  - |
    #include <dt-bindings/clock/tegra194-clock.h>
    #include <dt-bindings/interrupt-controller/arm-gic.h>
    #include <dt-bindings/memory/tegra194-mc.h>
    #include <dt-bindings/power/tegra194-powergate.h>
    #include <dt-bindings/reset/tegra194-reset.h>

    gpu@17000000 {
        compatible = "nvidia,gv11b";
        reg = <0x17000000 0x10000000>,
              <0x18000000 0x10000000>;
        interrupts = <GIC_SPI 70 IRQ_TYPE_LEVEL_HIGH>,
                     <GIC_SPI 71 IRQ_TYPE_LEVEL_HIGH>;
        interrupt-names = "stall", "nonstall";
        clocks = <&bpmp TEGRA194_CLK_GPCCLK>,
                 <&bpmp TEGRA194_CLK_GPU_PWR>,
                 <&bpmp TEGRA194_CLK_FUSE>;
        clock-names = "gpu", "pwr", "fuse";
        resets = <&bpmp TEGRA194_RESET_GPU>;
        reset-names = "gpu";
        dma-coherent;

        power-domains = <&bpmp TEGRA194_POWER_DOMAIN_GPU>;
        interconnects = <&mc TEGRA194_MEMORY_CLIENT_NVL1R &emc>,
                        <&mc TEGRA194_MEMORY_CLIENT_NVL1RHP &emc>,
                        <&mc TEGRA194_MEMORY_CLIENT_NVL1W &emc>,
                        <&mc TEGRA194_MEMORY_CLIENT_NVL2R &emc>,
                        <&mc TEGRA194_MEMORY_CLIENT_NVL2RHP &emc>,
                        <&mc TEGRA194_MEMORY_CLIENT_NVL2W &emc>,
                        <&mc TEGRA194_MEMORY_CLIENT_NVL3R &emc>,
                        <&mc TEGRA194_MEMORY_CLIENT_NVL3RHP &emc>,
                        <&mc TEGRA194_MEMORY_CLIENT_NVL3W &emc>,
                        <&mc TEGRA194_MEMORY_CLIENT_NVL4R &emc>,
                        <&mc TEGRA194_MEMORY_CLIENT_NVL4RHP &emc>,
                        <&mc TEGRA194_MEMORY_CLIENT_NVL4W &emc>;
        interconnect-names = "dma-mem", "read-0-hp", "write-0",
                             "read-1", "read-1-hp", "write-1",
                             "read-2", "read-2-hp", "write-2",
                             "read-3", "read-3-hp", "write-3";
    };
```

## Documentation/devicetree/bindings/hwmon/gpio-fan.yaml
```yaml
# SPDX-License-Identifier: GPL-2.0
%YAML 1.2
---
$id: http://devicetree.org/schemas/hwmon/gpio-fan.yaml#
$schema: http://devicetree.org/meta-schemas/core.yaml#

title: Bindings for fan connected to GPIO lines

maintainers:
  - Guenter Roeck <linux@roeck-us.net>
  - Jean Delvare <jdelvare@suse.com>

properties:
  compatible:
    const: gpio-fan

  gpios:
    description: Specifies the pins that map to bits in the control value, ordered MSB-->LSB.

  gpio-fan,speed-map:
    description: A mapping of possible fan RPM speeds and the control value that should be set to
      achieve them. This array must have the RPM values in ascending order.
    $ref: /schemas/types.yaml#/definitions/uint32-matrix

  alarm-gpios:
    description: This pin going active indicates something is wrong with the fan, and a udev event
      will be fired.

  # from ../thermal/thermal-cooling-devices.yaml
  "#cooling-cells": true

required:
  - compatible

allOf:
  - $ref: ../thermal/thermal-cooling-devices.yaml
  - anyOf:
      - required:
          - alarm-gpios

      - required:
          - gpios

dependencies:
  gpio-fan,speed-map: [ gpios ]

additionalProperties: false

examples:
  - |
    gpio_fan {
      compatible = "gpio-fan";
      gpios = <&gpio1 14 1>,
              <&gpio1 13 1>;
      gpio-fan,speed-map = <0    0>,
                           <3000 1>,
                           <6000 2>;
      alarm-gpios = <&gpio1 15 1>;
    };

  - |
    gpio_fan_cool: gpio_fan {
      compatible = "gpio-fan";
      gpios = <&gpio2 14 1>,
              <&gpio2 13 1>;
      gpio-fan,speed-map = <0    0>,
                           <3000 1>,
                           <6000 2>;
      alarm-gpios = <&gpio2 15 1>;
      #cooling-cells = <2>; /* min followed by max */
    };
```

## Documentation/devicetree/bindings/hwmon/national,lm95235.yaml
```yaml
# SPDX-License-Identifier: GPL-2.0-only or BSD-2-Clause
%YAML 1.2
---
$id: http://devicetree.org/schemas/hwmon/national,lm95235.yaml#
$schema: http://devicetree.org/meta-schemas/core.yaml#

title: National Semiconductors LM95235/LM95245 series thermometer

maintainers:
  - Jean Delvare <jdelvare@suse.com>
  - Guenter Roeck <linux@roeck-us.net>

properties:
  compatible:
    enum:
      - national,lm95235
      - national,lm95245

  reg:
    maxItems: 1

required:
  - compatible
  - reg

additionalProperties: false

examples:
  - |
    i2c {
      #address-cells = <1>;
      #size-cells = <0>;

      temp-sensor@4c {
        compatible = "national,lm95245";
        reg = <0x4c>;
      };
    };
```
