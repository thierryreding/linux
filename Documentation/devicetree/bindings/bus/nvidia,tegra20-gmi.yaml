## Documentation/devicetree/bindings/display/tegra/nvidia,tegra114-host1x.yaml
```yaml
# SPDX-License-Identifier: GPL-2.0-only
%YAML 1.2
---
$id: http://devicetree.org/schemas/display/tegra/nvidia,tegra114-host1x.yaml#
$schema: http://devicetree.org/meta-schemas/core.yaml#

title: NVIDIA Tegra114 host1x controller

maintainers:
  - Thierry Reding <thierry.reding@gmail.com>
  - Jon Hunter <jonathanh@nvidia.com>

description: The host1x top-level node defines a number of children, each representing one of the
  host1x client modules defined in this binding.

properties:
  compatible:
    const: nvidia,tegra114-host1x

  reg:
    maxItems: 1

  interrupts:
    items:
      - description: host1x syncpoint interrupt
      - description: host1x general interrupt

  interrupt-names:
    items:
      - const: syncpt
      - const: host1x

  clocks:
    items:
      - description: module clock

  clock-names:
    items:
      - const: host1x

  resets:
    items:
      - description: module reset

  reset-names:
    items:
      - const: host1x

  iommus:
    maxItems: 1

  interconnects:
    items:
      - description: memory read client for host1x

  interconnect-names:
    items:
      - const: dma-mem # read

  '#address-cells':
    description: The number of cells used to represent physical base addresses in the host1x
      address space.
    enum: [1, 2]

  '#size-cells':
    description: The number of cells used to represent the size of an address range in the host1x
      address space.
    enum: [1, 2]

  ranges:
    maxItems: 1

required:
  - compatible
  - reg
  - interrupts
  - interrupt-names
  - clocks
  - clock-names
  - resets
  - reset-names
  - '#address-cells'
  - '#size-cells'
  - ranges

additionalProperties: false

patternProperties:
  "^vi@[0-9a-f]+$":
    description: video input
    type: object
    properties:
      compatible:
        const: nvidia,tegra114-vi

      reg:
        maxItems: 1

      interrupts:
        maxItems: 1

      clocks:
        items:
          - description: module clock

      resets:
        items:
          - description: module reset

      reset-names:
        items:
          - const: vi

      iommus:
        maxItems: 1

    required:
      - compatible
      - reg
      - interrupts
      - clocks
      - resets
      - reset-names

    additionalProperties: false

  "^epp@[0-9a-f]+$":
    description: encoder pre-processor
    type: object
    properties:
      compatible:
        const: nvidia,tegra114-epp

      reg:
        maxItems: 1

      interrupts:
        maxItems: 1

      clocks:
        items:
          - description: module clock

      resets:
        items:
          - description: module reset

      reset-names:
        items:
          - const: epp

      iommus:
        maxItems: 1

    required:
      - compatible
      - reg
      - interrupts
      - clocks
      - resets
      - reset-names

    additionalProperties: false

  "^msenc@[0-9a-f]+$":
    description: video encoder
    type: object
    properties:
      compatible:
        const: nvidia,tegra114-msenc

      reg:
        maxItems: 1

      interrupts:
        maxItems: 1

      clocks:
        items:
          - description: module clock

      resets:
        items:
          - description: module reset

      reset-names:
        items:
          - const: msenc

      iommus:
        maxItems: 1

    required:
      - compatible
      - reg
      - interrupts
      - clocks
      - resets
      - reset-names

    additionalProperties: false

  "^gr2d@[0-9a-f]+$":
    description: 2D graphics engine
    type: object
    properties:
      compatible:
        const: nvidia,tegra114-gr2d

      reg:
        maxItems: 1

      interrupts:
        maxItems: 1

      clocks:
        items:
          - description: module clock

      resets:
        items:
          - description: module reset

      reset-names:
        items:
          - const: 2d

      iommus:
        maxItems: 1

    required:
      - compatible
      - reg
      - interrupts
      - clocks
      - resets
      - reset-names

    additionalProperties: false

  "^gr3d@[0-9a-f]+$":
    description: 3D graphics engine
    type: object
    properties:
      compatible:
        const: nvidia,tegra114-gr3d

      reg:
        maxItems: 1

      clocks:
        items:
          - description: module clock

      clock-names:
        items:
          - const: 3d

      resets:
        items:
          - description: module reset

      reset-names:
        items:
          - const: 3d

      iommus:
        maxItems: 1

    required:
      - compatible
      - reg
      - clocks
      - resets
      - reset-names

    additionalProperties: false

  "^dc@[0-9a-f]+$":
    description: display controller
    type: object
    properties:
      compatible:
        const: nvidia,tegra114-dc

      reg:
        maxItems: 1

      interrupts:
        maxItems: 1

      clocks:
        items:
          - description: display controller pixel clock

      clock-names:
        items:
          - const: dc

      resets:
        items:
          - description: module reset

      reset-names:
        items:
          - const: dc

      iommus:
        maxItems: 1

      interconnects:
        items:
          - description: memory read client for window A
          - description: memory read client for window B
          - description: memory read client for window C
          - description: memory read client for cursor

      interconnect-names:
        items:
          - const: wina
          - const: winb
          - const: winc
          - const: cursor

      nvidia,head:
        description: The number of the display controller head. This is used to setup the various
          types of output to receive video data from the given head.
        $ref: "/schemas/types.yaml#/definitions/uint32"

      rgb:
        description: Each display controller node has a child node, named "rgb", that represents
          the RGB output associated with the controller.
        type: object
        properties:
          nvidia,ddc-i2c-bus:
            description: phandle of an I2C controller used for DDC EDID probing
            $ref: "/schemas/types.yaml#/definitions/phandle"

          nvidia,hpd-gpio:
            description: specifies a GPIO used for hotplug detection
            maxItems: 1

          nvidia,edid:
            description: supplies a binary EDID blob
            $ref: "/schemas/types.yaml#/definitions/uint8-array"

          nvidia,panel:
            description: phandle of a display panel
            $ref: "/schemas/types.yaml#/definitions/phandle"

    required:
      - compatible
      - reg
      - interrupts
      - clocks
      - clock-names
      - resets
      - reset-names
      - nvidia,head

    additionalProperties: false

  "^hdmi@[0-9a-f]+$":
    description: High Definition Multimedia Interface
    type: object
    properties:
      compatible:
        const: nvidia,tegra114-hdmi

      reg:
        maxItems: 1

      interrupts:
        maxItems: 1

      clocks:
        items:
          - description: module clock
          - description: parent clock

      clock-names:
        items:
          - const: hdmi
          - const: parent

      resets:
        items:
          - description: module reset

      reset-names:
        items:
          - const: hdmi

      hdmi-supply:
        description: supply for the +5V HDMI connector pin

      vdd-supply:
        description: regulator for supply voltage

      pll-supply:
        description: regulator for PLL

      nvidia,ddc-i2c-bus:
        description: phandle of an I2C controller used for DDC EDID probing
        $ref: "/schemas/types.yaml#/definitions/phandle"

      nvidia,hpd-gpio:
        description: specifies a GPIO used for hotplug detection
        maxItems: 1

      nvidia,edid:
        description: supplies a binary EDID blob
        $ref: "/schemas/types.yaml#/definitions/uint8-array"

      nvidia,panel:
        description: phandle of a display panel
        $ref: "/schemas/types.yaml#/definitions/phandle"

    required:
      - compatible
      - reg
      - interrupts
      - clocks
      - clock-names
      - resets
      - reset-names
      - hdmi-supply
      - vdd-supply
      - pll-supply

    additionalProperties: false

  "^dsi@[0-9a-f]+$":
    description: display serial interface
    type: object
    properties:
      compatible:
        const: nvidia,tegra114-dsi

      reg:
        maxItems: 1

      clocks:
        items:
          - description: DSI module clock
          - description: low-power module clock
          - description: input for the pixel clock

      clock-names:
        items:
          - const: dsi
          - const: lp
          - const: parent

      resets:
        items:
          - description: module reset

      reset-names:
        items:
          - const: dsi

      avdd-dsi-csi-supply:
        description: phandle of a supply that powers the DSI controller

      nvidia,mipi-calibrate:
        description: Should contain a phandle and a specifier specifying which pads are used by
          this DSI output and need to be calibrated.

          See also ../display/tegra/nvidia,tegra114-mipi.txt.
        $ref: "/schemas/types.yaml#/definitions/phandle-array"

      nvidia,ddc-i2c-bus:
        description: phandle of an I2C controller used for DDC EDID probing
        $ref: "/schemas/types.yaml#/definitions/phandle"

      nvidia,hpd-gpio:
        description: specifies a GPIO used for hotplug detection
        maxItems: 1

      nvidia,edid:
        description: supplies a binary EDID blob
        $ref: "/schemas/types.yaml#/definitions/uint8-array"

      nvidia,panel:
        description: phandle of a display panel
        $ref: "/schemas/types.yaml#/definitions/phandle"

      nvidia,ganged-mode:
        description: contains a phandle to a second DSI controller to gang up with in order to
          support up to 8 data lanes
        $ref: "/schemas/types.yaml#/definitions/phandle"

      '#address-cells':
        const: 1

      '#size-cells':
        const: 0

    patternProperties:
      "^panel@[0-9]+$":
        type: object

    required:
      - compatible
      - reg
      - clocks
      - clock-names
      - resets
      - reset-names
      - avdd-dsi-csi-supply
      - nvidia,mipi-calibrate
      - "#address-cells"
      - "#size-cells"

    additionalProperties: false

  "^isp@[0-9a-f]+$":
    type: object
    properties:
      compatible:
        const: nvidia,tegra114-isp

      reg:
        maxItems: 1

      interrupts:
        maxItems: 1

      clocks:
        items:
          - description: module clock

      resets:
        items:
          - description: module reset

      reset-names:
        items:
          - const: isp

      iommus:
        maxItems: 1

    required:
      - compatible
      - reg
      - interrupts
      - clocks
      - resets
      - reset-names

    additionalProperties: false

examples:
  - |
    #include <dt-bindings/clock/tegra114-car.h>

    host1x@50000000 {
        compatible = "nvidia,tegra114-host1x";
        reg = <0x50000000 0x00024000>;
        interrupts = <0 65 0x04>, /* mpcore syncpt */
                     <0 67 0x04>; /* mpcore general */
        interrupt-names = "syncpt", "host1x";
        clocks = <&tegra_car TEGRA114_CLK_HOST1X>;
        clock-names = "host1x";
        resets = <&tegra_car 28>;
        reset-names = "host1x";

        #address-cells = <1>;
        #size-cells = <1>;

        ranges = <0x54000000 0x54000000 0x04000000>;

        vi@54080000 {
            compatible = "nvidia,tegra114-vi";
            reg = <0x54080000 0x00040000>;
            interrupts = <0 69 0x04>;
            clocks = <&tegra_car TEGRA114_CLK_VI>;
            resets = <&tegra_car 100>;
            reset-names = "vi";
        };

        epp@540c0000 {
            compatible = "nvidia,tegra114-epp";
            reg = <0x540c0000 0x00040000>;
            interrupts = <0 70 0x04>;
            clocks = <&tegra_car TEGRA114_CLK_EPP>;
            resets = <&tegra_car 19>;
            reset-names = "epp";
        };

        isp@54100000 {
            compatible = "nvidia,tegra114-isp";
            reg = <0x54100000 0x00040000>;
            interrupts = <0 71 0x04>;
            clocks = <&tegra_car TEGRA114_CLK_ISP>;
            resets = <&tegra_car 23>;
            reset-names = "isp";
        };

        gr2d@54140000 {
            compatible = "nvidia,tegra114-gr2d";
            reg = <0x54140000 0x00040000>;
            interrupts = <0 72 0x04>;
            clocks = <&tegra_car TEGRA114_CLK_GR2D>;
            resets = <&tegra_car 21>;
            reset-names = "2d";
        };

        gr3d@54180000 {
            compatible = "nvidia,tegra114-gr3d";
            reg = <0x54180000 0x00040000>;
            clocks = <&tegra_car TEGRA114_CLK_GR3D>;
            clock-names = "3d";
            resets = <&tegra_car 24>;
            reset-names = "3d";
        };

        dc@54200000 {
            compatible = "nvidia,tegra114-dc";
            reg = <0x54200000 0x00040000>;
            interrupts = <0 73 0x04>;
            clocks = <&tegra_car TEGRA114_CLK_DISP1>;
            clock-names = "dc";
            resets = <&tegra_car 27>;
            reset-names = "dc";

            nvidia,head = <0>;

            rgb {
            };
        };

        dc@54240000 {
            compatible = "nvidia,tegra114-dc";
            reg = <0x54240000 0x00040000>;
            interrupts = <0 74 0x04>;
            clocks = <&tegra_car TEGRA114_CLK_DISP2>;
            clock-names = "dc";
            resets = <&tegra_car 26>;
            reset-names = "dc";

            nvidia,head = <1>;

            rgb {
            };
        };

        hdmi@54280000 {
            compatible = "nvidia,tegra114-hdmi";
            reg = <0x54280000 0x00040000>;
            interrupts = <0 75 0x04>;
            clocks = <&tegra_car TEGRA114_CLK_HDMI>,
                     <&tegra_car TEGRA114_CLK_PLL_D_OUT0>;
            clock-names = "hdmi", "parent";
            resets = <&tegra_car 51>;
            reset-names = "hdmi";

            hdmi-supply = <&vdd_5v0_hdmi>;
            vdd-supply = <&sys_3v3_reg>;
            pll-supply = <&vio_reg>;
        };

        dsi@54300000 {
            compatible = "nvidia,tegra114-dsi";
            reg = <0x54300000 0x00040000>;
            clocks = <&tegra_car TEGRA114_CLK_DSIA>,
                     <&tegra_car TEGRA114_CLK_DSIALP>,
                     <&tegra_car TEGRA114_CLK_PLL_D_OUT0>;
            clock-names = "dsi", "lp", "parent";
            resets = <&tegra_car 48>;
            reset-names = "dsi";

            nvidia,mipi-calibrate = <&mipi 0x060>; /* DSIA & DSIB pads */
            avdd-dsi-csi-supply = <&avdd_1v2_reg>;

            #address-cells = <1>;
            #size-cells = <0>;
        };

        dsi@54400000 {
            compatible = "nvidia,tegra114-dsi";
            reg = <0x54300000 0x00040000>;
            clocks = <&tegra_car TEGRA114_CLK_DSIB>,
                     <&tegra_car TEGRA114_CLK_DSIBLP>,
                     <&tegra_car TEGRA114_CLK_PLL_D2_OUT0>;
            clock-names = "dsi", "lp", "parent";
            resets = <&tegra_car 48>;
            reset-names = "dsi";

            nvidia,mipi-calibrate = <&mipi 0x180>; /* DSIC & DSID pads */
            avdd-dsi-csi-supply = <&avdd_1v2_reg>;

            #address-cells = <1>;
            #size-cells = <0>;
        };

        msenc@544c0000 {
            compatible = "nvidia,tegra114-msenc";
            reg = <0x544c0000 0x00040000>;
            interrupts = <0 68 0x04>;
            clocks = <&tegra_car TEGRA114_CLK_MSENC>;
            resets = <&tegra_car 60>;
            reset-names = "msenc";
            monkeybrain;
        };
    };
```
