## Documentation/devicetree/bindings/input/touchscreen/st,stmpe-ts.yaml
```yaml
# SPDX-License-Identifier: GPL-2.0-only
%YAML 1.2
---
$id: http://devicetree.org/schemas/input/touchscreen/st,stmpe-ts.yaml#
$schema: http://devicetree.org/meta-schemas/core.yaml#

title: STMPE Touchscreen

maintainers:
  - Rob Herring <robh@kernel.org>

description: |
  Node name must be stmpe_touchscreen and should be child node of stmpe node to which it belongs.

  Note that common ADC settings of stmpe_touchscreen (child) will take precedence over the
  settings done in MFD.

properties:
  $nodename:
    const: stmpe_touchscreen

  compatible:
    const: st,stmpe-ts

  # optional properties
  st,ave-ctrl:
    $ref: /schemas/types.yaml#/definitions/uint32
    description: sample average control
    oneOf:
      - description: 1 sample
        const: 0
      - description: 2 samples
        const: 1
      - description: 4 samples
        const: 2
      - description: 8 samples
        const: 3

  st,touch-det-delay:
    $ref: /schemas/types.yaml#/definitions/uint32
    description: touch detect interrupt delay (recommended is 3)
    oneOf:
      - description: 10 us
        const: 0
      - description: 50 us
        const: 1
      - description: 100 us
        const: 2
      - description: 500 us
        const: 3
      - description: 1 ms
        const: 4
      - description: 5 ms
        const: 5
      - description: 10 ms
        const: 6
      - description: 50 ms
        const: 7

  st,settling:
    $ref: /schemas/types.yaml#/definitions/uint32
    description: panel driver settling time (recommended is 2)
    oneOf:
      - description: 10 us
        const: 0
      - description: 100 us
        const: 1
      - description: 500 us
        const: 2
      - description: 1 ms
        const: 3
      - description: 5 ms
        const: 4
      - description: 10 ms
        const: 5
      - description: 50 ms
        const: 6
      - description: 100 ms
        const: 7

  st,fraction-z:
    $ref: /schemas/types.yaml#/definitions/uint32
    description: length of the fractional part in z (recommended is 7)
    minimum: 0
    maximum: 7

  st,i-drive:
    $ref: /schemas/types.yaml#/definitions/uint32
    description: current limit value of the touchscreen drivers
    oneOf:
      - description: 20 mA (typical 35 mA max)
        const: 0
      - description: 50 mA (typical 80 mA max)
        const: 1

  # optional properties common with MFD (deprecated)
  st,sample-time:
    $ref: /schemas/types.yaml#/definitions/uint32
    description: ADC conversion time in number of clock ticks
    oneOf:
      - description: 36 clocks
        const: 0
      - description: 44 clocks
        const: 1
      - description: 56 clocks
        const: 2
      - description: 64 clocks
        const: 3
      - description: 80 clocks (recommended)
        const: 4
      - description: 96 clocks
        const: 5
      - description: 124 clocks
        const: 6

  st,mod-12b:
    $ref: /schemas/types.yaml#/definitions/uint32
    description: ADC bit mode
    oneOf:
      - description: 10 bit ADC
        const: 0
      - description: 12 bit ADC
        const: 1

  st,ref-sel:
    $ref: /schemas/types.yaml#/definitions/uint32
    description: ADC reference source
    oneOf:
      - description: internal
        const: 0
      - description: external
        const: 1

  st,adc-freq:
    $ref: /schemas/types.yaml#/definitions/uint32
    description: ADC clock speed
    oneOf:
      - description: 1.625 MHz
        const: 0
      - description: 3.25 MHz
        const: 1
      - description: 6.5 MHz
        const: 2
      - description: 6.5 MHz
        const: 3

additionalProperties: false

required:
  - compatible

examples:
  - |
    #include <dt-bindings/interrupt-controller/irq.h>

    i2c {
      #address-cells = <1>;
      #size-cells = <0>;

      stmpe811@41 {
        compatible = "st,stmpe811";
        pinctrl-names = "default";
        pinctrl-0 = <&pinctrl_touch_int>;
        reg = <0x41>;
        interrupts = <10 IRQ_TYPE_LEVEL_LOW>;
        interrupt-parent = <&gpio4>;
        interrupt-controller;
        /* Common ADC settings */
        /* 3.25 MHz ADC clock speed */
        st,adc-freq = <1>;
        /* 12-bit ADC */
        st,mod-12b = <1>;
        /* internal ADC reference */
        st,ref-sel = <0>;
        /* ADC converstion time: 80 clocks */
        st,sample-time = <4>;

        stmpe_touchscreen {
          compatible = "st,stmpe-ts";
          /* 8 sample average control */
          st,ave-ctrl = <3>;
          /* 5 ms touch detect interrupt delay */
          st,touch-det-delay = <5>;
          /* 1 ms panel driver settling time */
          st,settling = <3>;
          /* 7 length fractional part in z */
          st,fraction-z = <7>;
          /*
           * 50 mA typical 80 mA max touchscreen drivers
           * current limit value
           */
          st,i-drive = <1>;
        };

        stmpe_adc {
          compatible = "st,stmpe-adc";
          st,norequest-mask = <0x0F>;
        };
      };
    };
```
