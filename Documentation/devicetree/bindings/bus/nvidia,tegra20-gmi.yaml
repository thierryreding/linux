## Documentation/devicetree/bindings/hwmon/pwm-fan.yaml
```yaml
# SPDX-License-Identifier: GPL-2.0
%YAML 1.2
---

$id: http://devicetree.org/schemas/hwmon/pwm-fan.yaml#
$schema: http://devicetree.org/meta-schemas/core.yaml#

title: Bindings for a fan connected to the PWM lines

maintainers:
  - Kamil Debski <k.debski@samsung.com>
  - Guenter Roeck <linux@roeck-us.net>

properties:
  compatible:
    const: pwm-fan

  pwms:
    description: PWM used to control the PWM fan

  cooling-levels:
    description: PWM duty-cycle values in a range from 0 to 255 which
      correspond to thermal cooling states

  fan-supply:
    description: phandle to the regulator that provides power to the fan

  interrupts:
    description: This contains an interrupt specifier for each fan tachometer
      output connected to an interrupt source. The output signal must generate
      a defined number of interrupts per fan revolution, which require that it
      must be self resetting edge interrupts.

      See interrupt-controller/interrupts.txt for the format.

  pulses-per-revolution:
    description: Defines the number of pulses per fan revolution for each
      tachometer input as an integer (default is 2 interrupts per revolution).
      The value must be greater than zero.

  # from ../thermal/thermal-cooling-devices.yaml
  "#cooling-cells": true

required:
  - compatible
  - pwms
  - cooling-levels

additionalProperties: false

examples:
  - |
    #include <dt-bindings/interrupt-controller/irq.h>

    fan: pwm-fan {
        compatible = "pwm-fan";
        #cooling-cells = <2>;
        pwms = <&pwm 0 10000 0>;
        cooling-levels = <0 102 170 230>;
    };

    thermal-zones {
        cpu_thermal: cpu-thermal {
            thermal-sensors = <&tmu 0>;
            polling-delay-passive = <0>;
            polling-delay = <0>;

            trips {
                cpu_alert1: cpu-alert1 {
                    temperature = <100000>; /* millicelsius */
                    hysteresis = <2000>; /* millicelsius */
                    type = "passive";
                };
            };

            cooling-maps {
                map0 {
                    trip = <&cpu_alert1>;
                    cooling-device = <&fan 0 1>;
                };
            };
        };
    };

  - |
    #include <dt-bindings/interrupt-controller/irq.h>

    pwm-fan {
        compatible = "pwm-fan";
        pwms = <&pwm 0 40000 0>;
        fan-supply = <&reg_fan>;
        interrupt-parent = <&gpio5>;
        interrupts = <1 IRQ_TYPE_EDGE_FALLING>;
        pulses-per-revolution = <2>;
    };

  - |
    #include <dt-bindings/interrupt-controller/irq.h>

    pwm-fan {
        compatible = "pwm-fan";
        pwms = <&pwm1 0 25000 0>;
        interrupts-extended = <&gpio1 1 IRQ_TYPE_EDGE_FALLING>,
                              <&gpio2 5 IRQ_TYPE_EDGE_FALLING>;
        pulses-per-revolution = <2>, <1>;
    };
```

## Documentation/devicetree/bindings/hwmon/ti,ina3221.yaml
```yaml
# SPDX-License-Identifier: GPL-2.0-only
%YAML 1.2
---
$id: http://devicetree.org/schemas/hwmon/ti,ina3221.yaml#
$schema: http://devicetree.org/meta-schemas/core.yaml#

title: Texas Instruments INA3221 Device Tree Bindings

maintainers:
  - Jean Delvare <jdelvare@suse.com>
  - Guenter Roeck <linux@roeck-us.net>

properties:
  compatible:
    const: ti,ina3221

  reg:
    maxItems: 1

  ti,single-shot:
    description: |
      This chip has two power modes: single-shot (chip takes one measurement and then shuts itself
      down) and continuous (chip takes continuous measurements). The continuous mode is more
      reliable and suitable for hardware monitor type device, but the single-shot mode is more
      power-friendly and useful for battery-powered device which cares power consumptions while
      still needs some measurements occasionally.

      If this property is present, the single-shot mode will be used, instead of the default
      continuous one for monitoring.
    $ref: /schemas/types.yaml#/definitions/flag

  "#address-cells":
    description: Required only if a child node is present.
    const: 1

  "#size-cells":
    description: Required only if a child node is present.
    const: 0

patternProperties:
  "^input@[0-2]$":
    description: The node contains optional child nodes for three channels. Each child node
      describes the information of input source.
    type: object
    properties:
      reg:
        description: Must be 0, 1 and 2, corresponding to the IN1, IN2 or IN3 ports of the INA3221,
          respectively.
        enum: [ 0, 1, 2 ]

      label:
        description: name of the input source

      shunt-resistor-micro-ohms:
        description: shunt resistor value in micro-Ohm

    additionalProperties: false

    required:
      - reg

additionalProperties: false

required:
  - compatible
  - reg

examples:
  - |
    #include <dt-bindings/clock/tegra186-clock.h>
    #include <dt-bindings/interrupt-controller/arm-gic.h>
    #include <dt-bindings/reset/tegra186-reset.h>

    i2c@3160000 {
        compatible = "nvidia,tegra186-i2c";
        reg = <0x03160000 0x10000>;
        interrupts = <GIC_SPI 25 IRQ_TYPE_LEVEL_HIGH>;
        clocks = <&bpmp TEGRA186_CLK_I2C1>;
        clock-names = "div-clk";
        resets = <&bpmp TEGRA186_RESET_I2C1>;
        reset-names = "i2c";

        #address-cells = <1>;
        #size-cells = <0>;

        ina3221@40 {
            compatible = "ti,ina3221";
            reg = <0x40>;
            #address-cells = <1>;
            #size-cells = <0>;

            input@0 {
                reg = <0x0>;
                status = "disabled";
            };

            input@1 {
                reg = <0x1>;
                shunt-resistor-micro-ohms = <5000>;
            };

            input@2 {
                reg = <0x2>;
                label = "VDD_5V";
                shunt-resistor-micro-ohms = <5000>;
            };
        };
    };
```

## Documentation/devicetree/bindings/input/nvidia,tegra20-kbc.yaml
```yaml
# SPDX-License-Identifier: (GPL-2.0-only OR BSD-2-Clause)
%YAML 1.2
---
$id: http://devicetree.org/schemas/input/nvidia,tegra20-kbc.yaml#
$schema: http://devicetree.org/meta-schemas/core.yaml#

maintainers:
  - Thierry Reding <thierry.reding@gmail.com>
  - Jon Hunter <jonathanh@nvidia.com>

title: NVIDIA Tegra keyboard controller

description: |
  The key controller has maximum 24 pins to make matrix keypad. Any pin can be configured as row
  or column. The maximum column pin can be 8 and maximum row pins can be 16 for Tegra20/Tegra30.

properties:
  compatible:
    oneOf:
      - const: nvidia,tegra20-kbc
      - items:
          - const: nvidia,tegra30-kbc
          - const: nvidia,tegra20-kbc
      - const: nvidia,tegra114-kbc

  reg:
    maxItems: 1

  interrupts:
    maxItems: 1

  clocks:
    items:
      - description: module clock

  clock-names:
    items:
      - const: kbc

  resets:
    items:
      - description: module reset

  reset-names:
    items:
      - const: kbc

  nvidia,kbc-row-pins:
    $ref: /schemas/types.yaml#/definitions/uint32-array
    description: The KBC pins which are configured as row. This is an array of pin numbers which
      is used as rows.

  nvidia,kbc-col-pins:
    $ref: /schemas/types.yaml#/definitions/uint32-array
    description: The KBC pins which are configured as column. This is an array of pin numbers
      which is used as column.

  linux,fn-keymap:
    $ref: /schemas/types.yaml#/definitions/uint32-array
    description: A second keymap, same specification as the matrix-keyboard-controller spec but to
      be used when the KEY_FN modifier key is pressed.

  nvidia,debounce-delay-ms:
    description: delay in milliseconds per row scan for debouncing

  nvidia,repeat-delay-ms:
    description: delay in milliseconds before repeat starts

  nvidia,ghost-filter:
    $ref: /schemas/types.yaml#/definitions/flag
    description: enable ghost filtering for this device

  wakeup-source:
    $ref: /schemas/types.yaml#/definitions/flag
    description: configure keyboard as a wakeup source for suspend/resume (replaces the legacy
      "nvidia,wakeup-source" property)

  # from matrix-keymap.yaml
  linux,keymap: true

allOf:
  - $ref: matrix-keymap.yaml

additionalProperties: false

required:
  - compatible
  - reg
  - interrupts
  - clocks
  - resets
  - reset-names
  - linux,keymap
  - nvidia,kbc-row-pins
  - nvidia,kbc-col-pins

examples:
  - |
    #include <dt-bindings/clock/tegra20-car.h>
    #include <dt-bindings/interrupt-controller/arm-gic.h>

    keyboard@7000e200 {
      compatible = "nvidia,tegra20-kbc";
      reg = <0x7000e200 0x100>;
      interrupts = <GIC_SPI 85 IRQ_TYPE_LEVEL_HIGH>;
      clocks = <&tegra_car TEGRA20_CLK_KBC>;
      resets = <&tegra_car 36>;
      reset-names = "kbc";
      nvidia,ghost-filter;
      nvidia,debounce-delay-ms = <640>;
      nvidia,kbc-row-pins = <0 1 2>;    /* pin 0, 1, 2 as rows */
      nvidia,kbc-col-pins = <11 12 13>; /* pin 11, 12, 13 as columns */
      linux,keymap = <0x00000074
                      0x00010067
                      0x00020066
                      0x01010068
                      0x02000069
                      0x02010070
                      0x02020071>;
    };
```

## Documentation/devicetree/bindings/input/st,stmpe-keypad.yaml
```yaml
# SPDX-License-Identifier: GPL-2.0-only
%YAML 1.2
---
$id: http://devicetree.org/schemas/input/st,stmpe-keypad.yaml#
$schema: http://devicetree.org/meta-schemas/core.yaml#

title: ST Microelectronics STMPE Multi-Functional Device (keypad)

maintainers:
  - Rob Herring <robh+dt@kernel.org>

properties:
  compatible:
    const: st,stmpe-keypad

  debounce-interval:
    $ref: /schemas/types.yaml#/definitions/uint32
    description: debouncing interval time in milliseconds

  st,scan-count:
    $ref: /schemas/types.yaml#/definitions/uint32
    description: Scanning cycles elapsed before key data is updated

  st,no-autorepeat:
    $ref: /schemas/types.yaml#/definitions/flag
    description: if specified device will not autorepeat

allOf:
  - $ref: matrix-keymap.yaml

unevaluatedProperties: false

required:
  - compatible
  - linux,keymap

examples:
  - |
    stmpe_keypad {
      compatible = "st,stmpe-keypad";

      debounce-interval = <64>;
      st,scan-count = <8>;
      st,no-autorepeat;

      linux,keymap = <0x205006b>,
                     <0x4010074>,
                     <0x3050072>,
                     <0x1030004>,
                     <0x502006a>,
                     <0x500000a>,
                     <0x005008b>,
                     <0x706001c>,
                     <0x405000b>,
                     <0x6070003>,
                     <0x3040067>,
                     <0x303006c>,
                     <0x60400e7>,
                     <0x602009e>,
                     <0x4020073>,
                     <0x5050002>,
                     <0x4030069>,
                     <0x3020008>;
    };
```
