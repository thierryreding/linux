## Documentation/devicetree/bindings/display/tegra/nvidia,tegra194-host1x.yaml
```yaml
# SPDX-License-Identifier: GPL-2.0-only
%YAML 1.2
---
$id: http://devicetree.org/schemas/display/tegra/nvidia,tegra194-host1x.yaml#
$schema: http://devicetree.org/meta-schemas/core.yaml#

title: NVIDIA Tegra194 host1x controller

maintainers:
  - Thierry Reding <thierry.reding@gmail.com>
  - Jon Hunter <jonathanh@nvidia.com>

description: The host1x top-level node defines a number of children, each representing one of the
  host1x client modules defined in this binding.

properties:
  compatible:
    const: nvidia,tegra194-host1x

  reg:
    items:
      - description: physical base address and length of the register region used by the hypervisor
      - description: physical base address and length of the register region assigned to the VM

  reg-names:
    items:
      - const: hypervisor
      - const: vm

  interrupts:
    items:
      - description: host1x syncpoint interrupt
      - description: host1x general interrupt

  interrupt-names:
    items:
      - const: syncpt
      - const: host1x

  clocks:
    items:
      - description: module clock

  clock-names:
    items:
      - const: host1x

  resets:
    items:
      - description: module reset

  reset-names:
    items:
      - const: host1x

  iommus:
    maxItems: 1

  interconnects:
    items:
      - description: memory read client for host1x

  interconnect-names:
    items:
      - const: dma-mem # read

  '#address-cells':
    description: The number of cells used to represent physical base addresses in the host1x
      address space.
    enum: [1, 2]

  '#size-cells':
    description: The number of cells used to represent the size of an address range in the host1x
      address space.
    enum: [1, 2]

  ranges:
    maxItems: 1

required:
  - compatible
  - reg
  - interrupts
  - interrupt-names
  - clocks
  - clock-names
  - resets
  - reset-names
  - '#address-cells'
  - '#size-cells'
  - ranges

additionalProperties: false

patternProperties:
  "^display-hub@[0-9a-f]+$":
    description: display hub
    type: object
    properties:
      compatible:
        const: nvidia,tegra194-display

      reg:
        maxItems: 1

      clocks:
        items:
          - description: display core clock
          - description: display hub clock

      clock-names:
        items:
          - const: disp
          - const: hub

      resets:
        items:
          - description: display hub reset
          - description: window group 0 reset
          - description: window group 1 reset
          - description: window group 2 reset
          - description: window group 3 reset
          - description: window group 4 reset
          - description: window group 5 reset

      reset-names:
        items:
          - const: misc
          - const: wgrp0
          - const: wgrp1
          - const: wgrp2
          - const: wgrp3
          - const: wgrp4
          - const: wgrp5

      power-domains:
        maxItems: 1

      '#address-cells':
        const: 1

      '#size-cells':
        const: 1

      ranges:
        maxItems: 1

    patternProperties:
      "^display@[0-9a-f]+$":
        description: display controller
        type: object
        properties:
          compatible:
            const: nvidia,tegra194-dc

          reg:
            maxItems: 1

          interrupts:
            maxItems: 1

          clocks:
            items:
              - description: display controller pixel clock

          clock-names:
            items:
              - const: dc

          resets:
            items:
              - description: display controller reset

          reset-names:
            items:
              - const: dc

          power-domains:
            maxItems: 1

          iommus:
            maxItems: 1

          interconnects:
            items:
              - description: primary memory read path of the display controller
              - description: secondary memory read path of the display controller

          interconnect-names:
            items:
              - const: dma-mem # read-0
              - const: read-1

          nvidia,outputs:
            description: A list of phandles of outputs that this display controller can drive.
            $ref: "/schemas/types.yaml#/definitions/phandle-array"

          nvidia,head:
            description: The number of the display controller head. This is used to setup the
              various types of output to receive video data from the given head.
            $ref: "/schemas/types.yaml#/definitions/uint32"

        required:
          - compatible
          - reg
          - interrupts
          - clocks
          - clock-names
          - resets
          - reset-names
          - power-domains
          - nvidia,outputs
          - nvidia,head

        additionalProperties: false

    required:
      - compatible
      - reg
      - clocks
      - clock-names
      - resets
      - reset-names
      - power-domains
      - "#address-cells"
      - "#size-cells"
      - ranges

    additionalProperties: false

  "^sor@[0-9a-f]+$":
    description: The Serial Output Resource (SOR) can be used to drive HDMI, LVDS, eDP and DP
      outputs.

      See ../pinctrl/nvidia,tegra124-dpaux-padctl.txt for information regarding the DPAUX pad
      controller bindings.
    type: object
    properties:
      compatible:
        const: nvidia,tegra194-sor

      reg:
        maxItems: 1

      interrupts:
        maxItems: 1

      clocks:
        items:
          - description: clock input for the SOR hardware
          - description: SOR output clock
          - description: input for the pixel clock
          - description: reference clock for the SOR clock
          - description: safe reference clock for the SOR clock during power up
          - description: SOR pad output clock

      clock-names:
        items:
          - const: sor
          - enum:
              - source # deprecated
              - out
          - const: parent
          - const: dp
          - const: safe
          - const: pad

      resets:
        items:
          - description: module reset

      reset-names:
        items:
          - const: sor

      power-domains:
        maxItems: 1

      avdd-io-hdmi-dp-supply:
        description: I/O supply for HDMI/DP

      vdd-hdmi-dp-pll-supply:
        description: PLL supply for HDMI/DP

      hdmi-supply:
        description: +5.0V HDMI connector supply

      nvidia,interface:
        description: index of the SOR interface
        $ref: "/schemas/types.yaml#/definitions/uint32"

      nvidia,ddc-i2c-bus:
        description: phandle of an I2C controller used for DDC EDID probing
        $ref: "/schemas/types.yaml#/definitions/phandle"

      nvidia,hpd-gpio:
        description: specifies a GPIO used for hotplug detection
        maxItems: 1

      nvidia,edid:
        description: supplies a binary EDID blob
        $ref: "/schemas/types.yaml#/definitions/uint8-array"

      nvidia,panel:
        description: phandle of a display panel
        $ref: "/schemas/types.yaml#/definitions/phandle"

      nvidia,xbar-cfg:
        description: 5 cells containing the crossbar configuration. Each lane of the SOR,
          identified by the cell's index, is mapped via the crossbar to the pad specified by the
          cell's value.
        $ref: "/schemas/types.yaml#/definitions/uint32-array"

      # optional when driving an eDP output
      nvidia,dpaux:
        description: phandle to a DispayPort AUX interface
        $ref: "/schemas/types.yaml#/definitions/phandle"

      pinctrl-names: true

    patternProperties:
      "^pinctrl-[0-9]+$": true

    required:
      - compatible
      - reg
      - interrupts
      - clocks
      - clock-names
      - resets
      - reset-names
      - power-domains
      - avdd-io-hdmi-dp-supply
      - vdd-hdmi-dp-pll-supply
      - nvidia,interface

    additionalProperties: false

  "^dpaux@[0-9a-f]+$":
    description: DisplayPort AUX interface
    type: object
    properties:
      compatible:
        const: nvidia,tegra194-dpaux

      reg:
        maxItems: 1

      interrupts:
        maxItems: 1

      clocks:
        items:
          - description: clock input for the DPAUX hardware
          - description: reference clock

      clock-names:
        items:
          - const: dpaux
          - const: parent

      resets:
        items:
          - description: module reset

      reset-names:
        items:
          - const: dpaux

      power-domains:
        maxItems: 1

      vdd-supply:
        description: phandle of a supply that powers the DisplayPort link

      i2c-bus:
        description: Subnode where I2C slave devices are listed. This subnode must be always
          present. If there are no I2C slave devices, an empty node should be added.

          See ../../i2c/i2c.yaml for more information.

    patternProperties:
      "^pinmux-.*$":
        description: These child nodes contain the pinmux configuration for the DPAUX/I2C pins
          managed by this controller. Both pins are part of the same pad group and can only be
          configured together. They can be either in I2C mode, DPAUX mode or powered off.
        type: object
        properties:
          groups:
            $ref: /schemas/types.yaml#/definitions/string
            const: dpaux-io

          function:
            $ref: /schemas/types.yaml#/definitions/string
            enum: [ "aux", "i2c", "off" ]

        required:
          - groups
          - function

    required:
      - compatible
      - reg
      - interrupts
      - clocks
      - clock-names
      - resets
      - reset-names
      - power-domains
      - i2c-bus

    additionalProperties: false

  "^vic@[0-9a-f]+$":
    description: video image composer
    type: object
    properties:
      compatible:
        const: nvidia,tegra194-vic

      reg:
        maxItems: 1

      interrupts:
        maxItems: 1

      clocks:
        items:
          - description: clock input for the VIC hardware

      clock-names:
        items:
          - const: vic

      resets:
        items:
          - description: module reset

      reset-names:
        items:
          - const: vic

      power-domains:
        maxItems: 1

      iommus:
        maxItems: 1

      interconnects:
        items:
          - description: memory read client for VIC
          - description: memory write client for VIC

      interconnect-names:
        items:
          - const: dma-mem # read
          - const: write

    required:
      - compatible
      - reg
      - interrupts
      - clocks
      - clock-names
      - resets
      - reset-names
      - power-domains

    additionalProperties: false

examples:
  - |
    #include <dt-bindings/clock/tegra194-clock.h>
    #include <dt-bindings/interrupt-controller/arm-gic.h>
    #include <dt-bindings/memory/tegra194-mc.h>
    #include <dt-bindings/power/tegra194-powergate.h>
    #include <dt-bindings/reset/tegra194-reset.h>

    host1x@13e00000 {
        compatible = "nvidia,tegra194-host1x";
        reg = <0x13e00000 0x10000>,
              <0x13e10000 0x10000>;
        reg-names = "hypervisor", "vm";
        interrupts = <GIC_SPI 265 IRQ_TYPE_LEVEL_HIGH>,
                     <GIC_SPI 263 IRQ_TYPE_LEVEL_HIGH>;
        interrupt-names = "syncpt", "host1x";
        clocks = <&bpmp TEGRA194_CLK_HOST1X>;
        clock-names = "host1x";
        resets = <&bpmp TEGRA194_RESET_HOST1X>;
        reset-names = "host1x";

        #address-cells = <1>;
        #size-cells = <1>;

        ranges = <0x15000000 0x15000000 0x01000000>;
        interconnects = <&mc TEGRA194_MEMORY_CLIENT_HOST1XDMAR &emc>;
        interconnect-names = "dma-mem";

        iommus = <&smmu TEGRA194_SID_HOST1X>;

        display-hub@15200000 {
            compatible = "nvidia,tegra194-display";
            reg = <0x15200000 0x00040000>;
            resets = <&bpmp TEGRA194_RESET_NVDISPLAY0_MISC>,
                     <&bpmp TEGRA194_RESET_NVDISPLAY0_WGRP0>,
                     <&bpmp TEGRA194_RESET_NVDISPLAY0_WGRP1>,
                     <&bpmp TEGRA194_RESET_NVDISPLAY0_WGRP2>,
                     <&bpmp TEGRA194_RESET_NVDISPLAY0_WGRP3>,
                     <&bpmp TEGRA194_RESET_NVDISPLAY0_WGRP4>,
                     <&bpmp TEGRA194_RESET_NVDISPLAY0_WGRP5>;
            reset-names = "misc", "wgrp0", "wgrp1", "wgrp2",
                      "wgrp3", "wgrp4", "wgrp5";
            clocks = <&bpmp TEGRA194_CLK_NVDISPLAY_DISP>,
                     <&bpmp TEGRA194_CLK_NVDISPLAYHUB>;
            clock-names = "disp", "hub";
            status = "disabled";

            power-domains = <&bpmp TEGRA194_POWER_DOMAIN_DISP>;

            #address-cells = <1>;
            #size-cells = <1>;

            ranges = <0x15200000 0x15200000 0x40000>;

            display@15200000 {
                compatible = "nvidia,tegra194-dc";
                reg = <0x15200000 0x10000>;
                interrupts = <GIC_SPI 153 IRQ_TYPE_LEVEL_HIGH>;
                clocks = <&bpmp TEGRA194_CLK_NVDISPLAY_P0>;
                clock-names = "dc";
                resets = <&bpmp TEGRA194_RESET_NVDISPLAY0_HEAD0>;
                reset-names = "dc";

                power-domains = <&bpmp TEGRA194_POWER_DOMAIN_DISP>;
                interconnects = <&mc TEGRA194_MEMORY_CLIENT_NVDISPLAYR &emc>,
                                <&mc TEGRA194_MEMORY_CLIENT_NVDISPLAYR1 &emc>;
                interconnect-names = "dma-mem", "read-1";

                nvidia,outputs = <&sor0 &sor1 &sor2 &sor3>;
                nvidia,head = <0>;
            };

            display@15210000 {
                compatible = "nvidia,tegra194-dc";
                reg = <0x15210000 0x10000>;
                interrupts = <GIC_SPI 154 IRQ_TYPE_LEVEL_HIGH>;
                clocks = <&bpmp TEGRA194_CLK_NVDISPLAY_P1>;
                clock-names = "dc";
                resets = <&bpmp TEGRA194_RESET_NVDISPLAY0_HEAD1>;
                reset-names = "dc";

                power-domains = <&bpmp TEGRA194_POWER_DOMAIN_DISPB>;
                interconnects = <&mc TEGRA194_MEMORY_CLIENT_NVDISPLAYR &emc>,
                                <&mc TEGRA194_MEMORY_CLIENT_NVDISPLAYR1 &emc>;
                interconnect-names = "dma-mem", "read-1";

                nvidia,outputs = <&sor0 &sor1 &sor2 &sor3>;
                nvidia,head = <1>;
            };

            display@15220000 {
                compatible = "nvidia,tegra194-dc";
                reg = <0x15220000 0x10000>;
                interrupts = <GIC_SPI 155 IRQ_TYPE_LEVEL_HIGH>;
                clocks = <&bpmp TEGRA194_CLK_NVDISPLAY_P2>;
                clock-names = "dc";
                resets = <&bpmp TEGRA194_RESET_NVDISPLAY0_HEAD2>;
                reset-names = "dc";

                power-domains = <&bpmp TEGRA194_POWER_DOMAIN_DISPC>;
                interconnects = <&mc TEGRA194_MEMORY_CLIENT_NVDISPLAYR &emc>,
                                <&mc TEGRA194_MEMORY_CLIENT_NVDISPLAYR1 &emc>;
                interconnect-names = "dma-mem", "read-1";

                nvidia,outputs = <&sor0 &sor1 &sor2 &sor3>;
                nvidia,head = <2>;
            };

            display@15230000 {
                compatible = "nvidia,tegra194-dc";
                reg = <0x15230000 0x10000>;
                interrupts = <GIC_SPI 242 IRQ_TYPE_LEVEL_HIGH>;
                clocks = <&bpmp TEGRA194_CLK_NVDISPLAY_P3>;
                clock-names = "dc";
                resets = <&bpmp TEGRA194_RESET_NVDISPLAY0_HEAD3>;
                reset-names = "dc";

                power-domains = <&bpmp TEGRA194_POWER_DOMAIN_DISPC>;
                interconnects = <&mc TEGRA194_MEMORY_CLIENT_NVDISPLAYR &emc>,
                                <&mc TEGRA194_MEMORY_CLIENT_NVDISPLAYR1 &emc>;
                interconnect-names = "dma-mem", "read-1";

                nvidia,outputs = <&sor0 &sor1 &sor2 &sor3>;
                nvidia,head = <3>;
            };
        };

        vic@15340000 {
            compatible = "nvidia,tegra194-vic";
            reg = <0x15340000 0x00040000>;
            interrupts = <GIC_SPI 206 IRQ_TYPE_LEVEL_HIGH>;
            clocks = <&bpmp TEGRA194_CLK_VIC>;
            clock-names = "vic";
            resets = <&bpmp TEGRA194_RESET_VIC>;
            reset-names = "vic";

            power-domains = <&bpmp TEGRA194_POWER_DOMAIN_VIC>;
            interconnects = <&mc TEGRA194_MEMORY_CLIENT_VICSRD &emc>,
                            <&mc TEGRA194_MEMORY_CLIENT_VICSWR &emc>;
            interconnect-names = "dma-mem", "write";
        };

        dpaux0: dpaux@155c0000 {
            compatible = "nvidia,tegra194-dpaux";
            reg = <0x155c0000 0x10000>;
            interrupts = <GIC_SPI 159 IRQ_TYPE_LEVEL_HIGH>;
            clocks = <&bpmp TEGRA194_CLK_DPAUX>,
                     <&bpmp TEGRA194_CLK_PLLDP>;
            clock-names = "dpaux", "parent";
            resets = <&bpmp TEGRA194_RESET_DPAUX>;
            reset-names = "dpaux";
            status = "disabled";

            power-domains = <&bpmp TEGRA194_POWER_DOMAIN_DISP>;

            state_dpaux0_aux: pinmux-aux {
                groups = "dpaux-io";
                function = "aux";
            };

            state_dpaux0_i2c: pinmux-i2c {
                groups = "dpaux-io";
                function = "i2c";
            };

            state_dpaux0_off: pinmux-off {
                groups = "dpaux-io";
                function = "off";
            };

            i2c-bus {
                #address-cells = <1>;
                #size-cells = <0>;
            };
        };

        dpaux1: dpaux@155d0000 {
            compatible = "nvidia,tegra194-dpaux";
            reg = <0x155d0000 0x10000>;
            interrupts = <GIC_SPI 160 IRQ_TYPE_LEVEL_HIGH>;
            clocks = <&bpmp TEGRA194_CLK_DPAUX1>,
                     <&bpmp TEGRA194_CLK_PLLDP>;
            clock-names = "dpaux", "parent";
            resets = <&bpmp TEGRA194_RESET_DPAUX1>;
            reset-names = "dpaux";
            status = "disabled";

            power-domains = <&bpmp TEGRA194_POWER_DOMAIN_DISP>;

            state_dpaux1_aux: pinmux-aux {
                groups = "dpaux-io";
                function = "aux";
            };

            state_dpaux1_i2c: pinmux-i2c {
                groups = "dpaux-io";
                function = "i2c";
            };

            state_dpaux1_off: pinmux-off {
                groups = "dpaux-io";
                function = "off";
            };

            i2c-bus {
                #address-cells = <1>;
                #size-cells = <0>;
            };
        };

        dpaux2: dpaux@155e0000 {
            compatible = "nvidia,tegra194-dpaux";
            reg = <0x155e0000 0x10000>;
            interrupts = <GIC_SPI 245 IRQ_TYPE_LEVEL_HIGH>;
            clocks = <&bpmp TEGRA194_CLK_DPAUX2>,
                     <&bpmp TEGRA194_CLK_PLLDP>;
            clock-names = "dpaux", "parent";
            resets = <&bpmp TEGRA194_RESET_DPAUX2>;
            reset-names = "dpaux";
            status = "disabled";

            power-domains = <&bpmp TEGRA194_POWER_DOMAIN_DISP>;

            state_dpaux2_aux: pinmux-aux {
                groups = "dpaux-io";
                function = "aux";
            };

            state_dpaux2_i2c: pinmux-i2c {
                groups = "dpaux-io";
                function = "i2c";
            };

            state_dpaux2_off: pinmux-off {
                groups = "dpaux-io";
                function = "off";
            };

            i2c-bus {
                #address-cells = <1>;
                #size-cells = <0>;
            };
        };

        dpaux3: dpaux@155f0000 {
            compatible = "nvidia,tegra194-dpaux";
            reg = <0x155f0000 0x10000>;
            interrupts = <GIC_SPI 246 IRQ_TYPE_LEVEL_HIGH>;
            clocks = <&bpmp TEGRA194_CLK_DPAUX3>,
                     <&bpmp TEGRA194_CLK_PLLDP>;
            clock-names = "dpaux", "parent";
            resets = <&bpmp TEGRA194_RESET_DPAUX3>;
            reset-names = "dpaux";
            status = "disabled";

            power-domains = <&bpmp TEGRA194_POWER_DOMAIN_DISP>;

            state_dpaux3_aux: pinmux-aux {
                groups = "dpaux-io";
                function = "aux";
            };

            state_dpaux3_i2c: pinmux-i2c {
                groups = "dpaux-io";
                function = "i2c";
            };

            state_dpaux3_off: pinmux-off {
                groups = "dpaux-io";
                function = "off";
            };

            i2c-bus {
                #address-cells = <1>;
                #size-cells = <0>;
            };
        };

        sor0: sor@15b00000 {
            compatible = "nvidia,tegra194-sor";
            reg = <0x15b00000 0x40000>;
            interrupts = <GIC_SPI 157 IRQ_TYPE_LEVEL_HIGH>;
            clocks = <&bpmp TEGRA194_CLK_SOR0_REF>,
                     <&bpmp TEGRA194_CLK_SOR0_OUT>,
                     <&bpmp TEGRA194_CLK_PLLD>,
                     <&bpmp TEGRA194_CLK_PLLDP>,
                     <&bpmp TEGRA194_CLK_SOR_SAFE>,
                     <&bpmp TEGRA194_CLK_SOR0_PAD_CLKOUT>;
            clock-names = "sor", "out", "parent", "dp", "safe",
                          "pad";
            resets = <&bpmp TEGRA194_RESET_SOR0>;
            reset-names = "sor";
            pinctrl-0 = <&state_dpaux0_aux>;
            pinctrl-1 = <&state_dpaux0_i2c>;
            pinctrl-2 = <&state_dpaux0_off>;
            pinctrl-names = "aux", "i2c", "off";
            status = "disabled";

            power-domains = <&bpmp TEGRA194_POWER_DOMAIN_DISP>;
            nvidia,interface = <0>;
        };

        sor1: sor@15b40000 {
            compatible = "nvidia,tegra194-sor";
            reg = <0x15b40000 0x40000>;
            interrupts = <GIC_SPI 158 IRQ_TYPE_LEVEL_HIGH>;
            clocks = <&bpmp TEGRA194_CLK_SOR1_REF>,
                     <&bpmp TEGRA194_CLK_SOR1_OUT>,
                     <&bpmp TEGRA194_CLK_PLLD2>,
                     <&bpmp TEGRA194_CLK_PLLDP>,
                     <&bpmp TEGRA194_CLK_SOR_SAFE>,
                     <&bpmp TEGRA194_CLK_SOR1_PAD_CLKOUT>;
            clock-names = "sor", "out", "parent", "dp", "safe",
                          "pad";
            resets = <&bpmp TEGRA194_RESET_SOR1>;
            reset-names = "sor";
            pinctrl-0 = <&state_dpaux1_aux>;
            pinctrl-1 = <&state_dpaux1_i2c>;
            pinctrl-2 = <&state_dpaux1_off>;
            pinctrl-names = "aux", "i2c", "off";
            status = "disabled";

            power-domains = <&bpmp TEGRA194_POWER_DOMAIN_DISP>;
            nvidia,interface = <1>;
        };

        sor2: sor@15b80000 {
            compatible = "nvidia,tegra194-sor";
            reg = <0x15b80000 0x40000>;
            interrupts = <GIC_SPI 243 IRQ_TYPE_LEVEL_HIGH>;
            clocks = <&bpmp TEGRA194_CLK_SOR2_REF>,
                     <&bpmp TEGRA194_CLK_SOR2_OUT>,
                     <&bpmp TEGRA194_CLK_PLLD3>,
                     <&bpmp TEGRA194_CLK_PLLDP>,
                     <&bpmp TEGRA194_CLK_SOR_SAFE>,
                     <&bpmp TEGRA194_CLK_SOR2_PAD_CLKOUT>;
            clock-names = "sor", "out", "parent", "dp", "safe",
                          "pad";
            resets = <&bpmp TEGRA194_RESET_SOR2>;
            reset-names = "sor";
            pinctrl-0 = <&state_dpaux2_aux>;
            pinctrl-1 = <&state_dpaux2_i2c>;
            pinctrl-2 = <&state_dpaux2_off>;
            pinctrl-names = "aux", "i2c", "off";
            status = "disabled";

            power-domains = <&bpmp TEGRA194_POWER_DOMAIN_DISP>;
            nvidia,interface = <2>;
        };

        sor3: sor@15bc0000 {
            compatible = "nvidia,tegra194-sor";
            reg = <0x15bc0000 0x40000>;
            interrupts = <GIC_SPI 244 IRQ_TYPE_LEVEL_HIGH>;
            clocks = <&bpmp TEGRA194_CLK_SOR3_REF>,
                     <&bpmp TEGRA194_CLK_SOR3_OUT>,
                     <&bpmp TEGRA194_CLK_PLLD4>,
                     <&bpmp TEGRA194_CLK_PLLDP>,
                     <&bpmp TEGRA194_CLK_SOR_SAFE>,
                     <&bpmp TEGRA194_CLK_SOR3_PAD_CLKOUT>;
            clock-names = "sor", "out", "parent", "dp", "safe",
                          "pad";
            resets = <&bpmp TEGRA194_RESET_SOR3>;
            reset-names = "sor";
            pinctrl-0 = <&state_dpaux3_aux>;
            pinctrl-1 = <&state_dpaux3_i2c>;
            pinctrl-2 = <&state_dpaux3_off>;
            pinctrl-names = "aux", "i2c", "off";
            status = "disabled";

            power-domains = <&bpmp TEGRA194_POWER_DOMAIN_DISP>;
            nvidia,interface = <3>;
        };
    };
```
