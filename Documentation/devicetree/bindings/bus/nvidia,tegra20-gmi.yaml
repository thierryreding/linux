## Documentation/devicetree/bindings/display/tegra/nvidia,tegra210-tsec.yaml
```yaml
# SPDX-License-Identifier: (GPL-2.0-only OR BSD-2-Clause)
%YAML 1.2
---
$id: http://devicetree.org/schemas/display/tegra/nvidia,tegra210-tsec.yaml#
$schema: http://devicetree.org/meta-schemas/core.yaml#

title: NVIDIA Tegra210 Security Co-Processor

maintainers:
  - Thierry Reding <thierry.reding@gmail.com>
  - Jon Hunter <jonathanh@nvidia.com>

properties:
  compatible:
    const: nvidia,tegra210-tsec

  reg:
    maxItems: 1

  interrupts:
    maxItems: 1

  clocks:
    items:
      - description: module clock

  clock-names:
    items:
      - const: tsec

  resets:
    items:
      - description: module reset

  reset-names:
    items:
      - const: tsec

required:
  - compatible
  - reg
  - interrupts
  - clocks
  - clock-names
  - resets
  - reset-names

additionalProperties: false

examples:
  - |
    #include <dt-bindings/clock/tegra210-car.h>
    #include <dt-bindings/interrupt-controller/arm-gic.h>

    tsec@54100000 {
        compatible = "nvidia,tegra210-tsec";
        reg = <0x54100000 0x40000>;
        interrupts = <GIC_SPI 50 IRQ_TYPE_LEVEL_HIGH>;
        clocks = <&tegra_car TEGRA210_CLK_TSEC>;
        clock-names = "tsec";
        resets = <&tegra_car 83>;
        reset-names = "tsec";
    };
```

## Documentation/devicetree/bindings/display/tegra/nvidia,tegra234-dc.yaml
```yaml
# SPDX-License-Identifier: (GPL-2.0-only OR BSD-2-Clause)
%YAML 1.2
---
$id: http://devicetree.org/schemas/display/tegra/nvidia,tegra234-dc.yaml#
$schema: http://devicetree.org/meta-schemas/core.yaml#

title: NVIDIA Tegra234 (and later) Display Controller

maintainers:
  - Thierry Reding <thierry.reding@gmail.com>
  - Jon Hunter <jonathanh@nvidia.com>

properties:
  $nodename:
    pattern: "^display@[0-9a-f]+$"

  compatible:
    enum:
      - nvidia,tegra234-dc

  reg:
    maxItems: 1

  clocks:
    maxItems: 1

  iommus:
    maxItems: 1

  interconnects:
    description: Description of the interconnect paths for the
      display controller; see ../interconnect/interconnect.txt
      for details.

  interconnect-names:
    items:
      - const: dma-mem # read-0
      - const: read-1

  memory-region: true

  nvidia,head:
    description: The number of the display controller head. This
      is used to setup the various types of output to receive
      video data from the given head.
    $ref: "/schemas/types.yaml#/definitions/uint32"

  nvidia,outputs:
    description: A list of phandles of outputs that this display
      controller can drive.
    $ref: "/schemas/types.yaml#/definitions/phandle-array"

additionalProperties: false

required:
  - compatible
  - reg
  - clocks
  - nvidia,head
...
```

## Documentation/devicetree/bindings/display/tegra/nvidia,tegra234-dce.yaml
```yaml
# SPDX-License-Identifier: (GPL-2.0-only OR BSD-2-Clause)
%YAML 1.2
---
$id: http://devicetree.org/schemas/display/tegra/nvidia,tegra234-dce.yaml#
$schema: http://devicetree.org/meta-schemas/core.yaml#

title: NVIDIA Tegra234 (and later) Display Control Engine

maintainers:
  - Thierry Reding <thierry.reding@gmail.com>
  - Jon Hunter <jonathanh@nvidia.com>

properties:
  compatible:
    enum:
      - nvidia,tegra234-dce

  reg:
    maxItems: 1

  ranges:
    maxItems: 1

  "#address-cells":
    enum: [ 1, 2 ]

  "#size-cells":
    enum: [ 1, 2 ]

  mboxes:
    maxItems: 8

  mbox-names:
    items:
      - const: rm-rx
      - const: rm-tx
      - const: notify-rx
      - const: notify-tx
      - const: admin-rx
      - const: admin-tx
      - const: boot
      - const: irq

  iommus:
    maxItems: 1

additionalProperties:
  type: object
...
```

## Documentation/devicetree/bindings/dma/nvidia,tegra20-apbdma.yaml
```yaml
# SPDX-License-Identifier: (GPL-2.0-only OR BSD-2-Clause)
%YAML 1.2
---
$id: http://devicetree.org/schemas/dma/nvidia,tegra20-apbdma.yaml#
$schema: http://devicetree.org/meta-schemas/core.yaml#

title: NVIDIA Tegra APB DMA controller

maintainers:
  - Thierry Reding <thierry.reding@gmail.com>
  - Jon Hunter <jonathanh@nvidia.com>

properties:
  compatible:
    oneOf:
      - enum:
          - nvidia,tegra20-apbdma
          - nvidia,tegra114-apbdma
          - nvidia,tegra148-apbdma

      - items:
          - const: nvidia,tegra30-apbdma
          - const: nvidia,tegra20-apbdma

      - items:
          - enum:
              - nvidia,tegra124-apbdma
              - nvidia,tegra210-apbdma
          - enum:
              - nvidia,tegra148-apbdma

  reg:
    description: Base address and length of the DMA controller registers. This should include all
      of the per-channel registers.
    maxItems: 1

  interrupts:
    minItems: 16
    maxItems: 32

  clocks:
    items:
      - description: module clock

  clock-names:
    items:
      - const: dma

  resets:
    items:
      - description: module reset

  reset-names:
    items:
      - const: dma

  "#dma-cells":
    description: This dictates the length of DMA specifiers in client nodes' dmas properties. The
      specifier represents the DMA request select value for the peripheral. For more details,
      consult the Tegra TRM's documentation of the APB DMA channel control register REQ_SEL field.
    const: 1

required:
  - compatible
  - reg
  - interrupts
  - clocks
  - resets
  - reset-names
  - "#dma-cells"

additionalProperties: false

examples:
  - |
    #include <dt-bindings/clock/tegra20-car.h>
    #include <dt-bindings/interrupt-controller/arm-gic.h>

    dma@6000a000 {
        compatible = "nvidia,tegra20-apbdma";
        reg = <0x6000a000 0x1200>;
        interrupts = <GIC_SPI 136 IRQ_TYPE_LEVEL_HIGH>,
                     <GIC_SPI 137 IRQ_TYPE_LEVEL_HIGH>,
                     <GIC_SPI 138 IRQ_TYPE_LEVEL_HIGH>,
                     <GIC_SPI 139 IRQ_TYPE_LEVEL_HIGH>,
                     <GIC_SPI 140 IRQ_TYPE_LEVEL_HIGH>,
                     <GIC_SPI 141 IRQ_TYPE_LEVEL_HIGH>,
                     <GIC_SPI 142 IRQ_TYPE_LEVEL_HIGH>,
                     <GIC_SPI 143 IRQ_TYPE_LEVEL_HIGH>,
                     <GIC_SPI 144 IRQ_TYPE_LEVEL_HIGH>,
                     <GIC_SPI 145 IRQ_TYPE_LEVEL_HIGH>,
                     <GIC_SPI 146 IRQ_TYPE_LEVEL_HIGH>,
                     <GIC_SPI 147 IRQ_TYPE_LEVEL_HIGH>,
                     <GIC_SPI 148 IRQ_TYPE_LEVEL_HIGH>,
                     <GIC_SPI 149 IRQ_TYPE_LEVEL_HIGH>,
                     <GIC_SPI 150 IRQ_TYPE_LEVEL_HIGH>,
                     <GIC_SPI 151 IRQ_TYPE_LEVEL_HIGH>;
        clocks = <&tegra_car TEGRA20_CLK_APBDMA>;
        resets = <&tegra_car 34>;
        reset-names = "dma";
        #dma-cells = <1>;
    };
```

## Documentation/devicetree/bindings/firmware/nvidia,tegra186-bpmp.yaml
```yaml
# SPDX-License-Identifier: (GPL-2.0-only OR BSD-2-Clause)
%YAML 1.2
---
$id: http://devicetree.org/schemas/firmware/nvidia,tegra186-bpmp.yaml#
$schema: http://devicetree.org/meta-schemas/core.yaml#

title: NVIDIA Tegra186 (and later) Boot and Power Management Processor (BPMP)

maintainers:
  - Thierry Reding <thierry.reding@gmail.com>
  - Jon Hunter <jonathanh@nvidia.com>

description: |
  The BPMP is a specific processor in Tegra chip, which is designed for
  booting process handling and offloading the power management, clock
  management, and reset control tasks from the CPU. The binding document
  defines the resources that would be used by the BPMP firmware driver,
  which can create the interprocessor communication (IPC) between the
  CPU and BPMP.

  The BPMP implements some services which must be represented by separate
  nodes. For example, it can provide access to certain I2C controllers, and
  the I2C bindings represent each I2C controller as a device tree node. Such
  nodes should be nested directly inside the main BPMP node.

  Software can determine whether a child node of the BPMP node represents a
  device by checking for a compatible property. Any node with a compatible
  property represents a device that can be instantiated. Nodes without a
  compatible property may be used to provide configuration information
  regarding the BPMP itself, although no such configuration nodes are
  currently defined by this binding.

  The BPMP firmware defines no single global name-/numbering-space for such
  services. Put another way, the numbering scheme for I2C buses is distinct
  from the numbering scheme for any other service the BPMP may provide (e.g.
  a future hypothetical SPI bus service). As such, child device nodes will
  have no "reg" property, and the BPMP node will have no "#address-cells" or
  "#size-cells" property.

properties:
  compatible:
    items:
      - enum:
          - nvidia,tegra186-bpmp

  iommus:
    $ref: /schemas/types.yaml#/definitions/phandle-array
    description: |
      The phandle of the IOMMU and the IOMMU specifier. See ../iommu/iommu.txt
      for details.

  mboxes:
    $ref: /schemas/types.yaml#/definitions/phandle-array
    description: |
      The phandle of the mailbox controller and the mailbox specifier. See
      ../mailbox/mailbox.txt and ../mailbox/nvidia,tegra186-hsp.txt for
      details.

  shmem:
    $ref: /schemas/types.yaml#/definitions/phandle-array
    description: List of phandles for the TX and RX shared memory areas used
      for interprocess communication between the CPU and the BPMP.

      The shared memory area for the IPC TX and RX between CPU and BPMP are
      predefined and work on top of sysram, which is an SRAM inside the chip.

      See ../sram/sram.yaml for the bindings.

  "#clock-cells":
    const: 1

  "#power-domain-cells":
    const: 1

  "#reset-cells":
    const: 1

  i2c:
    type: object
    description: |
      The BPMP can provide serialized access to I2C controllers that have
      been assigned to it.

    properties:
      compatible:
        items:
          - enum:
              - nvidia,tegra186-bpmp-i2c

      "#address-cells":
        const: 1

      "#size-cells":
        const: 0

      nvidia,bpmp-bus-id:
        $ref: /schemas/types.yaml#/definitions/uint32
        description: The bus ID of the I2C controller.

    required:
      - compatible
      - "#address-cells"
      - "#size-cells"
      - nvidia,bpmp-bus-id

    patternProperties:
      "^.*@[0-9a-f]+$":
        type: object
        description: I2C slave
        properties:
          reg:
            maxItems: 1
            description: I2C address of the slave

        required:
          - reg

    additionalProperties: false

  thermal:
    type: object
    description:
      The BPMP provides functionality that exposes system temperature sensors
      and which can be used to trigger a system shutdown if the temperature
      for a given zone exceeds the specified thresholds.

    properties:
      compatible:
        items:
          - enum:
              - nvidia,tegra186-bpmp-thermal

      "#thermal-sensor-cells":
        description: The ID of the thermal zone.
        const: 1

    required:
      - compatible
      - "#thermal-sensor-cells"

    additionalProperties: false

required:
  - compatible
  - mboxes
  - shmem
  - "#clock-cells"
  - "#power-domain-cells"
  - "#reset-cells"

additionalProperties: false

examples:
  - |
    #include <dt-bindings/mailbox/tegra186-hsp.h>
    #include <dt-bindings/memory/tegra186-mc.h>

    bpmp {
        compatible = "nvidia,tegra186-bpmp";
        iommus = <&smmu TEGRA186_SID_BPMP>;
        mboxes = <&hsp_top0 TEGRA_HSP_MBOX_TYPE_DB TEGRA_HSP_DB_MASTER_BPMP>;
        shmem = <&cpu_bpmp_tx &cpu_bpmp_rx>;
        #clock-cells = <1>;
        #power-domain-cells = <1>;
        #reset-cells = <1>;

        i2c {
            compatible = "nvidia,tegra186-bpmp-i2c";
            nvidia,bpmp-bus-id = <5>;
            #address-cells = <1>;
            #size-cells = <0>;
            status = "disabled";
        };

        thermal {
            compatible = "nvidia,tegra186-bpmp-thermal";
            #thermal-sensor-cells = <1>;
        };
    };
```

## Documentation/devicetree/bindings/gpio/nvidia,tegra20-gpio.yaml
```yaml
# SPDX-License-Identifier: (GPL-2.0-only OR BSD-2-Clause)
%YAML 1.2
---
$id: http://devicetree.org/schemas/gpio/nvidia,tegra20-gpio.yaml#
$schema: http://devicetree.org/meta-schemas/core.yaml#

title: NVIDIA Tegra GPIO Controller (Tegra20 - Tegra210)

maintainers:
  - Thierry Reding <thierry.reding@gmail.com>
  - Jon Hunter <jonathanh@nvidia.com>

properties:
  compatible:
    oneOf:
      - enum:
          - nvidia,tegra20-gpio
          - nvidia,tegra30-gpio

      - items:
          - enum:
              - nvidia,tegra114-gpio
              - nvidia,tegra124-gpio
              - nvidia,tegra210-gpio
          - const: nvidia,tegra30-gpio

  reg:
    maxItems: 1

  interrupts:
    description: The interrupt outputs from the controller. For Tegra20,
      there should be 7 interrupts specified, and for Tegra30, there should
      be 8 interrupts specified.

  "#gpio-cells":
    description: The first cell is the pin number and the second cell is used
      to specify the GPIO polarity (0 = active high, 1 = active low).
    $ref: "/schemas/types.yaml#/definitions/uint32"
    const: 2

  gpio-controller: true

  "#interrupt-cells":
    description: |
      Should be 2. The first cell is the GPIO number. The second cell is
      used to specify flags:

        bits[3:0] trigger type and level flags:
          1 = low-to-high edge triggered.
          2 = high-to-low edge triggered.
          4 = active high level-sensitive.
          8 = active low level-sensitive.

      Valid combinations are 1, 2, 3, 4, 8.
    const: 2

  interrupt-controller: true

allOf:
  - if:
      properties:
        compatible:
          contains:
            const: nvidia,tegra30-gpio
    then:
      properties:
        interrupts:
          minItems: 8
          maxItems: 8
    else:
      properties:
        interrupts:
          minItems: 7
          maxItems: 7

required:
  - compatible
  - reg
  - interrupts
  - "#gpio-cells"
  - gpio-controller
  - "#interrupt-cells"
  - interrupt-controller

unevaluatedProperties:
  type: object
  required:
    - gpio-hog

examples:
  - |
    gpio: gpio@6000d000 {
        compatible = "nvidia,tegra20-gpio";
        reg = <0x6000d000 0x1000>;
        interrupts = <0 32 0x04>,
                     <0 33 0x04>,
                     <0 34 0x04>,
                     <0 35 0x04>,
                     <0 55 0x04>,
                     <0 87 0x04>,
                     <0 89 0x04>;
        #gpio-cells = <2>;
        gpio-controller;
        #interrupt-cells = <2>;
        interrupt-controller;
    };
```

## Documentation/devicetree/bindings/gpio/st,stmpe-gpio.yaml
```yaml
# SPDX-License-Identifier: GPL-2.0-only
%YAML 1.2
---
$id: http://devicetree.org/schemas/gpio/st,stmpe-gpio.yaml#
$schema: http://devicetree.org/meta-schemas/core.yaml#

title: ST Microelectronics STMPE Multi-Functional Device (GPIO)

maintainers:
  - Linus Walleij <linus.walleij@linaro.org>

properties:
  compatible:
    const: st,stmpe-gpio

  st,norequest-mask:
    $ref: /schemas/types.yaml#/definitions/uint32
    description: bitmask specifying which GPIOs should _not_ be requestable  due to different
      usage (e.g. touch, keypad)

additionalProperties: false

required:
  - compatible

examples:
  - |
    stmpe_gpio {
      compatible = "st,stmpe-gpio";
      st,norequest-mask = <0x20>; // gpio 5 can't be used
    };
```
